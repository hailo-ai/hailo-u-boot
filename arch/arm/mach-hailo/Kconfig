## arch/arm/mach-hailo/Kconfig
```kconfig
if ARCH_HAILO

config SYS_ARCH
	default "arm"

config SYS_SOC
	default "hailo"

config MACH_HAILO1X
	bool
	select ARCH_SUPPORT_TFABOOT
	select MISC_INIT_R
	select BOARD_EARLY_INIT_R
	select SCMI_BASE
	select SCMI_HAILO
	select SUPPORT_SPL
	select ARM64
	select ARMV8_MULTIENTRY
	select SYS_NS16550
	select DM
	select DM_SERIAL
	select PRE_CONSOLE_BUFFER
	select SILENT_CONSOLE
	select FIT
	select DM_SPI
	select DM_SPI_FLASH
	select OF_CONTROL
	select OF_BOARD
	select SPI
	select SPI_FLASH
	select DM_ETH
	select MACB
	select DM_GPIO
	select CLK
	select CLK_SCMI
	select FIRMWARE
	select SCMI_FIRMWARE
	select DM_RESET
	select RESET_SCMI
	select DM_MAILBOX
	select ARM_PL320_MAILBOX
	select PRINTF
	select PANIC_HANG
	select OF_LIBFDT
	select EFI_PARTITION
	select PINCONF
	select PINCTRL
	select PINCTRL_HAILO15
	select DM_I2C
	select SYS_I2C_DW
	select ENV_VARS_UBOOT_CONFIG
	select SPL
	select SPL_USE_ARCH_MEMSET
	select SPL_USE_ARCH_MEMCPY
	select SPL_DM
	# due to issue MSW-4053, we must enable MMC write in SPL even though we only do read,
	# since the changes this makes to the SD initalization flow enables some SD cards to work.
	select SPL_MMC_WRITE if SPL_MMC
	select SPL_DM_MAILBOX
	select SPL_LIBCOMMON_SUPPORT
	select SPL_LIBGENERIC_SUPPORT
	select SPL_OF_CONTROL
	select SPL_SERIAL
	select SPL_CLK
	select SPL_DM_RESET
	select SPL_FIRMWARE
	select SPL_OF_TRANSLATE
	select SPL_SEPARATE_BSS
	select SPL_ENV_SUPPORT
	select SPL_ATF
	select SPL_LOAD_FIT
	select SPL_FIT_SIGNATURE
	select FIT_SIGNATURE
	select SYS_RESET_SCTRL # TODO: understand why this
	select TFABOOT
	select SPL_BOARD_INIT
	select PSCI_RESET
	select SYSRESET
	select SYSRESET_PSCI
	select ARMV8_CRYPTO
    imply OF_LIBFDT_OVERLAY
	imply CMD_DM
	imply CMD_SF
	imply CMD_NET
	imply CMD_GPT
	imply NET_RANDOM_ETHADDR
	imply CMD_PING
	imply CMD_DHCP
	imply CMD_PCAP
	imply CMD_MMC
	imply CMD_FAT
	imply CMD_WDT
	imply SPL_DM_SPI
	imply SPL_DM_SPI_FLASH
	imply SPL_SPI
	imply SPL_SPI_FLASH_SUPPORT
	imply SPL_NOR_SUPPORT
	imply SPL_DM_SEQ_ALIAS
	imply SPL_EFI_PARTITION
	imply WATCHDOG
	imply SPL_WDT
	imply SPL_WATCHDOG
	imply WDT
	imply WDT_SP805
	imply FS_FAT
	imply FAT_WRITE
	imply CMD_BOOTMENU
	imply PARTITION_TYPE_GUID
	imply AUTOBOOT_MENU_SHOW
	imply CMD_MEMTEST
	imply CMD_MII
	imply CMD_PART
	imply CMD_I2C
	imply CMD_POWEROFF
	imply HUSH_PARSER
	imply AUTOBOOT
	imply SPL_DM_MMC
	imply SPL_MMC
	imply SPL_YMODEM_SUPPORT
	imply CMSDK_GPIO
	imply CMD_GPIO
	imply DM_GPIO
	imply GPIO_HOG
	imply DM_MMC
	imply MMC_SDHCI
	imply MMC_SDHCI_SNPS
	imply MMC_SDHCI_ADMA

config MACH_HAILO15
	bool
	select MACH_HAILO1X
	imply ENV_IS_IN_SPI_FLASH
	imply SPL_ENV_IS_IN_SPI_FLASH
	imply CADENCE_QSPI
	imply SPL_FS_FAT

config MACH_HAILO15L
	bool
	select MACH_HAILO1X
	imply ENV_IS_IN_MMC
	imply SPL_ENV_IS_IN_MMC
	imply SPL_MMC
	imply ENV_IS_IN_SPI_FLASH
	imply SPL_ENV_IS_IN_SPI_FLASH
	select HAILO_XSPI
	select SPL_RAM_SUPPORT
	select SPL_RAM_DEVICE
	select SUPPORT_RAW_INITRD
	imply SPL_FS_FAT
	imply SUPPORT_EMMC_BOOT
	imply SUPPORT_EMMC_BOOT_OVERRIDE_PART_CONFIG
	imply SYS_MMCSD_RAW_MODE_U_BOOT_USE_SECTOR

config MACH_HAILO10
	bool
	select MACH_HAILO1X

config MACH_HAILO12L
	bool
	select MACH_HAILO1X

if MACH_HAILO1X

config CORE_IMAGE_NAME
	string "Image Name"
	default "core-image-minimal"

config LMB_MAX_REGIONS
	default 32

config PRE_CON_BUF_ADDR
	default 0x802FE000

config SYS_LOAD_ADDR
	default 0x80500000

config SYS_TEXT_BASE
	default 0x80500000

config SYS_MALLOC_LEN
	default 0x81f000

config SYS_MALLOC_F_LEN
	default 0x10000

config SYS_UBOOT_OFFSET
	hex "U-BOOT offset in relevant storage"
	default 0x80000

config ENV_OFFSET
	default 0x50000

config ENV_SECT_SIZE
	default 0x4000

config MAC_ADDR_OFFSET
	hex "Stored MAC address offset in the relevant storage"
	default 0x7000

config ENV_SIZE
	default 0x4000

config SYS_MMC_ENV_DEV
	default 1

config SYS_MMC_ENV_PART
	default 1

config SPL_TEXT_BASE
	default 0x801D4000

config SPL_SIZE_LIMIT
	default 0x2C000

config SPL_SYS_MALLOC_F_LEN
	default 0xbec00

config HAILO15_SPL_DRAM_SIZE
	hex "Hailo15 SPL DRAM size"
	default 0x10000000

config HAILO15_DTB_ADDRESS
	hex "Hailo15 DTB load address"
	default 0x80100000

config HAILO15_DTB_MAX_SIZE
	hex "Hailo15 DTB maximum size"
	default 0x8000 if MACH_HAILO12L
	default 0xF000 if !MACH_HAILO12L

config SYS_MMCSD_RAW_MODE_U_BOOT_SECTOR
	default 0x400

config SPL_SIZE_LIMIT_PROVIDE_STACK
	default 0

config SYS_PROMPT
	default "hailo15# " if MACH_HAILO15
	default "hailo15l# " if MACH_HAILO15L
	default "hailo10# " if MACH_HAILO10

config HAILO15_DDR_ENABLE_ECC
	bool "Hailo15 DDR enable ECC"

config HAILO15_EMMC_8BIT
	bool "Hailo15 emmc 8bit"

config HAILO_NAND_BOOT
	bool "Hailo NAND boot"
	help
	  Hailo NAND boot
	  Enable this option to boot from NAND flash
	select SPI
	select MTD
	select DM_MTD
	select MTD_NAND_CORE
	select MTD_SPI_NAND
	select MTD_PARTITIONS
	select DM_SPI
	select DM_SPI_FLASH
	select LZO
	select ZLIB
	select CMD_MTD
	select CMD_MTDPARTS
	select CMD_UBI
	select CMD_UBIFS

config MAC_ADDR_IN_SPIFLASH
	bool "MAC address in SPI Flash"
	help
	  MAC address in SPI Flash
	  Enable this option to read the MAC from SPI Flash

config NR_DRAM_BANKS
	default 2

config HAILO15_SWUPDATE
	bool "Hailo15 SWUpdate support"
	select SUPPORT_RAW_INITRD

config HAILO15_ENABLE_CORESIGHT_AT_BOOT
	bool "Hailo15 enable coresight at boot"

config SPL_OF_LIBFDT_ASSUME_MASK
	default 0

config SYS_MMCSD_FS_BOOT_PARTITION
	default -2

config HAILO15_MMC_BOOT_PARTITION
	int
	default 1

config HAILO15_MMC_ROOTFS_PARTITION
	int
	default 2

config HAILO15_MMC_BOOT_PARTITION_B
	int
	default 3

config HAILO15_MMC_ROOTFS_PARTITION_B
	int
	default 4

config HAILO_VELOCE
	bool

config BAUDRATE
	default 12500000 if HAILO_VELOCE

endif

config SPL_LOAD_FIT_ADDRESS
	# u-boot-tfa.itb address in boot from RAM/Pcie, and it is used when not in falcon mode [when not skipping u-boot proper].
	default 0x8032C000 if !SPL_OS_BOOT
	# fitImage address in boot from RAM/Pcie, and it is used when in falcon mode [when skipping u-boot proper].
	default 0x88000000 if SPL_OS_BOOT

config TARGET_HAILO15_VP
	bool "Hailo15 VP"
	select MACH_HAILO15

config TARGET_HAILO15_GINGER_SOC
	bool "Hailo15 Ginger Soc"
	select MACH_HAILO15

config TARGET_HAILO15_GINGER_SOC_SDIO0
	bool "Hailo15 Ginger Soc sdio0"
	select MACH_HAILO15

config TARGET_HAILO15_GINGER_IMAGING
	bool "Hailo15 Ginger Imaging"
	select MACH_HAILO15

config TARGET_HAILO15_LAVENDER
	bool "Hailo15 Lavender"
	select MACH_HAILO15

config TARGET_HAILO15_VELOCE
	bool "Hailo15 VELOCE"
	select MACH_HAILO15
	select HAILO_VELOCE

config TARGET_HAILO15L_VELOCE
	bool "Hailo15L VELOCE"
	select MACH_HAILO15L
	select HAILO_VELOCE

config TARGET_HAILO15_EVB_2_CAMERA_VPU
	bool "Hailo15 EVB 2 Camera VPU"
	select MACH_HAILO15

config TARGET_HAILO15_EVB_SECURITY_CAMERA
	bool "Hailo15 EVB Security Camera"
	select MACH_HAILO15

config TARGET_HAILO15_SBC
	bool "Hailo15 SBC"
	select MACH_HAILO15

config TARGET_HAILO15_SBC_REV3
	bool "Hailo15 SBC REV3"
	select MACH_HAILO15

config TARGET_HAILO15_SBC_REV3_1
	bool "Hailo15 SBC REV3-1"
	select MACH_HAILO15

config TARGET_HAILO15L_OREGANO
	bool "Hailo15L Oregano"
	select MACH_HAILO15L

config TARGET_HAILO15L_EVB
	bool "Hailo15L EVB"
	select MACH_HAILO15L

config TARGET_HAILO15L_SBC
	bool "Hailo15L SBC"
	select MACH_HAILO15L

config TARGET_HAILO15L_SBC_NAND
	bool "Hailo15L SBC NAND flash"
	select MACH_HAILO15L
	select HAILO_NAND_BOOT

config TARGET_HAILO10_M2
	bool "Hailo10 M.2"
	select MACH_HAILO10

config TARGET_HAILO10_M2_DEVEL
	bool "Hailo10 M.2 development"
	select MACH_HAILO10

config TARGET_HAILO10_SBC_REV3
	bool "Hailo10 SBC REV3"
	select MACH_HAILO10

config TARGET_HAILO10_USB_DONGLE
	bool "Hailo10 USB Dongle"
	select MACH_HAILO10

config TARGET_HAILO12L_EVB
	bool "Hailo12L EVB"
	select MACH_HAILO12L

config TARGET_HAILO12L_VELOCE
	bool "Hailo12L VELOCE"
	select MACH_HAILO12L
	select HAILO_VELOCE

config TARGET_HAILO12L_MINT
	bool "Hailo12L Mint"
	select MACH_HAILO12L

config TARGET_HAILO12L_MAPLE
	bool "Hailo12L Maple"
	select MACH_HAILO12L

source "board/hailo/hailo15-vp/Kconfig"
source "board/hailo/hailo15-ginger-soc/Kconfig"
source "board/hailo/hailo15-ginger-soc-sdio0/Kconfig"
source "board/hailo/hailo15-lavender/Kconfig"
source "board/hailo/hailo15-veloce/Kconfig"
source "board/hailo/hailo15l-veloce/Kconfig"
source "board/hailo/hailo15-evb-2-camera-vpu/Kconfig"
source "board/hailo/hailo15-evb-security-camera/Kconfig"
source "board/hailo/hailo15-sbc/Kconfig"
source "board/hailo/hailo15-sbc-rev3/Kconfig"
source "board/hailo/hailo15-sbc-rev3-1/Kconfig"
source "board/hailo/hailo15l-oregano/Kconfig"
source "board/hailo/hailo15l-evb/Kconfig"
source "board/hailo/hailo15l-sbc/Kconfig"
source "board/hailo/hailo15l-sbc-nand/Kconfig"
source "board/hailo/hailo10-m2/Kconfig"
source "board/hailo/hailo10-sbc-rev3/Kconfig"
source "board/hailo/hailo10-usb-dongle/Kconfig"
source "board/hailo/hailo12l-evb/Kconfig"
source "board/hailo/hailo12l-veloce/Kconfig"
source "board/hailo/hailo12l-mint/Kconfig"
source "board/hailo/hailo12l-maple/Kconfig"

endif
```

## board/hailo/hailo10-sbc-rev3/Kconfig
```kconfig
if TARGET_HAILO10_SBC_REV3

config SYS_BOARD
	default "hailo10-sbc-rev3"

config SYS_VENDOR
	default "hailo"

config SYS_CONFIG_NAME
	default "hailo10-sbc-rev3"
	help
	  This option contains information about board configuration name.
	  Based on this option include/configs/<CONFIG_SYS_CONFIG_NAME>.h header
	  will be used for board configuration.

endif
```

## configs/hailo10_sbc_rev3_defconfig
```kconfig
CONFIG_ARM=y
CONFIG_ARCH_HAILO=y
CONFIG_TARGET_HAILO10_SBC_REV3=y
CONFIG_DEFAULT_DEVICE_TREE="hailo10-sbc-rev3"
CONFIG_SPI_FLASH_ISSI=y
CONFIG_SPI_FLASH_MACRONIX=y
CONFIG_SPL_OS_BOOT=y
CONFIG_SYS_OS_BASE=0x70080000
CONFIG_SPL_NOR_SUPPORT=y
CONFIG_SPL_LOAD_FIT=y
CONFIG_SPL_GZIP=y
# CONFIG_SPL_EFI_PARTITION is not set
# CONFIG_SPL_MMC is not set
# CONFIG_SPL_FS_FAT is not set
# CONFIG_SPL_WATCHDOG is not set
# CONFIG_SPL_YMODEM_SUPPORT is not set
# CONFIG_CMD_BOOTMENU is not set
# CONFIG_SPL_DM_SEQ_ALIAS is not set
# CONFIG_SPL_DM_MMC is not set
# CONFIG_WATCHDOG is not set
# CONFIG_WDT is not set
# CONFIG_SPL_WDT is not set
```

## configs/hailo15_sbc_rev3-1_defconfig
```kconfig
CONFIG_ARM=y
CONFIG_ARCH_HAILO=y
CONFIG_TARGET_HAILO15_SBC_REV3_1=y
CONFIG_HAILO_SENSOR_DETECT=y
CONFIG_DEFAULT_DEVICE_TREE="hailo15-sbc-rev3-1"
CONFIG_SPI_FLASH_ISSI=y
CONFIG_SPI_FLASH_MACRONIX=y
CONFIG_USE_PREBOOT=y
CONFIG_PREBOOT="i2c dev 1; i2c mw 0x40 0x00 0x54 1"
```

## configs/hailo15_sbc_rev3_defconfig
```kconfig
CONFIG_ARM=y
CONFIG_ARCH_HAILO=y
CONFIG_TARGET_HAILO15_SBC_REV3=y
CONFIG_HAILO_SENSOR_DETECT=y
CONFIG_DEFAULT_DEVICE_TREE="hailo15-sbc-rev3"
CONFIG_SPI_FLASH_ISSI=y
CONFIG_SPI_FLASH_MACRONIX=y
```

## configs/hailo15l_evb_defconfig
```kconfig
CONFIG_ARM=y
CONFIG_ARCH_HAILO=y
CONFIG_TARGET_HAILO15L_EVB=y
CONFIG_DEFAULT_DEVICE_TREE="hailo15l-evb"
CONFIG_SPI_FLASH_STMICRO=y
CONFIG_DM_ETH_PHY=y
CONFIG_PHY_MSCC=y
CONFIG_RGMII=y
CONFIG_DM_MDIO=y
```

## configs/hailo15l_sbc_defconfig
```kconfig
CONFIG_ARM=y
CONFIG_ARCH_HAILO=y
CONFIG_TARGET_HAILO15L_SBC=y
CONFIG_BOARD_LATE_INIT=y
CONFIG_DEFAULT_DEVICE_TREE="hailo15l-sbc"
CONFIG_SPI_FLASH_ISSI=y
CONFIG_SPL_LOAD_FIT_ADDRESS=0x70080000
CONFIG_DM_ETH_PHY=y
CONFIG_PHY_MSCC=y
CONFIG_PHY_TI=y
CONFIG_PHY_TI_GENERIC=y
CONFIG_RGMII=y
CONFIG_DM_MDIO=y
CONFIG_USE_PREBOOT=y
CONFIG_PREBOOT="i2c dev 1; i2c mw 0x43 0x00 0x56 1"
```

## configs/hailo15l_sbc_nand_defconfig
```kconfig
CONFIG_ARM=y
CONFIG_ARCH_HAILO=y
CONFIG_TARGET_HAILO15L_SBC_NAND=y
CONFIG_DEFAULT_DEVICE_TREE="hailo15l-sbc-nand"
CONFIG_SPI_FLASH_ISSI=y
CONFIG_SPL_LOAD_FIT_ADDRESS=0x70080000
CONFIG_DM_ETH_PHY=y
CONFIG_PHY_MSCC=y
CONFIG_RGMII=y
CONFIG_DM_MDIO=y
CONFIG_USE_PREBOOT=y
CONFIG_PREBOOT="i2c dev 1; i2c mw 0x43 0x00 0x56 1"
```
