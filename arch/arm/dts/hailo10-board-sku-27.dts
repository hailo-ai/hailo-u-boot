// SPDX-License-Identifier: GPL-2.0
/*
 * dts file for Hailo10 (board-sku-27).
 *
 * Copyright (c) 2019-2025 Hailo Technologies Ltd. All rights reserved.
 */
#include "hailo10-m2-base.dtsi"
/* TODO: Add RS2G32LV4D4BDT LP4X DDR configuration include when available */
