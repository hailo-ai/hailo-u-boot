// SPDX-License-Identifier: GPL-2.0
/*
 * dts file for Hailo12L Veloce SoC
 *
 * Copyright (c) 2019-2024 Hailo Technologies Ltd. All rights reserved.
 */

#include "hailo12l-base.dtsi"
#include "hailo15_ddr_configuration.dtsi"
#include "hailo1x_ddr_MT53E512M32D1-046_regconfig_2GB_LP4.dtsi" // 2GB ddr

&hailo_boot_info {
    ddr_config {
        bist_enable = <0>;
    };
};
