// SPDX-License-Identifier: GPL-2.0
/*
 * dts file for Hailo10 (board-sku-21).
 *
 * Copyright (c) 2019-2025 Hailo Technologies Ltd. All rights reserved.
 */
#include "hailo10-m2-base.dtsi"
#include "hailo1x_ddr_MT53E1G32D2FW-046-C_regconfig_4GB_LP4X.dtsi"
