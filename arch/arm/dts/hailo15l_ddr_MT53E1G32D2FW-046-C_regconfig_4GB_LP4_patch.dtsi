// SPDX-License-Identifier: GPL-2.0
/*
 * dts file for Hailo15 SoC
 *
 * Copyright (c) 2019-2023 Hailo Technologies Ltd. All rights reserved.
 */

&hailo_boot_info {
    ddr_config {
        ddr_patches {
            MT53E1G32D2FW-046-C_regconfig_4GB_LP4 {
                mr0 = <0xb9>;
                mr5 = <0xff>;
                mr6 = <0x7>;
                mr8 = <0x18>;
                mr12 = <0x4d>;
                num_of_ranks = <1>;
                DDR_ctrl_registers = <
                    21 0x01010000     //   21: ODT_VALUE:RW:24:1:=0x01 NO_MRW_INIT:RW:16:1:=0x00 DFI_INV_DATA_CS:RW:8:1:=0x00 MRR_ERROR_STATUS:RD:0:1:=0x00
                    22 0x01011001     //   22: DFIBUS_FREQ_INIT:RW:24:2:=0x02 PHY_INDEP_INIT_MODE:RW:16:1:=0x00 TSREF2PHYMSTR:RW:8:6:=0x10 PHY_INDEP_TRAIN_MODE:RW:0:1:=0x01
                    138 0x000E0A09    //  138: LPI_WAKEUP_EN:RW:24:6:=0x2f LPI_TIMER_WAKEUP_F2:RW:16:4:=0x0e LPI_SRPD_LONG_MCCLK_GATE_WAKEUP_F2:RW:8:4:=0x0a LPI_SRPD_LONG_WAKEUP_F2:RW:0:4:=0x09
                    147 0x08080000    //  147: PCPCS_PD_EXIT_DEPTH:RW:24:6:=0x08 PCPCS_PD_ENTER_DEPTH:RW:16:6:=0x08 PCPCS_PD_EN:RW:8:1:=0x01 LPC_SR_ZQ_EN:RW:0:1:=0x00
                    177 0x36000000    //  177: MR11_DATA_F1_0:RW:24:8:=0x00 MR11_DATA_F0_0:RW:16:8:=0x00 MR8_DATA_0:RD:8:8:=0x00 MR4_DATA_F2_0:RW:0:8:=0x00
                    178 0x10102B66    //  178: MR12_DATA_F2_0:RW:24:8:=0x00 MR12_DATA_F1_0:RW:16:8:=0x00 MR12_DATA_F0_0:RW:8:8:=0x00 MR11_DATA_F2_0:RW:0:8:=0x00
                    179 0x10102BC8    //  179: MR14_DATA_F2_0:RW:24:8:=0x00 MR14_DATA_F1_0:RW:16:8:=0x00 MR14_DATA_F0_0:RW:8:8:=0x00 MR13_DATA_0:RW:0:8:=0x00
                    185 0x2B663600    //  185: MR12_DATA_F0_1:RW:24:8:=0x00 MR11_DATA_F2_1:RW:16:8:=0x00 MR11_DATA_F1_1:RW:8:8:=0x00 MR11_DATA_F0_1:RW:0:8:=0x00
                    186 0x2BC81010    //  186: MR14_DATA_F0_1:RW:24:8:=0x00 MR13_DATA_1:RW:16:8:=0x00 MR12_DATA_F2_1:RW:8:8:=0x00 MR12_DATA_F1_1:RW:0:8:=0x00
                    187 0x00001010    //  187: MR17_DATA_1:RW:24:8:=0x00 MR16_DATA_1:RW:16:8:=0x00 MR14_DATA_F2_1:RW:8:8:=0x00 MR14_DATA_F1_1:RW:0:8:=0x00
                    190 0x01000000    //  190: FSP_PHY_UPDATE_MRW:RW:24:1:=0x00 RESERVED:RD:16:1:=0x00 RESERVED:RD:8:1:=0x00 RL3_SUPPORT_EN:RD:0:2:=0x00
                    191 0x01010001    //  191: FSP_WR_CURRENT:RW+:24:1:=0x00 FSP_OP_CURRENT:RW+:16:1:=0x00 FSP_STATUS:RW:8:1:=0x00 DFS_ALWAYS_WRITE_FSP:RW:0:1:=0x01
                    274 0x00001FFF    //  274: ROW_START_VAL_0:RW:16:3:=0x00 CS_VAL_UPPER_0:RW:0:16:=0x1fff
                    276 0x01FF0000    //  276: CS_MSK_0:RW:16:16:=0x03ff CS_MAP_NON_POW2:RW:8:2:=0x00 ROW_START_VAL_1:RW:0:3:=0x00
                    278 0x25250B00    //  278: COMMAND_AGE_COUNT:RW:24:8:=0xff AGE_COUNT:RW:16:8:=0xff APREBIT:RW_D:8:5:=0x0b RESERVED:RW:0:1:=0x00
                    281 0x01180001    //  281: SWAP_EN:RW:24:1:=0x01 NUM_Q_ENTRIES_ACT_DISABLE:RW:16:5:=0x18 DISABLE_RW_GROUP_W_BNK_CONFLICT:RW:8:2:=0x01 W2R_SPLIT_EN:RW:0:1:=0x01
                    282 0x00010000    //  282: REDUC:RW:24:1:=0x00 CS_MAP:RW:16:2:=0x03 INHIBIT_DRAM_CMD:RW:8:2:=0x00 DISABLE_RD_INTERLEAVE:RW:0:1:=0x00
                    331 0x04000104    //  331: AXI0_R_PRIORITY:RW:24:3:=0x04 AXI0_FIXED_PORT_PRIORITY_ENABLE:RW:16:1:=0x00 AXI0_ALL_STROBES_USED_ENABLE:RW:8:1:=0x00 TDQSCK_MIN_F2:RW:0:3:=0x04
                    332 0x04000104    //  332: AXI1_R_PRIORITY:RW:24:3:=0x04 AXI1_FIXED_PORT_PRIORITY_ENABLE:RW:16:1:=0x00 AXI1_ALL_STROBES_USED_ENABLE:RW:8:1:=0x00 AXI0_W_PRIORITY:RW:0:3:=0x04
                    385 0x1E060001    //  385: NWR_F1:RW:24:8:=0x1e NWR_F0:RW:16:8:=0x06 AXI_PARITY_ERROR_STATUS:RD:8:2:=0x00 GLOBAL_ERROR_MASK:RW:0:8:=0x00
                >;

                DDR_PI_registers = <
                    29 0x05000000     //   29: PI_WRLVL_CS_MAP:RW:24:4:=0x0f PI_WRLVL_ROTATE:RW:16:1:=0x00 PI_WRLVL_RESP_MASK:RW:8:4:=0x00 PI_WRLVL_DISABLE_DFS:RW:0:1:=0x00
                    45 0x00050500     //   45: PI_RDLVL_GATE_CS_MAP:RW:16:4:=0x0f PI_RDLVL_CS_MAP:RW:8:4:=0x0f PI_RDLVL_GATE_ROTATE:RW:0:1:=0x00
                    55 0x05000000     //   55: PI_CALVL_CS_MAP:RW:24:4:=0x0f PI_CALVL_ROTATE:RW:16:1:=0x00 PI_CALVL_DISABLE_DFS:RW:8:1:=0x00 PI_CALVL_ON_SREF_EXIT:RW:0:1:=0x00
                    139 0x00000100    //  139: PI_DLL_RST_DELAY:RW:16:16:=0x0000 PI_DRAM_INIT_EN:RW:8:1:=0x00 PI_DLL_RST:RW:0:1:=0x00
                    199 0x1C082D29    //  199: PI_CALVL_VREF_INITIAL_STOP_POINT_F1:RW:24:7:=0x1e PI_CALVL_VREF_INITIAL_START_POINT_F1:RW:16:7:=0x1a PI_CALVL_VREF_INITIAL_STOP_POINT_F0:RW:8:7:=0x1e PI_CALVL_VREF_INITIAL_START_POINT_F0:RW:0:7:=0x1a
                    200 0x01011C08    //  200: PI_CALVL_VREF_DELTA_F1:RW:24:4:=0x01 PI_CALVL_VREF_DELTA_F0:RW:16:4:=0x01 PI_CALVL_VREF_INITIAL_STOP_POINT_F2:RW:8:7:=0x1e PI_CALVL_VREF_INITIAL_START_POINT_F2:RW:0:7:=0x1a
                    211 0x2D290056    //  211: PI_WDQLVL_VREF_INITIAL_STOP_POINT_F0:RW:24:7:=0x1e PI_WDQLVL_VREF_INITIAL_START_POINT_F0:RW:16:7:=0x1a PI_TDFI_WDQLVL_RW_F0:RW:0:10:=0x0056
                    214 0x01011C08    //  214: PI_WDQLVL_EN_F1:RW:24:2:=0x01 PI_WDQLVL_VREF_DELTA_F1:RW:16:4:=0x01 PI_WDQLVL_VREF_INITIAL_STOP_POINT_F1:RW:8:7:=0x1e PI_WDQLVL_VREF_INITIAL_START_POINT_F1:RW:0:7:=0x1a
                    216 0x1C08005B    //  216: PI_WDQLVL_VREF_INITIAL_STOP_POINT_F2:RW:24:7:=0x1e PI_WDQLVL_VREF_INITIAL_START_POINT_F2:RW:16:7:=0x1a PI_TDFI_WDQLVL_RW_F2:RW:0:10:=0x005b
                    276 0x00162B2B    //  276: PI_MR23_DATA_F0_0:RW:24:8:=0x00 PI_MR22_DATA_F0_0:RW+:16:8:=0x00 PI_MR14_DATA_F0_0:RW+:8:8:=0x4d PI_MR12_DATA_F0_0:RW+:0:8:=0x4d
                    277 0x66312D54    //  277: PI_MR11_DATA_F1_0:RW+:24:8:=0x00 PI_MR3_DATA_F1_0:RW+:16:8:=0x31 PI_MR2_DATA_F1_0:RW+:8:8:=0x2d PI_MR1_DATA_F1_0:RW+:0:8:=0x54
                    278 0x00161010    //  278: PI_MR23_DATA_F1_0:RW:24:8:=0x00 PI_MR22_DATA_F1_0:RW+:16:8:=0x00 PI_MR14_DATA_F1_0:RW+:8:8:=0x4d PI_MR12_DATA_F1_0:RW+:0:8:=0x4d
                    279 0x66313F74    //  279: PI_MR11_DATA_F2_0:RW+:24:8:=0x00 PI_MR3_DATA_F2_0:RW+:16:8:=0x31 PI_MR2_DATA_F2_0:RW+:8:8:=0x3f PI_MR1_DATA_F2_0:RW+:0:8:=0x74
                    280 0x00161010    //  280: PI_MR23_DATA_F2_0:RW:24:8:=0x00 PI_MR22_DATA_F2_0:RW+:16:8:=0x00 PI_MR14_DATA_F2_0:RW+:8:8:=0x4d PI_MR12_DATA_F2_0:RW+:0:8:=0x4d
                    282 0x00162B2B    //  282: PI_MR23_DATA_F0_1:RW:24:8:=0x00 PI_MR22_DATA_F0_1:RW+:16:8:=0x00 PI_MR14_DATA_F0_1:RW+:8:8:=0x4d PI_MR12_DATA_F0_1:RW+:0:8:=0x4d
                    283 0x36312D54    //  283: PI_MR11_DATA_F1_1:RW+:24:8:=0x00 PI_MR3_DATA_F1_1:RW+:16:8:=0x31 PI_MR2_DATA_F1_1:RW+:8:8:=0x2d PI_MR1_DATA_F1_1:RW+:0:8:=0x54
                    284 0x00161010    //  284: PI_MR23_DATA_F1_1:RW:24:8:=0x00 PI_MR22_DATA_F1_1:RW+:16:8:=0x00 PI_MR14_DATA_F1_1:RW+:8:8:=0x4d PI_MR12_DATA_F1_1:RW+:0:8:=0x4d
                    285 0x66313F74    //  285: PI_MR11_DATA_F2_1:RW+:24:8:=0x00 PI_MR3_DATA_F2_1:RW+:16:8:=0x31 PI_MR2_DATA_F2_1:RW+:8:8:=0x3f PI_MR1_DATA_F2_1:RW+:0:8:=0x74
                    286 0x00161010    //  286: PI_MR23_DATA_F2_1:RW:24:8:=0x00 PI_MR22_DATA_F2_1:RW+:16:8:=0x00 PI_MR14_DATA_F2_1:RW+:8:8:=0x4d PI_MR12_DATA_F2_1:RW+:0:8:=0x4d
                    288 0x00162B2B    //  288: PI_MR23_DATA_F0_2:RW:24:8:=0x00 PI_MR22_DATA_F0_2:RW+:16:8:=0x00 PI_MR14_DATA_F0_2:RW+:8:8:=0x4d PI_MR12_DATA_F0_2:RW+:0:8:=0x4d
                    289 0x36312D54    //  289: PI_MR11_DATA_F1_2:RW+:24:8:=0x00 PI_MR3_DATA_F1_2:RW+:16:8:=0x31 PI_MR2_DATA_F1_2:RW+:8:8:=0x2d PI_MR1_DATA_F1_2:RW+:0:8:=0x54
                    290 0x00161010    //  290: PI_MR23_DATA_F1_2:RW:24:8:=0x00 PI_MR22_DATA_F1_2:RW+:16:8:=0x00 PI_MR14_DATA_F1_2:RW+:8:8:=0x4d PI_MR12_DATA_F1_2:RW+:0:8:=0x4d
                    291 0x66313F74    //  291: PI_MR11_DATA_F2_2:RW+:24:8:=0x00 PI_MR3_DATA_F2_2:RW+:16:8:=0x31 PI_MR2_DATA_F2_2:RW+:8:8:=0x3f PI_MR1_DATA_F2_2:RW+:0:8:=0x74
                    292 0x00361010    //  292: PI_MR23_DATA_F2_2:RW:24:8:=0x00 PI_MR22_DATA_F2_2:RW+:16:8:=0x00 PI_MR14_DATA_F2_2:RW+:8:8:=0x4d PI_MR12_DATA_F2_2:RW+:0:8:=0x4d
                    294 0x00162B2B    //  294: PI_MR23_DATA_F0_3:RW:24:8:=0x00 PI_MR22_DATA_F0_3:RW+:16:8:=0x00 PI_MR14_DATA_F0_3:RW+:8:8:=0x4d PI_MR12_DATA_F0_3:RW+:0:8:=0x4d
                    295 0x36312D54    //  295: PI_MR11_DATA_F1_3:RW+:24:8:=0x00 PI_MR3_DATA_F1_3:RW+:16:8:=0x31 PI_MR2_DATA_F1_3:RW+:8:8:=0x2d PI_MR1_DATA_F1_3:RW+:0:8:=0x54
                    296 0x00161010    //  296: PI_MR23_DATA_F1_3:RW:24:8:=0x00 PI_MR22_DATA_F1_3:RW+:16:8:=0x00 PI_MR14_DATA_F1_3:RW+:8:8:=0x4d PI_MR12_DATA_F1_3:RW+:0:8:=0x4d
                    297 0x66313F74    //  297: PI_MR11_DATA_F2_3:RW+:24:8:=0x00 PI_MR3_DATA_F2_3:RW+:16:8:=0x31 PI_MR2_DATA_F2_3:RW+:8:8:=0x3f PI_MR1_DATA_F2_3:RW+:0:8:=0x74
                    298 0x00161010    //  298: PI_MR23_DATA_F2_3:RW:24:8:=0x00 PI_MR22_DATA_F2_3:RW+:16:8:=0x00 PI_MR14_DATA_F2_3:RW+:8:8:=0x4d PI_MR12_DATA_F2_3:RW+:0:8:=0x4d
                >;

                DDR_PHY_registers = <
                    5 0x01010000       //    5: PHY_PER_CS_TRAINING_MULTICAST_EN_0:RW_D:24:1:=0x01 PHY_PER_RANK_CS_MAP_0:RW+:16:2:=0x03 PHY_SW_WRDQS_SHIFT_0:RW:8:4:=0x00 PHY_SW_WRDM_SHIFT_0:RW:0:6:=0x00
                    84 0x018C0C01      //   84: PHY_DQS_TSEL_ENABLE_0:RW+:24:3:=0x01 PHY_DQ_TSEL_SELECT_0:RW+:8:16:=0x4408 PHY_DQ_TSEL_ENABLE_0:RW+:0:3:=0x01
                    85 0x1E038C0C      //   85: PHY_VREF_INITIAL_START_POINT_0:RW+:24:7:=0x20 PHY_TWO_CYC_PREAMBLE_0:RW+:16:2:=0x03 PHY_DQS_TSEL_SELECT_0:RW+:0:16:=0x4408
                    86 0x20000132      //   86: PHY_NTP_WDQ_STEP_SIZE_0:RW+:24:8:=0x20 PHY_NTP_TRAIN_EN_0:RW+:16:1:=0x00 PHY_VREF_TRAINING_CTRL_0:RW+:8:2:=0x01 PHY_VREF_INITIAL_STOP_POINT_0:RW+:0:7:=0x25
                    114 0x62534071     //  114: PHY_DQ_DM_SWIZZLE0_0:RW+:0:32:=0x76543210
                    261 0x01010000     //  261: PHY_PER_CS_TRAINING_MULTICAST_EN_1:RW_D:24:1:=0x01 PHY_PER_RANK_CS_MAP_1:RW+:16:2:=0x03 PHY_SW_WRDQS_SHIFT_1:RW:8:4:=0x00 PHY_SW_WRDM_SHIFT_1:RW:0:6:=0x00
                    340 0x018C0C01     //  340: PHY_DQS_TSEL_ENABLE_1:RW+:24:3:=0x01 PHY_DQ_TSEL_SELECT_1:RW+:8:16:=0x4408 PHY_DQ_TSEL_ENABLE_1:RW+:0:3:=0x01
                    341 0x1E038C0C     //  341: PHY_VREF_INITIAL_START_POINT_1:RW+:24:7:=0x20 PHY_TWO_CYC_PREAMBLE_1:RW+:16:2:=0x03 PHY_DQS_TSEL_SELECT_1:RW+:0:16:=0x4408
                    342 0x20000132     //  342: PHY_NTP_WDQ_STEP_SIZE_1:RW+:24:8:=0x20 PHY_NTP_TRAIN_EN_1:RW+:16:1:=0x00 PHY_VREF_TRAINING_CTRL_1:RW+:8:2:=0x01 PHY_VREF_INITIAL_STOP_POINT_1:RW+:0:7:=0x25
                    370 0x25104763     //  370: PHY_DQ_DM_SWIZZLE0_1:RW+:0:32:=0x76543210
                    517 0x01010000     //  517: PHY_PER_CS_TRAINING_MULTICAST_EN_2:RW_D:24:1:=0x01 PHY_PER_RANK_CS_MAP_2:RW+:16:2:=0x03 PHY_SW_WRDQS_SHIFT_2:RW:8:4:=0x00 PHY_SW_WRDM_SHIFT_2:RW:0:6:=0x00
                    596 0x018C0C01     //  596: PHY_DQS_TSEL_ENABLE_2:RW+:24:3:=0x01 PHY_DQ_TSEL_SELECT_2:RW+:8:16:=0x4408 PHY_DQ_TSEL_ENABLE_2:RW+:0:3:=0x01
                    597 0x1E038C0C     //  597: PHY_VREF_INITIAL_START_POINT_2:RW+:24:7:=0x20 PHY_TWO_CYC_PREAMBLE_2:RW+:16:2:=0x03 PHY_DQS_TSEL_SELECT_2:RW+:0:16:=0x4408
                    598 0x20000132     //  598: PHY_NTP_WDQ_STEP_SIZE_2:RW+:24:8:=0x20 PHY_NTP_TRAIN_EN_2:RW+:16:1:=0x00 PHY_VREF_TRAINING_CTRL_2:RW+:8:2:=0x01 PHY_VREF_INITIAL_STOP_POINT_2:RW+:0:7:=0x25
                    626 0x67305142     //  626: PHY_DQ_DM_SWIZZLE0_2:RW+:0:32:=0x76543210
                    773 0x01010000     //  773: PHY_PER_CS_TRAINING_MULTICAST_EN_3:RW_D:24:1:=0x01 PHY_PER_RANK_CS_MAP_3:RW+:16:2:=0x03 PHY_SW_WRDQS_SHIFT_3:RW:8:4:=0x00 PHY_SW_WRDM_SHIFT_3:RW:0:6:=0x00
                    852 0x018C0C01     //  852: PHY_DQS_TSEL_ENABLE_3:RW+:24:3:=0x01 PHY_DQ_TSEL_SELECT_3:RW+:8:16:=0x4408 PHY_DQ_TSEL_ENABLE_3:RW+:0:3:=0x01
                    853 0x1E038C0C     //  853: PHY_VREF_INITIAL_START_POINT_3:RW+:24:7:=0x20 PHY_TWO_CYC_PREAMBLE_3:RW+:16:2:=0x03 PHY_DQS_TSEL_SELECT_3:RW+:0:16:=0x4408
                    854 0x20000132     //  854: PHY_NTP_WDQ_STEP_SIZE_3:RW+:24:8:=0x20 PHY_NTP_TRAIN_EN_3:RW+:16:1:=0x00 PHY_VREF_TRAINING_CTRL_3:RW+:8:2:=0x01 PHY_VREF_INITIAL_STOP_POINT_3:RW+:0:7:=0x25
                    882 0x67431052     //  882: PHY_DQ_DM_SWIZZLE0_3:RW+:0:32:=0x76543210
                    1064 0x000604CC    // 1064: PHY_PAD_ADR_IO_CFG_0:RW+:16:11:=0x0000 PHY_ADR_DC_CAL_CLK_SEL_0:RW+:8:3:=0x02 PHY_ADR_TSEL_SELECT_0:RW+:0:8:=0x44
                    1408 0x0C600DFA    // 1408: PHY_PAD_DATA_DRIVE:RW+:0:31:=0x00000180
                    1409 0x30006DFA    // 1409: PHY_PAD_DQS_DRIVE:RW+:0:32:=0x00000180
                    1410 0x300DFA71    // 1410: PHY_PAD_ADDR_DRIVE:RW+:0:30:=0x00018011
                    1416 0x300DFA71    // 1416: PHY_PAD_RST_DRIVE:RW+:0:30:=0x00018011
                    1418 0x300DFA71    // 1418: PHY_PAD_CS_DRIVE:RW+:0:30:=0x00018011
                >;

            };
        };
    };
};
