// SPDX-License-Identifier: GPL-2.0
/*
 * dts file for Hailo15 SoC
 *
 * Copyright (c) 2019-2023 Hailo Technologies Ltd. All rights reserved.
 *
 * BIWIN BWMEDX32H2A-32Gb-X LPDDR4X 4GB regconfig.
 * Based on the proven MT53E1G32D2FW-046-C 4GB LP4X regconfig (same JEDEC
 * topology: 4GB, 4266Mb/s, 32Gb single rank, 16Gb x16 per channel, VDDQ=0.6V).
 * MR identification values updated to BIWIN datasheet
 * (DAT-CES-0109-A, Ver.1.0, July 2023, Table 2 Mode Register Definition):
 *   - mr5 (Manufacturer ID) = 0xFF  (1111 1111b)
 *   - mr6 (Revision ID1)    = 0x06  (0000 0110b)
 */

&hailo_boot_info {
    ddr_config {
        ddr_patches {
            BWMEDX32H2A_regconfig_4GB_LP4X {
                reg_config_version = "2.5";
                mr0 = <0xb8>;
                mr5 = <0xff>;
                mr6 = <0x6>;
                mr8 = <0x18>;
                mr12 = <0x5d>;
                num_of_ranks = <1>;
                DDR_ctrl_registers = <
                    68 0x01300010    //  68: TRFC_PB_F1:RW:16:10:=0x0130 TREFI_PB_F0:RW:0:16:=0x0010   (16Gb/ch tRFCpb=190ns @ F1)
                    69 0x01960304    //  69: TRFC_PB_F2:RW:16:10:=0x0196 TREFI_PB_F1:RW:0:16:=0x0304   (16Gb/ch tRFCpb=190ns @ F2)
                    178 0x14143236    //  178: MR12_DATA_F2_0:RW:24:8:=0x00 MR12_DATA_F1_0:RW:16:8:=0x00 MR12_DATA_F0_0:RW:8:8:=0x00 MR11_DATA_F2_0:RW:0:8:=0x00
                    179 0x161632C8    //  179: MR14_DATA_F2_0:RW:24:8:=0x00 MR14_DATA_F1_0:RW:16:8:=0x00 MR14_DATA_F0_0:RW:8:8:=0x00 MR13_DATA_0:RW:0:8:=0x00
                    185 0x32363600    //  185: MR12_DATA_F0_1:RW:24:8:=0x00 MR11_DATA_F2_1:RW:16:8:=0x00 MR11_DATA_F1_1:RW:8:8:=0x00 MR11_DATA_F0_1:RW:0:8:=0x00
                    186 0x32C81414    //  186: MR14_DATA_F0_1:RW:24:8:=0x00 MR13_DATA_1:RW:16:8:=0x00 MR12_DATA_F2_1:RW:8:8:=0x00 MR12_DATA_F1_1:RW:0:8:=0x00
                    187 0x00001616    //  187: MR17_DATA_1:RW:24:8:=0x00 MR16_DATA_1:RW:16:8:=0x00 MR14_DATA_F2_1:RW:8:8:=0x00 MR14_DATA_F1_1:RW:0:8:=0x00
                    188 0x2E2E2E00    //  188: MR22_DATA_F2_1:RW:24:8:=0x00 MR22_DATA_F1_1:RW:16:8:=0x00 MR22_DATA_F0_1:RW:8:8:=0x00 MR20_DATA_1:RD:0:8:=0x00
                    282 0x00010000    //  282: REDUC:RW:24:1:=0x00 CS_MAP:RW:16:2:=0x03 INHIBIT_DRAM_CMD:RW:8:2:=0x00 DISABLE_RD_INTERLEAVE:RW:0:1:=0x00
                >;

                DDR_PI_registers = <
                    199 0x1810322E    //  199: PI_CALVL_VREF_INITIAL_STOP_POINT_F1:RW:24:7:=0x1e PI_CALVL_VREF_INITIAL_START_POINT_F1:RW:16:7:=0x1a PI_CALVL_VREF_INITIAL_STOP_POINT_F0:RW:8:7:=0x1e PI_CALVL_VREF_INITIAL_START_POINT_F0:RW:0:7:=0x1a
                    200 0x01011810    //  200: PI_CALVL_VREF_DELTA_F1:RW:24:4:=0x01 PI_CALVL_VREF_DELTA_F0:RW:16:4:=0x01 PI_CALVL_VREF_INITIAL_STOP_POINT_F2:RW:8:7:=0x1e PI_CALVL_VREF_INITIAL_START_POINT_F2:RW:0:7:=0x1a
                    211 0x322E0056    //  211: PI_WDQLVL_VREF_INITIAL_STOP_POINT_F0:RW:24:7:=0x1e PI_WDQLVL_VREF_INITIAL_START_POINT_F0:RW:16:7:=0x1a PI_TDFI_WDQLVL_RW_F0:RW:0:10:=0x0056
                    214 0x01011A12    //  214: PI_WDQLVL_EN_F1:RW:24:2:=0x01 PI_WDQLVL_VREF_DELTA_F1:RW:16:4:=0x01 PI_WDQLVL_VREF_INITIAL_STOP_POINT_F1:RW:8:7:=0x1e PI_WDQLVL_VREF_INITIAL_START_POINT_F1:RW:0:7:=0x1a
                    216 0x1A12005B    //  216: PI_WDQLVL_VREF_INITIAL_STOP_POINT_F2:RW:24:7:=0x1e PI_WDQLVL_VREF_INITIAL_START_POINT_F2:RW:16:7:=0x1a PI_TDFI_WDQLVL_RW_F2:RW:0:10:=0x005b
                    276 0x00063232    //  276: PI_MR23_DATA_F0_0:RW:24:8:=0x00 PI_MR22_DATA_F0_0:RW+:16:8:=0x00 PI_MR14_DATA_F0_0:RW+:8:8:=0x4d PI_MR12_DATA_F0_0:RW+:0:8:=0x4d
                    278 0x00061614    //  278: PI_MR23_DATA_F1_0:RW:24:8:=0x00 PI_MR22_DATA_F1_0:RW+:16:8:=0x00 PI_MR14_DATA_F1_0:RW+:8:8:=0x4d PI_MR12_DATA_F1_0:RW+:0:8:=0x4d
                    280 0x00061614    //  280: PI_MR23_DATA_F2_0:RW:24:8:=0x00 PI_MR22_DATA_F2_0:RW+:16:8:=0x00 PI_MR14_DATA_F2_0:RW+:8:8:=0x4d PI_MR12_DATA_F2_0:RW+:0:8:=0x4d
                    282 0x002E3232    //  282: PI_MR23_DATA_F0_1:RW:24:8:=0x00 PI_MR22_DATA_F0_1:RW+:16:8:=0x00 PI_MR14_DATA_F0_1:RW+:8:8:=0x4d PI_MR12_DATA_F0_1:RW+:0:8:=0x4d
                    284 0x002E1614    //  284: PI_MR23_DATA_F1_1:RW:24:8:=0x00 PI_MR22_DATA_F1_1:RW+:16:8:=0x00 PI_MR14_DATA_F1_1:RW+:8:8:=0x4d PI_MR12_DATA_F1_1:RW+:0:8:=0x4d
                    286 0x002E1614    //  286: PI_MR23_DATA_F2_1:RW:24:8:=0x00 PI_MR22_DATA_F2_1:RW+:16:8:=0x00 PI_MR14_DATA_F2_1:RW+:8:8:=0x4d PI_MR12_DATA_F2_1:RW+:0:8:=0x4d
                    288 0x00063232    //  288: PI_MR23_DATA_F0_2:RW:24:8:=0x00 PI_MR22_DATA_F0_2:RW+:16:8:=0x00 PI_MR14_DATA_F0_2:RW+:8:8:=0x4d PI_MR12_DATA_F0_2:RW+:0:8:=0x4d
                    290 0x00061614    //  290: PI_MR23_DATA_F1_2:RW:24:8:=0x00 PI_MR22_DATA_F1_2:RW+:16:8:=0x00 PI_MR14_DATA_F1_2:RW+:8:8:=0x4d PI_MR12_DATA_F1_2:RW+:0:8:=0x4d
                    292 0x00061614    //  292: PI_MR23_DATA_F2_2:RW:24:8:=0x00 PI_MR22_DATA_F2_2:RW+:16:8:=0x00 PI_MR14_DATA_F2_2:RW+:8:8:=0x4d PI_MR12_DATA_F2_2:RW+:0:8:=0x4d
                    294 0x002E3232    //  294: PI_MR23_DATA_F0_3:RW:24:8:=0x00 PI_MR22_DATA_F0_3:RW+:16:8:=0x00 PI_MR14_DATA_F0_3:RW+:8:8:=0x4d PI_MR12_DATA_F0_3:RW+:0:8:=0x4d
                    296 0x002E1614    //  296: PI_MR23_DATA_F1_3:RW:24:8:=0x00 PI_MR22_DATA_F1_3:RW+:16:8:=0x00 PI_MR14_DATA_F1_3:RW+:8:8:=0x4d PI_MR12_DATA_F1_3:RW+:0:8:=0x4d
                    298 0x002E1614    //  298: PI_MR23_DATA_F2_3:RW:24:8:=0x00 PI_MR22_DATA_F2_3:RW+:16:8:=0x00 PI_MR14_DATA_F2_3:RW+:8:8:=0x4d PI_MR12_DATA_F2_3:RW+:0:8:=0x4d
                >;

                DDR_PHY_registers = <
                    84 0x01CC0C01    //  84: PHY_DQS_TSEL_ENABLE_0:RW+:24:3:=0x01 PHY_DQ_TSEL_SELECT_0:RW+:8:16:=0x4408 PHY_DQ_TSEL_ENABLE_0:RW+:0:3:=0x01
                    85 0x2E03CC0C    //  85: PHY_VREF_INITIAL_START_POINT_0:RW+:24:7:=0x20 PHY_TWO_CYC_PREAMBLE_0:RW+:16:2:=0x03 PHY_DQS_TSEL_SELECT_0:RW+:0:16:=0x4408
                    86 0x20000136    //  86: PHY_NTP_WDQ_STEP_SIZE_0:RW+:24:8:=0x20 PHY_NTP_TRAIN_EN_0:RW+:16:1:=0x00 PHY_VREF_TRAINING_CTRL_0:RW+:8:2:=0x01 PHY_VREF_INITIAL_STOP_POINT_0:RW+:0:7:=0x25
                    100 0x09B000A0    //  100: PHY_PAD_VREF_CTRL_DQ_0:RW+:16:12:=0x069f PHY_VREF_SETTING_TIME_0:RW+:0:16:=0x0004
                    138 0x01012020    //  138: PHY_DSLICE_PAD_BOOSTPN_SETTING_0:RW+:16:16:=0x0000 PHY_DATA_DC_DM_CLK_ADJUST_0:RW+:8:8:=0x20 PHY_DATA_DC_DQ7_CLK_ADJUST_0:RW+:0:8:=0x20
                    139 0x00000003    //  139: PHY_DQS_FFE_0:RW+:16:2:=0x00 PHY_DQ_FFE_0:RW+:8:2:=0x00 PHY_DSLICE_PAD_RX_CTLE_SETTING_0:RW+:0:6:=0x03   (BIWIN tune: slice0 RX CTLE=3)
                    340 0x01CC0C01    //  340: PHY_DQS_TSEL_ENABLE_1:RW+:24:3:=0x01 PHY_DQ_TSEL_SELECT_1:RW+:8:16:=0x4408 PHY_DQ_TSEL_ENABLE_1:RW+:0:3:=0x01
                    341 0x2E03CC0C    //  341: PHY_VREF_INITIAL_START_POINT_1:RW+:24:7:=0x20 PHY_TWO_CYC_PREAMBLE_1:RW+:16:2:=0x03 PHY_DQS_TSEL_SELECT_1:RW+:0:16:=0x4408
                    342 0x20000136    //  342: PHY_NTP_WDQ_STEP_SIZE_1:RW+:24:8:=0x20 PHY_NTP_TRAIN_EN_1:RW+:16:1:=0x00 PHY_VREF_TRAINING_CTRL_1:RW+:8:2:=0x01 PHY_VREF_INITIAL_STOP_POINT_1:RW+:0:7:=0x25
                    356 0x09B000A0    //  356: PHY_PAD_VREF_CTRL_DQ_1:RW+:16:12:=0x069f PHY_VREF_SETTING_TIME_1:RW+:0:16:=0x0004
                    394 0x01012020    //  394: PHY_DSLICE_PAD_BOOSTPN_SETTING_1:RW+:16:16:=0x0000 PHY_DATA_DC_DM_CLK_ADJUST_1:RW+:8:8:=0x20 PHY_DATA_DC_DQ7_CLK_ADJUST_1:RW+:0:8:=0x20
                    395 0x00000003    //  395: PHY_DQS_FFE_1:RW+:16:2:=0x00 PHY_DQ_FFE_1:RW+:8:2:=0x00 PHY_DSLICE_PAD_RX_CTLE_SETTING_1:RW+:0:6:=0x03   (BIWIN tune: slice1 RX CTLE=3)
                    596 0x01CC0C01    //  596: PHY_DQS_TSEL_ENABLE_2:RW+:24:3:=0x01 PHY_DQ_TSEL_SELECT_2:RW+:8:16:=0x4408 PHY_DQ_TSEL_ENABLE_2:RW+:0:3:=0x01
                    597 0x2E03CC0C    //  597: PHY_VREF_INITIAL_START_POINT_2:RW+:24:7:=0x20 PHY_TWO_CYC_PREAMBLE_2:RW+:16:2:=0x03 PHY_DQS_TSEL_SELECT_2:RW+:0:16:=0x4408
                    598 0x20000136    //  598: PHY_NTP_WDQ_STEP_SIZE_2:RW+:24:8:=0x20 PHY_NTP_TRAIN_EN_2:RW+:16:1:=0x00 PHY_VREF_TRAINING_CTRL_2:RW+:8:2:=0x01 PHY_VREF_INITIAL_STOP_POINT_2:RW+:0:7:=0x25
                    612 0x09B000A0    //  612: PHY_PAD_VREF_CTRL_DQ_2:RW+:16:12:=0x069f PHY_VREF_SETTING_TIME_2:RW+:0:16:=0x0004
                    650 0x01012020    //  650: PHY_DSLICE_PAD_BOOSTPN_SETTING_2:RW+:16:16:=0x0000 PHY_DATA_DC_DM_CLK_ADJUST_2:RW+:8:8:=0x20 PHY_DATA_DC_DQ7_CLK_ADJUST_2:RW+:0:8:=0x20
                    651 0x00000000    //  651: PHY_DQS_FFE_2:RW+:16:2:=0x00 PHY_DQ_FFE_2:RW+:8:2:=0x00 PHY_DSLICE_PAD_RX_CTLE_SETTING_2:RW+:0:6:=0x00   (BIWIN tune: slice2 RX CTLE=0, fall eye collapses with CTLE>0)
                    852 0x01CC0C01    //  852: PHY_DQS_TSEL_ENABLE_3:RW+:24:3:=0x01 PHY_DQ_TSEL_SELECT_3:RW+:8:16:=0x4408 PHY_DQ_TSEL_ENABLE_3:RW+:0:3:=0x01
                    853 0x2E03CC0C    //  853: PHY_VREF_INITIAL_START_POINT_3:RW+:24:7:=0x20 PHY_TWO_CYC_PREAMBLE_3:RW+:16:2:=0x03 PHY_DQS_TSEL_SELECT_3:RW+:0:16:=0x4408
                    854 0x20000136    //  854: PHY_NTP_WDQ_STEP_SIZE_3:RW+:24:8:=0x20 PHY_NTP_TRAIN_EN_3:RW+:16:1:=0x00 PHY_VREF_TRAINING_CTRL_3:RW+:8:2:=0x01 PHY_VREF_INITIAL_STOP_POINT_3:RW+:0:7:=0x25
                    868 0x09B000A0    //  868: PHY_PAD_VREF_CTRL_DQ_3:RW+:16:12:=0x069f PHY_VREF_SETTING_TIME_3:RW+:0:16:=0x0004
                    906 0x01012020    //  906: PHY_DSLICE_PAD_BOOSTPN_SETTING_3:RW+:16:16:=0x0000 PHY_DATA_DC_DM_CLK_ADJUST_3:RW+:8:8:=0x20 PHY_DATA_DC_DQ7_CLK_ADJUST_3:RW+:0:8:=0x20
                    907 0x00000003    //  907: PHY_DQS_FFE_3:RW+:16:2:=0x00 PHY_DQ_FFE_3:RW+:8:2:=0x00 PHY_DSLICE_PAD_RX_CTLE_SETTING_3:RW+:0:6:=0x03   (BIWIN tune: slice3 RX CTLE=3)
                    1064 0x000604CC    //  1064: PHY_PAD_ADR_IO_CFG_0:RW+:16:11:=0x0000 PHY_ADR_DC_CAL_CLK_SEL_0:RW+:8:3:=0x02 PHY_ADR_TSEL_SELECT_0:RW+:0:8:=0x44
                    1330 0x00001294    //  1330: PHY_CAL_START_0:WR:24:1:=0x00 PHY_CAL_CLEAR_0:WR:16:1:=0x00 PHY_CAL_MODE_0:RW:0:13:=0x0064
                    1406 0x0184BF88    //  1406: PHY_PAD_FDBK_DRIVE:RW+:0:30:=0x00030044
                    1407 0x00030100    //  1407: PHY_PAD_FDBK_DRIVE2:RW+:0:18:=0x030008
                    1408 0x00000E7F    //  1408: PHY_PAD_DATA_DRIVE:RW+:0:31:=0x00000180
                    1409 0x00000E7F    //  1409: PHY_PAD_DQS_DRIVE:RW+:0:32:=0x00000180
                    1410 0x001E7F11    //  1410: PHY_PAD_ADDR_DRIVE:RW+:0:30:=0x00018011
                    1411 0x01990000    //  1411: PHY_PAD_ADDR_DRIVE2:RW+:0:27:=0x0089ff00
                    1412 0x008E7FCC    //  1412: PHY_PAD_CLK_DRIVE:RW+:0:32:=0x00018044
                    1414 0x001E7F11    //  1414: PHY_PAD_CKE_DRIVE:RW+:0:30:=0x00018011
                    1415 0x01990000    //  1415: PHY_PAD_CKE_DRIVE2:RW+:0:27:=0x0089ff00
                    1416 0x001E7F11    //  1416: PHY_PAD_RST_DRIVE:RW+:0:30:=0x00018011
                    1417 0x01990000    //  1417: PHY_PAD_RST_DRIVE2:RW+:0:27:=0x0089ff00
                    1418 0x001E7F11    //  1418: PHY_PAD_CS_DRIVE:RW+:0:30:=0x00018011
                >;

            };
        };
    };
};
