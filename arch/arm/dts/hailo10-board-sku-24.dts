// SPDX-License-Identifier: GPL-2.0
/*
 * dts file for Hailo10 (board-sku-24).
 *
 * Copyright (c) 2019-2025 Hailo Technologies Ltd. All rights reserved.
 */
#include "hailo10-m2-base.dtsi"
#include "hailo1x_ddr_H9HCNNNBKUMLXR_NEE_regconfig_2GB_LP4.dtsi"
