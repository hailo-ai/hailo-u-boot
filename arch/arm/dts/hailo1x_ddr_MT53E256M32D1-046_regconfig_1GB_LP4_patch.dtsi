// SPDX-License-Identifier: GPL-2.0
/*
 * dts file for Hailo15 SoC
 *
 * Copyright (c) 2019-2023 Hailo Technologies Ltd. All rights reserved.
 */

&hailo_boot_info {
    ddr_config {
        ddr_patches {
            MT53E256M32D1-046_regconfig_1GB_LP4 {
                reg_config_version = "2.5";
                mr0 = <0xb9>;
                mr5 = <0xff>;
                mr6 = <0x7>;
                mr8 = <0x8>;
                mr12 = <0x4d>;
                num_of_ranks = <1>;
                DDR_ctrl_registers = <
                    37 0x12481040    //  37: WRLAT_F2:RW:24:7:=0x12 CASLAT_LIN_F2:RW:16:7:=0x48 WRLAT_F1:RW:8:7:=0x0e CASLAT_LIN_F1:RW:0:7:=0x38
                    40 0x11000203    //  40: TRRD_F1:RW:24:8:=0x0d TFAW_F0:RW:8:9:=0x0002 TRP_F0:RW:0:8:=0x03
                    42 0x1600311D    //  42: TRRD_F2:RW:24:8:=0x11 TFAW_F1:RW:8:9:=0x0031 TRP_F1:RW:0:8:=0x1d
                    60 0x00000009    //  60: TRFC_F0:RW:0:10:=0x0013
                    62 0x00000120    //  62: TRFC_F1:RW:0:10:=0x0260
                    64 0x00000180    //  64: TRFC_F2:RW:0:10:=0x032b
                    67 0x00020000    //  67: TRFC_PB_F0:RW:16:10:=0x0005 PBR_NUMERIC_ORDER:RW:8:1:=0x00 PBR_EN:RW:0:1:=0x00
                    68 0x00480010    //  68: TRFC_PB_F1:RW:16:10:=0x0098 TREFI_PB_F0:RW:0:16:=0x0010
                    69 0x00600304    //  69: TRFC_PB_F2:RW:16:10:=0x00cb TREFI_PB_F1:RW:0:16:=0x0304
                    79 0x000A000A    //  79: TXSNR_F0:RW:16:16:=0x0014 TXSR_F0:RW:0:16:=0x0014
                    80 0x012C012C    //  80: TXSNR_F1:RW:16:16:=0x026c TXSR_F1:RW:0:16:=0x026c
                    81 0x01900190    //  81: TXSNR_F2:RW:16:16:=0x033b TXSR_F2:RW:0:16:=0x033b
                    174 0x36640004    //  174: MR2_DATA_F1_0:RW:24:8:=0x2d MR1_DATA_F1_0:RW:16:8:=0x54 MR2_DATA_F0_0:RW:8:8:=0x00 MR1_DATA_F0_0:RW:0:8:=0x04
                    182 0x3F743664    //  182: MR2_DATA_F2_1:RW:24:8:=0x3f MR1_DATA_F2_1:RW:16:8:=0x74 MR2_DATA_F1_1:RW:8:8:=0x2d MR1_DATA_F1_1:RW:0:8:=0x54
                    272 0x02020000    //  272: ROW_DIFF_1:RW:24:3:=0x00 ROW_DIFF_0:RW:16:3:=0x00 BANK_DIFF_1:RW:8:2:=0x00 BANK_DIFF_0:RW:0:2:=0x00
                    274 0x000007FF    //  274: ROW_START_VAL_0:RW:16:3:=0x00 CS_VAL_UPPER_0:RW:0:16:=0x1fff
                    276 0x00FF0000    //  276: CS_MSK_0:RW:16:16:=0x03ff CS_MAP_NON_POW2:RW:8:2:=0x00 ROW_START_VAL_1:RW:0:3:=0x00
                    282 0x00010000    //  282: REDUC:RW:24:1:=0x00 CS_MAP:RW:16:2:=0x03 INHIBIT_DRAM_CMD:RW:8:2:=0x00 DISABLE_RD_INTERLEAVE:RW:0:1:=0x00
                    323 0x050A0A03    //  323: RD_TO_ODTH_F0:RW:24:6:=0x05 WR_TO_ODTH_F2:RW:16:6:=0x0a WR_TO_ODTH_F1:RW:8:6:=0x08 WR_TO_ODTH_F0:RW:0:6:=0x03
                    324 0x0C081F1C    //  324: RW2MRW_DLY_F1:RW_D:24:5:=0x0c RW2MRW_DLY_F0:RW_D:16:5:=0x08 RD_TO_ODTH_F2:RW:8:6:=0x1f RD_TO_ODTH_F1:RW:0:6:=0x18
                    326 0x0A0C020E    //  326: W2R_DIFFCS_DLY_F1:RW_D:24:5:=0x0a R2W_DIFFCS_DLY_F1:RW_D:16:5:=0x0a R2R_DIFFCS_DLY_F1:RW_D:8:5:=0x02 W2W_DIFFCS_DLY_F0:RW_D:0:5:=0x0e
                    328 0x0C080007    //  328: R2W_SAMECS_DLY_F1:RW_D:24:5:=0x0a R2W_SAMECS_DLY_F0:RW_D:16:5:=0x08 R2R_SAMECS_DLY:RW:8:5:=0x00 W2W_DIFFCS_DLY_F2:RW_D:0:5:=0x07
                    365 0x00000C14    //  365: WRLAT_ADJ_F1:RW:8:7:=0x0a RDLAT_ADJ_F1:RW:0:7:=0x10
                    376 0x0B1E091A    //  376: TDFI_WRCSLAT_F2:RW:24:7:=0x0b TDFI_RDCSLAT_F2:RW:16:7:=0x1e TDFI_WRCSLAT_F1:RW:8:7:=0x07 TDFI_RDCSLAT_F1:RW:0:7:=0x16
                    385 0x22060001    //  385: NWR_F1:RW:24:8:=0x1e NWR_F0:RW:16:8:=0x06 AXI_PARITY_ERROR_STATUS:RD:8:2:=0x00 GLOBAL_ERROR_MASK:RW:0:8:=0x00
                >;

                DDR_PI_registers = <
                    73 0x00080200    //  73: RESERVED:RW_D:24:4:=0x00 PI_TCCD:RW:16:5:=0x08 PI_ROW_DIFF:RW:8:3:=0x00 PI_BANK_DIFF:RW:0:2:=0x00
                    165 0x0000005B    //  165: PI_TDELAY_RDWR_2_BUS_IDLE_F1:RW:0:8:=0x57
                    168 0x40100C04    //  168: PI_CASLAT_LIN_F1:RW:24:7:=0x38 PI_WRLAT_F1:RW:16:7:=0x0e PI_CASLAT_LIN_F0:RW:8:7:=0x0c PI_WRLAT_F0:RW:0:7:=0x04
                    169 0x00094812    //  169: PI_TRFC_F0:RW:16:10:=0x0013 PI_CASLAT_LIN_F2:RW:8:7:=0x48 PI_WRLAT_F2:RW:0:7:=0x12
                    171 0x00000120    //  171: PI_TRFC_F1:RW:0:10:=0x0260
                    173 0x00000180    //  173: PI_TRFC_F2:RW:0:10:=0x032b
                    185 0x14040300    //  185: PI_RDLAT_ADJ_F1:RW:24:7:=0x10 PI_RDLAT_ADJ_F0:RW:16:7:=0x04 PI_RDLVL_MULTI_EN_F2:RW:8:2:=0x00 PI_RDLVL_DFE_EN_F2:RW:0:2:=0x00
                    186 0x0E0C0215    //  186: PI_WRLAT_ADJ_F2:RW:24:7:=0x0e PI_WRLAT_ADJ_F1:RW:16:7:=0x0a PI_WRLAT_ADJ_F0:RW:8:7:=0x02 PI_RDLAT_ADJ_F2:RW:0:7:=0x15
                    213 0x005C002E    //  213: PI_TDFI_WDQLVL_RW_F1:RW:16:10:=0x005a PI_TDFI_WDQLVL_WR_F1:RW:0:10:=0x002c
                    235 0x012C000A    //  235: PI_TXSR_F1:RW:16:16:=0x026c PI_TXSR_F0:RW:0:16:=0x0014
                    236 0x03030190    //  236: PI_TEXCKE_F1:RW:24:6:=0x03 PI_TEXCKE_F0:RW:16:6:=0x03 PI_TXSR_F2:RW:0:16:=0x033b
                    241 0x0000000A    //  241: PI_TXSNR_F0:RW:0:16:=0x0014
                    246 0x0000012C    //  246: PI_TXSNR_F1:RW:0:16:=0x026c
                    251 0x01000190    //  251: RESERVED:RW:16:12:=0x0100 PI_TXSNR_F2:RW:0:16:=0x033b
                    277 0x36313664    //  277: PI_MR11_DATA_F1_0:RW+:24:8:=0x00 PI_MR3_DATA_F1_0:RW+:16:8:=0x31 PI_MR2_DATA_F1_0:RW+:8:8:=0x2d PI_MR1_DATA_F1_0:RW+:0:8:=0x54
                    283 0x36313664    //  283: PI_MR11_DATA_F1_1:RW+:24:8:=0x00 PI_MR3_DATA_F1_1:RW+:16:8:=0x31 PI_MR2_DATA_F1_1:RW+:8:8:=0x2d PI_MR1_DATA_F1_1:RW+:0:8:=0x54
                    289 0x36313664    //  289: PI_MR11_DATA_F1_2:RW+:24:8:=0x00 PI_MR3_DATA_F1_2:RW+:16:8:=0x31 PI_MR2_DATA_F1_2:RW+:8:8:=0x2d PI_MR1_DATA_F1_2:RW+:0:8:=0x54
                    295 0x36313664    //  295: PI_MR11_DATA_F1_3:RW+:24:8:=0x00 PI_MR3_DATA_F1_3:RW+:16:8:=0x31 PI_MR2_DATA_F1_3:RW+:8:8:=0x2d PI_MR1_DATA_F1_3:RW+:0:8:=0x54
                >;

                DDR_PHY_registers = <
                >;

            };
        };
    };
};
