// SPDX-License-Identifier: GPL-2.0
/*
 * dts file for Hailo15 SoC
 *
 * Copyright (c) 2019-2023 Hailo Technologies Ltd. All rights reserved.
 */

#include "hailo15-base.dtsi"

&sdio1 {
    status = "okay";
    bus-width = <8>;
};

&macb {
    status = "okay";
};