// SPDX-License-Identifier: GPL-2.0
/*
 * dts file for Hailo15 SoC
 *
 * Copyright (c) 2019-2023 Hailo Technologies Ltd. All rights reserved.
 */

&hailo_boot_info {
    ddr_config {
        ddr_patches {
            B3221PM3BDGVIW_regconfig_4GB_LP4 {
		reg_config_version = "2.4";
                mr0 = <0xb8>;
                mr5 = <0xff>;
                mr6 = <0x7>;
                mr8 = <0x18>;
                mr12 = <0x4d>;
                num_of_ranks = <1>;
                DDR_ctrl_registers = <
                    21 0x01010000    //  21: ODT_VALUE:RW:24:1:=0x01 NO_MRW_INIT:RW:16:1:=0x00 DFI_INV_DATA_CS:RW:8:1:=0x00 MRR_ERROR_STATUS:RD:0:1:=0x00
                    22 0x02011001    //  22: DFIBUS_FREQ_INIT:RW:24:2:=0x02 PHY_INDEP_INIT_MODE:RW:16:1:=0x00 TSREF2PHYMSTR:RW:8:6:=0x10 PHY_INDEP_TRAIN_MODE:RW:0:1:=0x01
                    37 0x12481040    //  37: WRLAT_F2:RW:24:7:=0x12 CASLAT_LIN_F2:RW:16:7:=0x48 WRLAT_F1:RW:8:7:=0x0e CASLAT_LIN_F1:RW:0:7:=0x38
                    138 0x000E0A09    //  138: LPI_WAKEUP_EN:RW:24:6:=0x2f LPI_TIMER_WAKEUP_F2:RW:16:4:=0x0e LPI_SRPD_LONG_MCCLK_GATE_WAKEUP_F2:RW:8:4:=0x0a LPI_SRPD_LONG_WAKEUP_F2:RW:0:4:=0x09
                    147 0x08080000    //  147: PCPCS_PD_EXIT_DEPTH:RW:24:6:=0x08 PCPCS_PD_ENTER_DEPTH:RW:16:6:=0x08 PCPCS_PD_EN:RW:8:1:=0x01 LPC_SR_ZQ_EN:RW:0:1:=0x00
                    174 0x36640004    //  174: MR2_DATA_F1_0:RW:24:8:=0x2d MR1_DATA_F1_0:RW:16:8:=0x54 MR2_DATA_F0_0:RW:8:8:=0x00 MR1_DATA_F0_0:RW:0:8:=0x04
                    177 0x36000000    //  177: MR11_DATA_F1_0:RW:24:8:=0x00 MR11_DATA_F0_0:RW:16:8:=0x00 MR8_DATA_0:RD:8:8:=0x00 MR4_DATA_F2_0:RW:0:8:=0x00
                    178 0x24242B36    //  178: MR12_DATA_F2_0:RW:24:8:=0x00 MR12_DATA_F1_0:RW:16:8:=0x00 MR12_DATA_F0_0:RW:8:8:=0x00 MR11_DATA_F2_0:RW:0:8:=0x00
                    179 0x0A0A2BC8    //  179: MR14_DATA_F2_0:RW:24:8:=0x00 MR14_DATA_F1_0:RW:16:8:=0x00 MR14_DATA_F0_0:RW:8:8:=0x00 MR13_DATA_0:RW:0:8:=0x00
                    180 0x06000000    //  180: MR22_DATA_F0_0:RW:24:8:=0x00 MR20_DATA_0:RD:16:8:=0x00 MR17_DATA_0:RW:8:8:=0x00 MR16_DATA_0:RW:0:8:=0x00
                    181 0x00040606    //  181: MR2_DATA_F0_1:RW:24:8:=0x00 MR1_DATA_F0_1:RW:16:8:=0x04 MR22_DATA_F2_0:RW:8:8:=0x00 MR22_DATA_F1_0:RW:0:8:=0x00
                    182 0x3F743664    //  182: MR2_DATA_F2_1:RW:24:8:=0x3f MR1_DATA_F2_1:RW:16:8:=0x74 MR2_DATA_F1_1:RW:8:8:=0x2d MR1_DATA_F1_1:RW:0:8:=0x54
                    185 0x2B363600    //  185: MR12_DATA_F0_1:RW:24:8:=0x00 MR11_DATA_F2_1:RW:16:8:=0x00 MR11_DATA_F1_1:RW:8:8:=0x00 MR11_DATA_F0_1:RW:0:8:=0x00
                    186 0x2BC82424    //  186: MR14_DATA_F0_1:RW:24:8:=0x00 MR13_DATA_1:RW:16:8:=0x00 MR12_DATA_F2_1:RW:8:8:=0x00 MR12_DATA_F1_1:RW:0:8:=0x00
                    187 0x00000A0A    //  187: MR17_DATA_1:RW:24:8:=0x00 MR16_DATA_1:RW:16:8:=0x00 MR14_DATA_F2_1:RW:8:8:=0x00 MR14_DATA_F1_1:RW:0:8:=0x00
                    190 0x01000000    //  190: FSP_PHY_UPDATE_MRW:RW:24:1:=0x00 RESERVED:RD:16:1:=0x00 RESERVED:RD:8:1:=0x00 RL3_SUPPORT_EN:RD:0:2:=0x00
                    191 0x01010001    //  191: FSP_WR_CURRENT:RW+:24:1:=0x00 FSP_OP_CURRENT:RW+:16:1:=0x00 FSP_STATUS:RW:8:1:=0x00 DFS_ALWAYS_WRITE_FSP:RW:0:1:=0x01
                    278 0x25250B00    //  278: COMMAND_AGE_COUNT:RW:24:8:=0xff AGE_COUNT:RW:16:8:=0xff APREBIT:RW_D:8:5:=0x0b RESERVED:RW:0:1:=0x00
                    281 0x01180001    //  281: SWAP_EN:RW:24:1:=0x01 NUM_Q_ENTRIES_ACT_DISABLE:RW:16:5:=0x18 DISABLE_RW_GROUP_W_BNK_CONFLICT:RW:8:2:=0x01 W2R_SPLIT_EN:RW:0:1:=0x01
                    282 0x00010000    //  282: REDUC:RW:24:1:=0x00 CS_MAP:RW:16:2:=0x03 INHIBIT_DRAM_CMD:RW:8:2:=0x00 DISABLE_RD_INTERLEAVE:RW:0:1:=0x00
                    323 0x050A0A03    //  323: RD_TO_ODTH_F0:RW:24:6:=0x05 WR_TO_ODTH_F2:RW:16:6:=0x0a WR_TO_ODTH_F1:RW:8:6:=0x08 WR_TO_ODTH_F0:RW:0:6:=0x03
                    324 0x0C081F1C    //  324: RW2MRW_DLY_F1:RW_D:24:5:=0x0c RW2MRW_DLY_F0:RW_D:16:5:=0x08 RD_TO_ODTH_F2:RW:8:6:=0x1f RD_TO_ODTH_F1:RW:0:6:=0x18
                    326 0x0A0C020E    //  326: W2R_DIFFCS_DLY_F1:RW_D:24:5:=0x0a R2W_DIFFCS_DLY_F1:RW_D:16:5:=0x0a R2R_DIFFCS_DLY_F1:RW_D:8:5:=0x02 W2W_DIFFCS_DLY_F0:RW_D:0:5:=0x0e
                    328 0x0C080007    //  328: R2W_SAMECS_DLY_F1:RW_D:24:5:=0x0a R2W_SAMECS_DLY_F0:RW_D:16:5:=0x08 R2R_SAMECS_DLY:RW:8:5:=0x00 W2W_DIFFCS_DLY_F2:RW_D:0:5:=0x07
                    331 0x04000104    //  331: AXI0_R_PRIORITY:RW:24:3:=0x04 AXI0_FIXED_PORT_PRIORITY_ENABLE:RW:16:1:=0x00 AXI0_ALL_STROBES_USED_ENABLE:RW:8:1:=0x00 TDQSCK_MIN_F2:RW:0:3:=0x04
                    332 0x04000104    //  332: AXI1_R_PRIORITY:RW:24:3:=0x04 AXI1_FIXED_PORT_PRIORITY_ENABLE:RW:16:1:=0x00 AXI1_ALL_STROBES_USED_ENABLE:RW:8:1:=0x00 AXI0_W_PRIORITY:RW:0:3:=0x04
                    365 0x00000C14    //  365: WRLAT_ADJ_F1:RW:8:7:=0x0a RDLAT_ADJ_F1:RW:0:7:=0x10
                    376 0x0B1E091A    //  376: TDFI_WRCSLAT_F2:RW:24:7:=0x0b TDFI_RDCSLAT_F2:RW:16:7:=0x1e TDFI_WRCSLAT_F1:RW:8:7:=0x07 TDFI_RDCSLAT_F1:RW:0:7:=0x16
                    385 0x22060001    //  385: NWR_F1:RW:24:8:=0x1e NWR_F0:RW:16:8:=0x06 AXI_PARITY_ERROR_STATUS:RD:8:2:=0x00 GLOBAL_ERROR_MASK:RW:0:8:=0x00
                >;

                DDR_PI_registers = <
                    12 0x00000005    //  12: PI_FREQ_MAP:RW:0:32:=0x00000007
                    13 0x00010002    //  13: RESERVED:RW:24:1:=0x00 PI_SW_RST_N:RW_D:16:1:=0x01 PI_INIT_DFS_CALVL_ONLY:RW:8:1:=0x00 PI_INIT_WORK_FREQ:RW:0:5:=0x02
                    29 0x05000000    //  29: PI_WRLVL_CS_MAP:RW:24:4:=0x0f PI_WRLVL_ROTATE:RW:16:1:=0x00 PI_WRLVL_RESP_MASK:RW:8:4:=0x00 PI_WRLVL_DISABLE_DFS:RW:0:1:=0x00
                    45 0x00050500    //  45: PI_RDLVL_GATE_CS_MAP:RW:16:4:=0x0f PI_RDLVL_CS_MAP:RW:8:4:=0x0f PI_RDLVL_GATE_ROTATE:RW:0:1:=0x00
                    55 0x05000000    //  55: PI_CALVL_CS_MAP:RW:24:4:=0x0f PI_CALVL_ROTATE:RW:16:1:=0x00 PI_CALVL_DISABLE_DFS:RW:8:1:=0x00 PI_CALVL_ON_SREF_EXIT:RW:0:1:=0x00
                    61 0x10020101    //  61: PI_TDFI_INIT_START_MIN:RW:24:8:=0x10 PI_CALVL_VREF_NORMAL_STEPSIZE:RW:16:4:=0x02 PI_CALVL_VREF_INITIAL_STEPSIZE:RW:8:4:=0x04 PI_CA_TRAIN_VREF_EN:RW:0:1:=0x01
                    67 0x00020105    //  67: PI_WDQLVL_PERIODIC:RW:24:1:=0x00 PI_WDQLVL_VREF_NORMAL_STEPSIZE:RW:16:5:=0x02 PI_WDQLVL_VREF_INITIAL_STEPSIZE:RW:8:5:=0x04 PI_WDQLVL_CS_MAP:RW:0:4:=0x0f
                    139 0x00000100    //  139: PI_DLL_RST_DELAY:RW:16:16:=0x0000 PI_DRAM_INIT_EN:RW:8:1:=0x00 PI_DLL_RST:RW:0:1:=0x00
                    165 0x0000005B    //  165: PI_TDELAY_RDWR_2_BUS_IDLE_F1:RW:0:8:=0x57
                    168 0x40100C04    //  168: PI_CASLAT_LIN_F1:RW:24:7:=0x38 PI_WRLAT_F1:RW:16:7:=0x0e PI_CASLAT_LIN_F0:RW:8:7:=0x0c PI_WRLAT_F0:RW:0:7:=0x04
                    185 0x14040300    //  185: PI_RDLAT_ADJ_F1:RW:24:7:=0x10 PI_RDLAT_ADJ_F0:RW:16:7:=0x04 PI_RDLVL_MULTI_EN_F2:RW:8:2:=0x00 PI_RDLVL_DFE_EN_F2:RW:0:2:=0x00
                    186 0x0E0C0215    //  186: PI_WRLAT_ADJ_F2:RW:24:7:=0x0e PI_WRLAT_ADJ_F1:RW:16:7:=0x0a PI_WRLAT_ADJ_F0:RW:8:7:=0x02 PI_RDLAT_ADJ_F2:RW:0:7:=0x15
                    199 0x28202D29    //  199: PI_CALVL_VREF_INITIAL_STOP_POINT_F1:RW:24:7:=0x1e PI_CALVL_VREF_INITIAL_START_POINT_F1:RW:16:7:=0x1a PI_CALVL_VREF_INITIAL_STOP_POINT_F0:RW:8:7:=0x1e PI_CALVL_VREF_INITIAL_START_POINT_F0:RW:0:7:=0x1a
                    200 0x01012820    //  200: PI_CALVL_VREF_DELTA_F1:RW:24:4:=0x01 PI_CALVL_VREF_DELTA_F0:RW:16:4:=0x01 PI_CALVL_VREF_INITIAL_STOP_POINT_F2:RW:8:7:=0x1e PI_CALVL_VREF_INITIAL_START_POINT_F2:RW:0:7:=0x1a
                    211 0x2D290056    //  211: PI_WDQLVL_VREF_INITIAL_STOP_POINT_F0:RW:24:7:=0x1e PI_WDQLVL_VREF_INITIAL_START_POINT_F0:RW:16:7:=0x1a PI_TDFI_WDQLVL_RW_F0:RW:0:10:=0x0056
                    213 0x005C002E    //  213: PI_TDFI_WDQLVL_RW_F1:RW:16:10:=0x005a PI_TDFI_WDQLVL_WR_F1:RW:0:10:=0x002c
                    214 0x01011008    //  214: PI_WDQLVL_EN_F1:RW:24:2:=0x01 PI_WDQLVL_VREF_DELTA_F1:RW:16:4:=0x01 PI_WDQLVL_VREF_INITIAL_STOP_POINT_F1:RW:8:7:=0x1e PI_WDQLVL_VREF_INITIAL_START_POINT_F1:RW:0:7:=0x1a
                    216 0x1008005B    //  216: PI_WDQLVL_VREF_INITIAL_STOP_POINT_F2:RW:24:7:=0x1e PI_WDQLVL_VREF_INITIAL_START_POINT_F2:RW:16:7:=0x1a PI_TDFI_WDQLVL_RW_F2:RW:0:10:=0x005b
                    235 0x01CC000F    //  235: PI_TXSR_F1:RW:16:16:=0x026c PI_TXSR_F0:RW:0:16:=0x0014
                    236 0x03030266    //  236: PI_TEXCKE_F1:RW:24:6:=0x03 PI_TEXCKE_F0:RW:16:6:=0x03 PI_TXSR_F2:RW:0:16:=0x033b
                    276 0x00062B2B    //  276: PI_MR23_DATA_F0_0:RW:24:8:=0x00 PI_MR22_DATA_F0_0:RW+:16:8:=0x00 PI_MR14_DATA_F0_0:RW+:8:8:=0x4d PI_MR12_DATA_F0_0:RW+:0:8:=0x4d
                    277 0x36313664    //  277: PI_MR11_DATA_F1_0:RW+:24:8:=0x00 PI_MR3_DATA_F1_0:RW+:16:8:=0x31 PI_MR2_DATA_F1_0:RW+:8:8:=0x2d PI_MR1_DATA_F1_0:RW+:0:8:=0x54
                    278 0x00060A24    //  278: PI_MR23_DATA_F1_0:RW:24:8:=0x00 PI_MR22_DATA_F1_0:RW+:16:8:=0x00 PI_MR14_DATA_F1_0:RW+:8:8:=0x4d PI_MR12_DATA_F1_0:RW+:0:8:=0x4d
                    279 0x36313F74    //  279: PI_MR11_DATA_F2_0:RW+:24:8:=0x00 PI_MR3_DATA_F2_0:RW+:16:8:=0x31 PI_MR2_DATA_F2_0:RW+:8:8:=0x3f PI_MR1_DATA_F2_0:RW+:0:8:=0x74
                    280 0x00060A24    //  280: PI_MR23_DATA_F2_0:RW:24:8:=0x00 PI_MR22_DATA_F2_0:RW+:16:8:=0x00 PI_MR14_DATA_F2_0:RW+:8:8:=0x4d PI_MR12_DATA_F2_0:RW+:0:8:=0x4d
                    282 0x00162B2B    //  282: PI_MR23_DATA_F0_1:RW:24:8:=0x00 PI_MR22_DATA_F0_1:RW+:16:8:=0x00 PI_MR14_DATA_F0_1:RW+:8:8:=0x4d PI_MR12_DATA_F0_1:RW+:0:8:=0x4d
                    283 0x36313664    //  283: PI_MR11_DATA_F1_1:RW+:24:8:=0x00 PI_MR3_DATA_F1_1:RW+:16:8:=0x31 PI_MR2_DATA_F1_1:RW+:8:8:=0x2d PI_MR1_DATA_F1_1:RW+:0:8:=0x54
                    284 0x00160A24    //  284: PI_MR23_DATA_F1_1:RW:24:8:=0x00 PI_MR22_DATA_F1_1:RW+:16:8:=0x00 PI_MR14_DATA_F1_1:RW+:8:8:=0x4d PI_MR12_DATA_F1_1:RW+:0:8:=0x4d
                    285 0x36313F74    //  285: PI_MR11_DATA_F2_1:RW+:24:8:=0x00 PI_MR3_DATA_F2_1:RW+:16:8:=0x31 PI_MR2_DATA_F2_1:RW+:8:8:=0x3f PI_MR1_DATA_F2_1:RW+:0:8:=0x74
                    286 0x00160A24    //  286: PI_MR23_DATA_F2_1:RW:24:8:=0x00 PI_MR22_DATA_F2_1:RW+:16:8:=0x00 PI_MR14_DATA_F2_1:RW+:8:8:=0x4d PI_MR12_DATA_F2_1:RW+:0:8:=0x4d
                    288 0x00062B2B    //  288: PI_MR23_DATA_F0_2:RW:24:8:=0x00 PI_MR22_DATA_F0_2:RW+:16:8:=0x00 PI_MR14_DATA_F0_2:RW+:8:8:=0x4d PI_MR12_DATA_F0_2:RW+:0:8:=0x4d
                    289 0x36313664    //  289: PI_MR11_DATA_F1_2:RW+:24:8:=0x00 PI_MR3_DATA_F1_2:RW+:16:8:=0x31 PI_MR2_DATA_F1_2:RW+:8:8:=0x2d PI_MR1_DATA_F1_2:RW+:0:8:=0x54
                    290 0x00060A24    //  290: PI_MR23_DATA_F1_2:RW:24:8:=0x00 PI_MR22_DATA_F1_2:RW+:16:8:=0x00 PI_MR14_DATA_F1_2:RW+:8:8:=0x4d PI_MR12_DATA_F1_2:RW+:0:8:=0x4d
                    291 0x36313F74    //  291: PI_MR11_DATA_F2_2:RW+:24:8:=0x00 PI_MR3_DATA_F2_2:RW+:16:8:=0x31 PI_MR2_DATA_F2_2:RW+:8:8:=0x3f PI_MR1_DATA_F2_2:RW+:0:8:=0x74
                    292 0x00060A24    //  292: PI_MR23_DATA_F2_2:RW:24:8:=0x00 PI_MR22_DATA_F2_2:RW+:16:8:=0x00 PI_MR14_DATA_F2_2:RW+:8:8:=0x4d PI_MR12_DATA_F2_2:RW+:0:8:=0x4d
                    294 0x00162B2B    //  294: PI_MR23_DATA_F0_3:RW:24:8:=0x00 PI_MR22_DATA_F0_3:RW+:16:8:=0x00 PI_MR14_DATA_F0_3:RW+:8:8:=0x4d PI_MR12_DATA_F0_3:RW+:0:8:=0x4d
                    295 0x36313664    //  295: PI_MR11_DATA_F1_3:RW+:24:8:=0x00 PI_MR3_DATA_F1_3:RW+:16:8:=0x31 PI_MR2_DATA_F1_3:RW+:8:8:=0x2d PI_MR1_DATA_F1_3:RW+:0:8:=0x54
                    296 0x00160A24    //  296: PI_MR23_DATA_F1_3:RW:24:8:=0x00 PI_MR22_DATA_F1_3:RW+:16:8:=0x00 PI_MR14_DATA_F1_3:RW+:8:8:=0x4d PI_MR12_DATA_F1_3:RW+:0:8:=0x4d
                    297 0x36313F74    //  297: PI_MR11_DATA_F2_3:RW+:24:8:=0x00 PI_MR3_DATA_F2_3:RW+:16:8:=0x31 PI_MR2_DATA_F2_3:RW+:8:8:=0x3f PI_MR1_DATA_F2_3:RW+:0:8:=0x74
                    298 0x00160A24    //  298: PI_MR23_DATA_F2_3:RW:24:8:=0x00 PI_MR22_DATA_F2_3:RW+:16:8:=0x00 PI_MR14_DATA_F2_3:RW+:8:8:=0x4d PI_MR12_DATA_F2_3:RW+:0:8:=0x4d
                >;

                DDR_PHY_registers = <
                    5 0x01010000    //  5: PHY_PER_CS_TRAINING_MULTICAST_EN_0:RW_D:24:1:=0x01 PHY_PER_RANK_CS_MAP_0:RW+:16:2:=0x03 PHY_SW_WRDQS_SHIFT_0:RW:8:4:=0x00 PHY_SW_WRDM_SHIFT_0:RW:0:6:=0x00
                    12 0x00000100    //  12: PHY_VREF_TRAIN_OBS_0:RD:16:7:=0x00 PHY_VREF_INITIAL_STEPSIZE_0:RW:8:6:=0x04 PHY_RDLVL_MULTI_PATT_RST_DISABLE_0:RW:0:1:=0x00
                    84 0x018C0C01    //  84: PHY_DQS_TSEL_ENABLE_0:RW+:24:3:=0x01 PHY_DQ_TSEL_SELECT_0:RW+:8:16:=0x4408 PHY_DQ_TSEL_ENABLE_0:RW+:0:3:=0x01
                    85 0x20038C0C    //  85: PHY_VREF_INITIAL_START_POINT_0:RW+:24:7:=0x20 PHY_TWO_CYC_PREAMBLE_0:RW+:16:2:=0x03 PHY_DQS_TSEL_SELECT_0:RW+:0:16:=0x4408
                    86 0x20000125    //  86: PHY_NTP_WDQ_STEP_SIZE_0:RW+:24:8:=0x20 PHY_NTP_TRAIN_EN_0:RW+:16:1:=0x00 PHY_VREF_TRAINING_CTRL_0:RW+:8:2:=0x01 PHY_VREF_INITIAL_STOP_POINT_0:RW+:0:7:=0x25
                    100 0x07A600A0    //  100: PHY_PAD_VREF_CTRL_DQ_0:RW+:16:12:=0x069f PHY_VREF_SETTING_TIME_0:RW+:0:16:=0x0004
                    138 0x10102020    //  138: PHY_DSLICE_PAD_BOOSTPN_SETTING_0:RW+:16:16:=0x0000 PHY_DATA_DC_DM_CLK_ADJUST_0:RW+:8:8:=0x20 PHY_DATA_DC_DQ7_CLK_ADJUST_0:RW+:0:8:=0x20
                    261 0x01010000    //  261: PHY_PER_CS_TRAINING_MULTICAST_EN_1:RW_D:24:1:=0x01 PHY_PER_RANK_CS_MAP_1:RW+:16:2:=0x03 PHY_SW_WRDQS_SHIFT_1:RW:8:4:=0x00 PHY_SW_WRDM_SHIFT_1:RW:0:6:=0x00
                    268 0x00000100    //  268: PHY_VREF_TRAIN_OBS_1:RD:16:7:=0x00 PHY_VREF_INITIAL_STEPSIZE_1:RW:8:6:=0x04 PHY_RDLVL_MULTI_PATT_RST_DISABLE_1:RW:0:1:=0x00
                    340 0x018C0C01    //  340: PHY_DQS_TSEL_ENABLE_1:RW+:24:3:=0x01 PHY_DQ_TSEL_SELECT_1:RW+:8:16:=0x4408 PHY_DQ_TSEL_ENABLE_1:RW+:0:3:=0x01
                    341 0x20038C0C    //  341: PHY_VREF_INITIAL_START_POINT_1:RW+:24:7:=0x20 PHY_TWO_CYC_PREAMBLE_1:RW+:16:2:=0x03 PHY_DQS_TSEL_SELECT_1:RW+:0:16:=0x4408
                    342 0x20000125    //  342: PHY_NTP_WDQ_STEP_SIZE_1:RW+:24:8:=0x20 PHY_NTP_TRAIN_EN_1:RW+:16:1:=0x00 PHY_VREF_TRAINING_CTRL_1:RW+:8:2:=0x01 PHY_VREF_INITIAL_STOP_POINT_1:RW+:0:7:=0x25
                    356 0x07A600A0    //  356: PHY_PAD_VREF_CTRL_DQ_1:RW+:16:12:=0x069f PHY_VREF_SETTING_TIME_1:RW+:0:16:=0x0004
                    394 0x10102020    //  394: PHY_DSLICE_PAD_BOOSTPN_SETTING_1:RW+:16:16:=0x0000 PHY_DATA_DC_DM_CLK_ADJUST_1:RW+:8:8:=0x20 PHY_DATA_DC_DQ7_CLK_ADJUST_1:RW+:0:8:=0x20
                    517 0x01010000    //  517: PHY_PER_CS_TRAINING_MULTICAST_EN_2:RW_D:24:1:=0x01 PHY_PER_RANK_CS_MAP_2:RW+:16:2:=0x03 PHY_SW_WRDQS_SHIFT_2:RW:8:4:=0x00 PHY_SW_WRDM_SHIFT_2:RW:0:6:=0x00
                    524 0x00000100    //  524: PHY_VREF_TRAIN_OBS_2:RD:16:7:=0x00 PHY_VREF_INITIAL_STEPSIZE_2:RW:8:6:=0x04 PHY_RDLVL_MULTI_PATT_RST_DISABLE_2:RW:0:1:=0x00
                    596 0x018C0C01    //  596: PHY_DQS_TSEL_ENABLE_2:RW+:24:3:=0x01 PHY_DQ_TSEL_SELECT_2:RW+:8:16:=0x4408 PHY_DQ_TSEL_ENABLE_2:RW+:0:3:=0x01
                    597 0x20038C0C    //  597: PHY_VREF_INITIAL_START_POINT_2:RW+:24:7:=0x20 PHY_TWO_CYC_PREAMBLE_2:RW+:16:2:=0x03 PHY_DQS_TSEL_SELECT_2:RW+:0:16:=0x4408
                    598 0x20000125    //  598: PHY_NTP_WDQ_STEP_SIZE_2:RW+:24:8:=0x20 PHY_NTP_TRAIN_EN_2:RW+:16:1:=0x00 PHY_VREF_TRAINING_CTRL_2:RW+:8:2:=0x01 PHY_VREF_INITIAL_STOP_POINT_2:RW+:0:7:=0x25
                    612 0x07A600A0    //  612: PHY_PAD_VREF_CTRL_DQ_2:RW+:16:12:=0x069f PHY_VREF_SETTING_TIME_2:RW+:0:16:=0x0004
                    650 0x10102020    //  650: PHY_DSLICE_PAD_BOOSTPN_SETTING_2:RW+:16:16:=0x0000 PHY_DATA_DC_DM_CLK_ADJUST_2:RW+:8:8:=0x20 PHY_DATA_DC_DQ7_CLK_ADJUST_2:RW+:0:8:=0x20
                    773 0x01010000    //  773: PHY_PER_CS_TRAINING_MULTICAST_EN_3:RW_D:24:1:=0x01 PHY_PER_RANK_CS_MAP_3:RW+:16:2:=0x03 PHY_SW_WRDQS_SHIFT_3:RW:8:4:=0x00 PHY_SW_WRDM_SHIFT_3:RW:0:6:=0x00
                    780 0x00000100    //  780: PHY_VREF_TRAIN_OBS_3:RD:16:7:=0x00 PHY_VREF_INITIAL_STEPSIZE_3:RW:8:6:=0x04 PHY_RDLVL_MULTI_PATT_RST_DISABLE_3:RW:0:1:=0x00
                    852 0x018C0C01    //  852: PHY_DQS_TSEL_ENABLE_3:RW+:24:3:=0x01 PHY_DQ_TSEL_SELECT_3:RW+:8:16:=0x4408 PHY_DQ_TSEL_ENABLE_3:RW+:0:3:=0x01
                    853 0x20038C0C    //  853: PHY_VREF_INITIAL_START_POINT_3:RW+:24:7:=0x20 PHY_TWO_CYC_PREAMBLE_3:RW+:16:2:=0x03 PHY_DQS_TSEL_SELECT_3:RW+:0:16:=0x4408
                    854 0x20000125    //  854: PHY_NTP_WDQ_STEP_SIZE_3:RW+:24:8:=0x20 PHY_NTP_TRAIN_EN_3:RW+:16:1:=0x00 PHY_VREF_TRAINING_CTRL_3:RW+:8:2:=0x01 PHY_VREF_INITIAL_STOP_POINT_3:RW+:0:7:=0x25
                    868 0x07A600A0    //  868: PHY_PAD_VREF_CTRL_DQ_3:RW+:16:12:=0x069f PHY_VREF_SETTING_TIME_3:RW+:0:16:=0x0004
                    906 0x10102020    //  906: PHY_DSLICE_PAD_BOOSTPN_SETTING_3:RW+:16:16:=0x0000 PHY_DATA_DC_DM_CLK_ADJUST_3:RW+:8:8:=0x20 PHY_DATA_DC_DQ7_CLK_ADJUST_3:RW+:0:8:=0x20
                    1064 0x000604CC    //  1064: PHY_PAD_ADR_IO_CFG_0:RW+:16:11:=0x0000 PHY_ADR_DC_CAL_CLK_SEL_0:RW+:8:3:=0x02 PHY_ADR_TSEL_SELECT_0:RW+:0:8:=0x44
                    1281 0x00010100    //  1281: PHY_SW_GRP0_SHIFT_0:RW+:24:5:=0x00 PHY_FREQ_SEL_INDEX:RW+:16:2:=0x00 PHY_FREQ_SEL_MULTICAST_EN:RW+:8:1:=0x01 PHY_FREQ_SEL_FROM_REGIF:RW_D:0:1:=0x00
                    1293 0x50020040    //  1293: PHY_CALVL_CS_MAP:RW:24:8:=0x50 PHY_CSLVL_COARSE_CAPTURE_CNT:RW:16:4:=0x02 PHY_CSLVL_COARSE_CHK:RW:0:11:=0x0028
                    1330 0x00000E74    //  1330: PHY_CAL_START_0:WR:24:1:=0x00 PHY_CAL_CLEAR_0:WR:16:1:=0x00 PHY_CAL_MODE_0:RW:0:13:=0x0064
                    1406 0x01E3BA88    //  1406: PHY_PAD_FDBK_DRIVE:RW+:0:30:=0x00030044
                    1407 0x00031000    //  1407: PHY_PAD_FDBK_DRIVE2:RW+:0:18:=0x030008
                    1408 0x00600DFA    //  1408: PHY_PAD_DATA_DRIVE:RW+:0:31:=0x00000180
                    1409 0x00006DFA    //  1409: PHY_PAD_DQS_DRIVE:RW+:0:32:=0x00000180
                    1410 0x010DFA11    //  1410: PHY_PAD_ADDR_DRIVE:RW+:0:30:=0x00018011
                    1411 0x01190000    //  1411: PHY_PAD_ADDR_DRIVE2:RW+:0:27:=0x0089ff00
                    1412 0x080DFACC    //  1412: PHY_PAD_CLK_DRIVE:RW+:0:32:=0x00018044
                    1413 0x00004011    //  1413: PHY_PAD_CLK_DRIVE2:RW+:0:18:=0x004011
                    1414 0x010DFA71    //  1414: PHY_PAD_CKE_DRIVE:RW+:0:30:=0x00018011
                    1415 0x01190000    //  1415: PHY_PAD_CKE_DRIVE2:RW+:0:27:=0x0089ff00
                    1416 0x010DFA71    //  1416: PHY_PAD_RST_DRIVE:RW+:0:30:=0x00018011
                    1417 0x01190000    //  1417: PHY_PAD_RST_DRIVE2:RW+:0:27:=0x0089ff00
                    1418 0x010DFA11    //  1418: PHY_PAD_CS_DRIVE:RW+:0:30:=0x00018011
                    1419 0x00EF0000    //  1419: PHY_PAD_CS_DRIVE2:RW+:0:27:=0x0089ff00
                >;

            };
        };
    };
};
