// SPDX-License-Identifier: GPL-2.0
/*
 * dts file for Hailo15 SoC
 *
 * Copyright (c) 2019-2023 Hailo Technologies Ltd. All rights reserved.
 */

&hailo_boot_info {
    ddr_config {
        ddr_patches {
            MT53E1G32D2FW-046-B_regconfig_4GB_LP4X {
                reg_config_version = "2.5";
                mr0 = <0xb9>;
                mr5 = <0xff>;
                mr6 = <0x7>;
                mr8 = <0x10>;
                mr12 = <0x5d>;
                num_of_ranks = <2>;
                DDR_ctrl_registers = <
                    60 0x0000000E    //  60: TRFC_F0:RW:0:10:=0x0013
                    62 0x000001C0    //  62: TRFC_F1:RW:0:10:=0x0260
                    64 0x00000256    //  64: TRFC_F2:RW:0:10:=0x032b
                    67 0x00030000    //  67: TRFC_PB_F0:RW:16:10:=0x0005 PBR_NUMERIC_ORDER:RW:8:1:=0x00 PBR_EN:RW:0:1:=0x00
                    68 0x00700010    //  68: TRFC_PB_F1:RW:16:10:=0x0098 TREFI_PB_F0:RW:0:16:=0x0010
                    69 0x00950304    //  69: TRFC_PB_F2:RW:16:10:=0x00cb TREFI_PB_F1:RW:0:16:=0x0304
                    79 0x000F000F    //  79: TXSNR_F0:RW:16:16:=0x0014 TXSR_F0:RW:0:16:=0x0014
                    80 0x01CC01CC    //  80: TXSNR_F1:RW:16:16:=0x026c TXSR_F1:RW:0:16:=0x026c
                    81 0x02660266    //  81: TXSNR_F2:RW:16:16:=0x033b TXSR_F2:RW:0:16:=0x033b
                    177 0x26000000    //  177: MR11_DATA_F1_0:RW:24:8:=0x00 MR11_DATA_F0_0:RW:16:8:=0x00 MR8_DATA_0:RD:8:8:=0x00 MR4_DATA_F2_0:RW:0:8:=0x00
                    178 0x18183226    //  178: MR12_DATA_F2_0:RW:24:8:=0x00 MR12_DATA_F1_0:RW:16:8:=0x00 MR12_DATA_F0_0:RW:8:8:=0x00 MR11_DATA_F2_0:RW:0:8:=0x00
                    179 0x0E0E32C8    //  179: MR14_DATA_F2_0:RW:24:8:=0x00 MR14_DATA_F1_0:RW:16:8:=0x00 MR14_DATA_F0_0:RW:8:8:=0x00 MR13_DATA_0:RW:0:8:=0x00
                    185 0x32262600    //  185: MR12_DATA_F0_1:RW:24:8:=0x00 MR11_DATA_F2_1:RW:16:8:=0x00 MR11_DATA_F1_1:RW:8:8:=0x00 MR11_DATA_F0_1:RW:0:8:=0x00
                    186 0x32C81818    //  186: MR14_DATA_F0_1:RW:24:8:=0x00 MR13_DATA_1:RW:16:8:=0x00 MR12_DATA_F2_1:RW:8:8:=0x00 MR12_DATA_F1_1:RW:0:8:=0x00
                    187 0x00000E0E    //  187: MR17_DATA_1:RW:24:8:=0x00 MR16_DATA_1:RW:16:8:=0x00 MR14_DATA_F2_1:RW:8:8:=0x00 MR14_DATA_F1_1:RW:0:8:=0x00
                    188 0x2E2E2E00    //  188: MR22_DATA_F2_1:RW:24:8:=0x00 MR22_DATA_F1_1:RW:16:8:=0x00 MR22_DATA_F0_1:RW:8:8:=0x00 MR20_DATA_1:RD:0:8:=0x00
                    272 0x01010000    //  272: ROW_DIFF_1:RW:24:3:=0x00 ROW_DIFF_0:RW:16:3:=0x00 BANK_DIFF_1:RW:8:2:=0x00 BANK_DIFF_0:RW:0:2:=0x00
                    274 0x00000FFF    //  274: ROW_START_VAL_0:RW:16:3:=0x00 CS_VAL_UPPER_0:RW:0:16:=0x1fff
                    275 0x1FFF1000    //  275: CS_VAL_UPPER_1:RW:16:16:=0x3fff CS_VAL_LOWER_1:RW:0:16:=0x2000
                    276 0x01FF0000    //  276: CS_MSK_0:RW:16:16:=0x03ff CS_MAP_NON_POW2:RW:8:2:=0x00 ROW_START_VAL_1:RW:0:3:=0x00
                    277 0x000001FF    //  277: RESERVED:RW:24:5:=0x00 CS_LOWER_ADDR_EN:RW:16:1:=0x00 CS_MSK_1:RW:0:16:=0x03ff
                    291 0x01010000    //  291: DEVICE0_BYTE0_CS1:RW:24:4:=0x01 MEMDATA_RATIO_1:RW:16:3:=0x01 DEVICE3_BYTE0_CS0:RW:8:4:=0x00 DEVICE2_BYTE0_CS0:RW:0:4:=0x00
                    292 0x00000004    //  292: Q_FULLNESS:RW:24:5:=0x00 DEVICE3_BYTE0_CS1:RW:16:4:=0x00 DEVICE2_BYTE0_CS1:RW:8:4:=0x00 DEVICE1_BYTE0_CS1:RW:0:4:=0x04
                >;

                DDR_PI_registers = <
                    14 0x0800000F    //  14: PI_TMRR:RW:24:4:=0x08 PI_SRX_LVL_TARGET_CS_EN:RW:16:1:=0x00 PI_RANK_NUM_PER_CKE:RW:8:5:=0x00 PI_CS_MAP:RW:0:4:=0x0f
                    29 0x0F000000    //  29: PI_WRLVL_CS_MAP:RW:24:4:=0x0f PI_WRLVL_ROTATE:RW:16:1:=0x00 PI_WRLVL_RESP_MASK:RW:8:4:=0x00 PI_WRLVL_DISABLE_DFS:RW:0:1:=0x00
                    45 0x000F0F00    //  45: PI_RDLVL_GATE_CS_MAP:RW:16:4:=0x0f PI_RDLVL_CS_MAP:RW:8:4:=0x0f PI_RDLVL_GATE_ROTATE:RW:0:1:=0x00
                    55 0x0F000000    //  55: PI_CALVL_CS_MAP:RW:24:4:=0x0f PI_CALVL_ROTATE:RW:16:1:=0x00 PI_CALVL_DISABLE_DFS:RW:8:1:=0x00 PI_CALVL_ON_SREF_EXIT:RW:0:1:=0x00
                    67 0x0002010F    //  67: PI_WDQLVL_PERIODIC:RW:24:1:=0x00 PI_WDQLVL_VREF_NORMAL_STEPSIZE:RW:16:5:=0x02 PI_WDQLVL_VREF_INITIAL_STEPSIZE:RW:8:5:=0x04 PI_WDQLVL_CS_MAP:RW:0:4:=0x0f
                    73 0x00080100    //  73: RESERVED:RW_D:24:4:=0x00 PI_TCCD:RW:16:5:=0x08 PI_ROW_DIFF:RW:8:3:=0x00 PI_BANK_DIFF:RW:0:2:=0x00
                    169 0x000E4812    //  169: PI_TRFC_F0:RW:16:10:=0x0013 PI_CASLAT_LIN_F2:RW:8:7:=0x48 PI_WRLAT_F2:RW:0:7:=0x12
                    171 0x000001C0    //  171: PI_TRFC_F1:RW:0:10:=0x0260
                    173 0x00000256    //  173: PI_TRFC_F2:RW:0:10:=0x032b
                    199 0x1C14322E    //  199: PI_CALVL_VREF_INITIAL_STOP_POINT_F1:RW:24:7:=0x1e PI_CALVL_VREF_INITIAL_START_POINT_F1:RW:16:7:=0x1a PI_CALVL_VREF_INITIAL_STOP_POINT_F0:RW:8:7:=0x1e PI_CALVL_VREF_INITIAL_START_POINT_F0:RW:0:7:=0x1a
                    200 0x01011C14    //  200: PI_CALVL_VREF_DELTA_F1:RW:24:4:=0x01 PI_CALVL_VREF_DELTA_F0:RW:16:4:=0x01 PI_CALVL_VREF_INITIAL_STOP_POINT_F2:RW:8:7:=0x1e PI_CALVL_VREF_INITIAL_START_POINT_F2:RW:0:7:=0x1a
                    211 0x322E0056    //  211: PI_WDQLVL_VREF_INITIAL_STOP_POINT_F0:RW:24:7:=0x1e PI_WDQLVL_VREF_INITIAL_START_POINT_F0:RW:16:7:=0x1a PI_TDFI_WDQLVL_RW_F0:RW:0:10:=0x0056
                    214 0x0101100A    //  214: PI_WDQLVL_EN_F1:RW:24:2:=0x01 PI_WDQLVL_VREF_DELTA_F1:RW:16:4:=0x01 PI_WDQLVL_VREF_INITIAL_STOP_POINT_F1:RW:8:7:=0x1e PI_WDQLVL_VREF_INITIAL_START_POINT_F1:RW:0:7:=0x1a
                    216 0x100A005B    //  216: PI_WDQLVL_VREF_INITIAL_STOP_POINT_F2:RW:24:7:=0x1e PI_WDQLVL_VREF_INITIAL_START_POINT_F2:RW:16:7:=0x1a PI_TDFI_WDQLVL_RW_F2:RW:0:10:=0x005b
                    235 0x01CC000F    //  235: PI_TXSR_F1:RW:16:16:=0x026c PI_TXSR_F0:RW:0:16:=0x0014
                    236 0x03030266    //  236: PI_TEXCKE_F1:RW:24:6:=0x03 PI_TEXCKE_F0:RW:16:6:=0x03 PI_TXSR_F2:RW:0:16:=0x033b
                    241 0x0000000F    //  241: PI_TXSNR_F0:RW:0:16:=0x0014
                    246 0x000001CC    //  246: PI_TXSNR_F1:RW:0:16:=0x026c
                    251 0x01000266    //  251: RESERVED:RW:16:12:=0x0100 PI_TXSNR_F2:RW:0:16:=0x033b
                    276 0x00063232    //  276: PI_MR23_DATA_F0_0:RW:24:8:=0x00 PI_MR22_DATA_F0_0:RW+:16:8:=0x00 PI_MR14_DATA_F0_0:RW+:8:8:=0x4d PI_MR12_DATA_F0_0:RW+:0:8:=0x4d
                    277 0x26312D54    //  277: PI_MR11_DATA_F1_0:RW+:24:8:=0x00 PI_MR3_DATA_F1_0:RW+:16:8:=0x31 PI_MR2_DATA_F1_0:RW+:8:8:=0x2d PI_MR1_DATA_F1_0:RW+:0:8:=0x54
                    278 0x00060E18    //  278: PI_MR23_DATA_F1_0:RW:24:8:=0x00 PI_MR22_DATA_F1_0:RW+:16:8:=0x00 PI_MR14_DATA_F1_0:RW+:8:8:=0x4d PI_MR12_DATA_F1_0:RW+:0:8:=0x4d
                    279 0x26313F74    //  279: PI_MR11_DATA_F2_0:RW+:24:8:=0x00 PI_MR3_DATA_F2_0:RW+:16:8:=0x31 PI_MR2_DATA_F2_0:RW+:8:8:=0x3f PI_MR1_DATA_F2_0:RW+:0:8:=0x74
                    280 0x00060E18    //  280: PI_MR23_DATA_F2_0:RW:24:8:=0x00 PI_MR22_DATA_F2_0:RW+:16:8:=0x00 PI_MR14_DATA_F2_0:RW+:8:8:=0x4d PI_MR12_DATA_F2_0:RW+:0:8:=0x4d
                    282 0x002E3232    //  282: PI_MR23_DATA_F0_1:RW:24:8:=0x00 PI_MR22_DATA_F0_1:RW+:16:8:=0x00 PI_MR14_DATA_F0_1:RW+:8:8:=0x4d PI_MR12_DATA_F0_1:RW+:0:8:=0x4d
                    283 0x26312D54    //  283: PI_MR11_DATA_F1_1:RW+:24:8:=0x00 PI_MR3_DATA_F1_1:RW+:16:8:=0x31 PI_MR2_DATA_F1_1:RW+:8:8:=0x2d PI_MR1_DATA_F1_1:RW+:0:8:=0x54
                    284 0x002E0E18    //  284: PI_MR23_DATA_F1_1:RW:24:8:=0x00 PI_MR22_DATA_F1_1:RW+:16:8:=0x00 PI_MR14_DATA_F1_1:RW+:8:8:=0x4d PI_MR12_DATA_F1_1:RW+:0:8:=0x4d
                    285 0x26313F74    //  285: PI_MR11_DATA_F2_1:RW+:24:8:=0x00 PI_MR3_DATA_F2_1:RW+:16:8:=0x31 PI_MR2_DATA_F2_1:RW+:8:8:=0x3f PI_MR1_DATA_F2_1:RW+:0:8:=0x74
                    286 0x002E0E18    //  286: PI_MR23_DATA_F2_1:RW:24:8:=0x00 PI_MR22_DATA_F2_1:RW+:16:8:=0x00 PI_MR14_DATA_F2_1:RW+:8:8:=0x4d PI_MR12_DATA_F2_1:RW+:0:8:=0x4d
                    288 0x00063232    //  288: PI_MR23_DATA_F0_2:RW:24:8:=0x00 PI_MR22_DATA_F0_2:RW+:16:8:=0x00 PI_MR14_DATA_F0_2:RW+:8:8:=0x4d PI_MR12_DATA_F0_2:RW+:0:8:=0x4d
                    289 0x26312D54    //  289: PI_MR11_DATA_F1_2:RW+:24:8:=0x00 PI_MR3_DATA_F1_2:RW+:16:8:=0x31 PI_MR2_DATA_F1_2:RW+:8:8:=0x2d PI_MR1_DATA_F1_2:RW+:0:8:=0x54
                    290 0x00060E18    //  290: PI_MR23_DATA_F1_2:RW:24:8:=0x00 PI_MR22_DATA_F1_2:RW+:16:8:=0x00 PI_MR14_DATA_F1_2:RW+:8:8:=0x4d PI_MR12_DATA_F1_2:RW+:0:8:=0x4d
                    291 0x26313F74    //  291: PI_MR11_DATA_F2_2:RW+:24:8:=0x00 PI_MR3_DATA_F2_2:RW+:16:8:=0x31 PI_MR2_DATA_F2_2:RW+:8:8:=0x3f PI_MR1_DATA_F2_2:RW+:0:8:=0x74
                    292 0x00060E18    //  292: PI_MR23_DATA_F2_2:RW:24:8:=0x00 PI_MR22_DATA_F2_2:RW+:16:8:=0x00 PI_MR14_DATA_F2_2:RW+:8:8:=0x4d PI_MR12_DATA_F2_2:RW+:0:8:=0x4d
                    294 0x002E3232    //  294: PI_MR23_DATA_F0_3:RW:24:8:=0x00 PI_MR22_DATA_F0_3:RW+:16:8:=0x00 PI_MR14_DATA_F0_3:RW+:8:8:=0x4d PI_MR12_DATA_F0_3:RW+:0:8:=0x4d
                    295 0x26312D54    //  295: PI_MR11_DATA_F1_3:RW+:24:8:=0x00 PI_MR3_DATA_F1_3:RW+:16:8:=0x31 PI_MR2_DATA_F1_3:RW+:8:8:=0x2d PI_MR1_DATA_F1_3:RW+:0:8:=0x54
                    296 0x002E0E18    //  296: PI_MR23_DATA_F1_3:RW:24:8:=0x00 PI_MR22_DATA_F1_3:RW+:16:8:=0x00 PI_MR14_DATA_F1_3:RW+:8:8:=0x4d PI_MR12_DATA_F1_3:RW+:0:8:=0x4d
                    297 0x26313F74    //  297: PI_MR11_DATA_F2_3:RW+:24:8:=0x00 PI_MR3_DATA_F2_3:RW+:16:8:=0x31 PI_MR2_DATA_F2_3:RW+:8:8:=0x3f PI_MR1_DATA_F2_3:RW+:0:8:=0x74
                    298 0x002E0E18    //  298: PI_MR23_DATA_F2_3:RW:24:8:=0x00 PI_MR22_DATA_F2_3:RW+:16:8:=0x00 PI_MR14_DATA_F2_3:RW+:8:8:=0x4d PI_MR12_DATA_F2_3:RW+:0:8:=0x4d
                >;

                DDR_PHY_registers = <
                    5 0x01030000    //  5: PHY_PER_CS_TRAINING_MULTICAST_EN_0:RW_D:24:1:=0x01 PHY_PER_RANK_CS_MAP_0:RW+:16:2:=0x03 PHY_SW_WRDQS_SHIFT_0:RW:8:4:=0x00 PHY_SW_WRDM_SHIFT_0:RW:0:6:=0x00
                    84 0x01CC0C01    //  84: PHY_DQS_TSEL_ENABLE_0:RW+:24:3:=0x01 PHY_DQ_TSEL_SELECT_0:RW+:8:16:=0x4408 PHY_DQ_TSEL_ENABLE_0:RW+:0:3:=0x01
                    85 0x3A03CC0C    //  85: PHY_VREF_INITIAL_START_POINT_0:RW+:24:7:=0x20 PHY_TWO_CYC_PREAMBLE_0:RW+:16:2:=0x03 PHY_DQS_TSEL_SELECT_0:RW+:0:16:=0x4408
                    86 0x20000142    //  86: PHY_NTP_WDQ_STEP_SIZE_0:RW+:24:8:=0x20 PHY_NTP_TRAIN_EN_0:RW+:16:1:=0x00 PHY_VREF_TRAINING_CTRL_0:RW+:8:2:=0x01 PHY_VREF_INITIAL_STOP_POINT_0:RW+:0:7:=0x25
                    100 0x09BE00A0    //  100: PHY_PAD_VREF_CTRL_DQ_0:RW+:16:12:=0x069f PHY_VREF_SETTING_TIME_0:RW+:0:16:=0x0004
                    138 0x01012020    //  138: PHY_DSLICE_PAD_BOOSTPN_SETTING_0:RW+:16:16:=0x0000 PHY_DATA_DC_DM_CLK_ADJUST_0:RW+:8:8:=0x20 PHY_DATA_DC_DQ7_CLK_ADJUST_0:RW+:0:8:=0x20
                    261 0x01030000    //  261: PHY_PER_CS_TRAINING_MULTICAST_EN_1:RW_D:24:1:=0x01 PHY_PER_RANK_CS_MAP_1:RW+:16:2:=0x03 PHY_SW_WRDQS_SHIFT_1:RW:8:4:=0x00 PHY_SW_WRDM_SHIFT_1:RW:0:6:=0x00
                    340 0x01CC0C01    //  340: PHY_DQS_TSEL_ENABLE_1:RW+:24:3:=0x01 PHY_DQ_TSEL_SELECT_1:RW+:8:16:=0x4408 PHY_DQ_TSEL_ENABLE_1:RW+:0:3:=0x01
                    341 0x3A03CC0C    //  341: PHY_VREF_INITIAL_START_POINT_1:RW+:24:7:=0x20 PHY_TWO_CYC_PREAMBLE_1:RW+:16:2:=0x03 PHY_DQS_TSEL_SELECT_1:RW+:0:16:=0x4408
                    342 0x20000142    //  342: PHY_NTP_WDQ_STEP_SIZE_1:RW+:24:8:=0x20 PHY_NTP_TRAIN_EN_1:RW+:16:1:=0x00 PHY_VREF_TRAINING_CTRL_1:RW+:8:2:=0x01 PHY_VREF_INITIAL_STOP_POINT_1:RW+:0:7:=0x25
                    356 0x09BE00A0    //  356: PHY_PAD_VREF_CTRL_DQ_1:RW+:16:12:=0x069f PHY_VREF_SETTING_TIME_1:RW+:0:16:=0x0004
                    394 0x01012020    //  394: PHY_DSLICE_PAD_BOOSTPN_SETTING_1:RW+:16:16:=0x0000 PHY_DATA_DC_DM_CLK_ADJUST_1:RW+:8:8:=0x20 PHY_DATA_DC_DQ7_CLK_ADJUST_1:RW+:0:8:=0x20
                    517 0x01030000    //  517: PHY_PER_CS_TRAINING_MULTICAST_EN_2:RW_D:24:1:=0x01 PHY_PER_RANK_CS_MAP_2:RW+:16:2:=0x03 PHY_SW_WRDQS_SHIFT_2:RW:8:4:=0x00 PHY_SW_WRDM_SHIFT_2:RW:0:6:=0x00
                    596 0x01CC0C01    //  596: PHY_DQS_TSEL_ENABLE_2:RW+:24:3:=0x01 PHY_DQ_TSEL_SELECT_2:RW+:8:16:=0x4408 PHY_DQ_TSEL_ENABLE_2:RW+:0:3:=0x01
                    597 0x3A03CC0C    //  597: PHY_VREF_INITIAL_START_POINT_2:RW+:24:7:=0x20 PHY_TWO_CYC_PREAMBLE_2:RW+:16:2:=0x03 PHY_DQS_TSEL_SELECT_2:RW+:0:16:=0x4408
                    598 0x20000142    //  598: PHY_NTP_WDQ_STEP_SIZE_2:RW+:24:8:=0x20 PHY_NTP_TRAIN_EN_2:RW+:16:1:=0x00 PHY_VREF_TRAINING_CTRL_2:RW+:8:2:=0x01 PHY_VREF_INITIAL_STOP_POINT_2:RW+:0:7:=0x25
                    612 0x09BE00A0    //  612: PHY_PAD_VREF_CTRL_DQ_2:RW+:16:12:=0x069f PHY_VREF_SETTING_TIME_2:RW+:0:16:=0x0004
                    650 0x01012020    //  650: PHY_DSLICE_PAD_BOOSTPN_SETTING_2:RW+:16:16:=0x0000 PHY_DATA_DC_DM_CLK_ADJUST_2:RW+:8:8:=0x20 PHY_DATA_DC_DQ7_CLK_ADJUST_2:RW+:0:8:=0x20
                    773 0x01030000    //  773: PHY_PER_CS_TRAINING_MULTICAST_EN_3:RW_D:24:1:=0x01 PHY_PER_RANK_CS_MAP_3:RW+:16:2:=0x03 PHY_SW_WRDQS_SHIFT_3:RW:8:4:=0x00 PHY_SW_WRDM_SHIFT_3:RW:0:6:=0x00
                    852 0x01CC0C01    //  852: PHY_DQS_TSEL_ENABLE_3:RW+:24:3:=0x01 PHY_DQ_TSEL_SELECT_3:RW+:8:16:=0x4408 PHY_DQ_TSEL_ENABLE_3:RW+:0:3:=0x01
                    853 0x3A03CC0C    //  853: PHY_VREF_INITIAL_START_POINT_3:RW+:24:7:=0x20 PHY_TWO_CYC_PREAMBLE_3:RW+:16:2:=0x03 PHY_DQS_TSEL_SELECT_3:RW+:0:16:=0x4408
                    854 0x20000142    //  854: PHY_NTP_WDQ_STEP_SIZE_3:RW+:24:8:=0x20 PHY_NTP_TRAIN_EN_3:RW+:16:1:=0x00 PHY_VREF_TRAINING_CTRL_3:RW+:8:2:=0x01 PHY_VREF_INITIAL_STOP_POINT_3:RW+:0:7:=0x25
                    868 0x09BE00A0    //  868: PHY_PAD_VREF_CTRL_DQ_3:RW+:16:12:=0x069f PHY_VREF_SETTING_TIME_3:RW+:0:16:=0x0004
                    906 0x01012020    //  906: PHY_DSLICE_PAD_BOOSTPN_SETTING_3:RW+:16:16:=0x0000 PHY_DATA_DC_DM_CLK_ADJUST_3:RW+:8:8:=0x20 PHY_DATA_DC_DQ7_CLK_ADJUST_3:RW+:0:8:=0x20
                    1064 0x000604FF    //  1064: PHY_PAD_ADR_IO_CFG_0:RW+:16:11:=0x0000 PHY_ADR_DC_CAL_CLK_SEL_0:RW+:8:3:=0x02 PHY_ADR_TSEL_SELECT_0:RW+:0:8:=0x44
                    1330 0x00001294    //  1330: PHY_CAL_START_0:WR:24:1:=0x00 PHY_CAL_CLEAR_0:WR:16:1:=0x00 PHY_CAL_MODE_0:RW:0:13:=0x0064
                    1406 0x0184BF88    //  1406: PHY_PAD_FDBK_DRIVE:RW+:0:30:=0x00030044
                    1407 0x00030100    //  1407: PHY_PAD_FDBK_DRIVE2:RW+:0:18:=0x030008
                    1408 0x00000E7F    //  1408: PHY_PAD_DATA_DRIVE:RW+:0:31:=0x00000180
                    1409 0x00000E7F    //  1409: PHY_PAD_DQS_DRIVE:RW+:0:32:=0x00000180
                    1410 0x001E7F11    //  1410: PHY_PAD_ADDR_DRIVE:RW+:0:30:=0x00018011
                    1411 0x01990000    //  1411: PHY_PAD_ADDR_DRIVE2:RW+:0:27:=0x0089ff00
                    1412 0x008E7FCC    //  1412: PHY_PAD_CLK_DRIVE:RW+:0:32:=0x00018044
                    1414 0x001E7F11    //  1414: PHY_PAD_CKE_DRIVE:RW+:0:30:=0x00018011
                    1415 0x01990000    //  1415: PHY_PAD_CKE_DRIVE2:RW+:0:27:=0x0089ff00
                    1416 0x001E7F11    //  1416: PHY_PAD_RST_DRIVE:RW+:0:30:=0x00018011
                    1417 0x01990000    //  1417: PHY_PAD_RST_DRIVE2:RW+:0:27:=0x0089ff00
                    1418 0x001E7F11    //  1418: PHY_PAD_CS_DRIVE:RW+:0:30:=0x00018011
                >;

            };
        };
    };
};
