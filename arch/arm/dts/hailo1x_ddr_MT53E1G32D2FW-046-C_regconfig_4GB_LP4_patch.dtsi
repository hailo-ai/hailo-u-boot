// SPDX-License-Identifier: GPL-2.0
/*
 * dts file for Hailo15 SoC
 *
 * Copyright (c) 2019-2023 Hailo Technologies Ltd. All rights reserved.
 */

&hailo_boot_info {
    ddr_config {
        ddr_patches {
            MT53E1G32D2FW-046-C_regconfig_4GB_LP4 {
                reg_config_version = "2.6";
                mr0 = <0xb9>;
                mr5 = <0xff>;
                mr6 = <0x7>;
                mr8 = <0x18>;
                mr12 = <0x4d>;
                num_of_ranks = <1>;
                DDR_ctrl_registers = <
                    282 0x00010000    //  282: REDUC:RW:24:1:=0x00 CS_MAP:RW:16:2:=0x03 INHIBIT_DRAM_CMD:RW:8:2:=0x00 DISABLE_RD_INTERLEAVE:RW:0:1:=0x00
                >;

                DDR_PI_registers = <
                    161 0x05010000    //  161: PI_CATR:RW:24:4:=0x00 PI_PARALLEL_CALVL_EN:RW:16:1:=0x01 RESERVED:RW:8:5:=0x00 PI_FREQ_SEL_FROM_REGIF:RW:0:1:=0x00
                    162 0x00000001    //  162: PI_NOTCARE_MC_INIT_START:RW:24:1:=0x00 PI_DISCONNECT_MC:RW:16:1:=0x00 PI_MASK_INIT_COMPLETE:RW:8:1:=0x00 PI_NO_CATR_READ:RW:0:1:=0x00
                >;

                DDR_PHY_registers = <
                >;

            };
        };
    };
};
