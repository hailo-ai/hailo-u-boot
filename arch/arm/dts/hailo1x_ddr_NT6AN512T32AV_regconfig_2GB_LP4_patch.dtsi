// SPDX-License-Identifier: GPL-2.0
/*
 * dts file for Hailo15 SoC
 *
 * Copyright (c) 2019-2023 Hailo Technologies Ltd. All rights reserved.
 */

&hailo_boot_info {
    ddr_config {
        ddr_patches {
            NT6AN512T32AV_regconfig_2GB_LP4 {
                reg_config_version = "2.5";
                mr0 = <0x38>;
                mr5 = <0x05>;
                mr6 = <0x0>;
                mr8 = <0x10>;
                mr12 = <0x4d>;
                num_of_ranks = <1>;
                DDR_ctrl_registers = <
                    39 0x09040008    //  39: TWTR_F0:RW:24:6:=0x09 TRAS_MIN_F0:RW:16:8:=0x04 TRC_F0:RW:0:9:=0x0007
                    40 0x0D000204    //  40: TRRD_F1:RW:24:8:=0x0d TFAW_F0:RW:8:9:=0x0002 TRP_F0:RW:0:8:=0x03
                    54 0x08010100    //  54: TDAL_F0:RW:24:8:=0x07 TRAS_LOCKOUT:RW:16:1:=0x01 CONCURRENTAP:RW:8:1:=0x01 AP:RW:0:1:=0x00
                    55 0x0404503C    //  55: TRP_AB_F0_0:RW:24:8:=0x03 BSTLEN:RW_D:16:5:=0x04 TDAL_F2:RW:8:8:=0x50 TDAL_F1:RW:0:8:=0x3c
                    56 0x22042D22    //  56: TRP_AB_F1_1:RW:24:8:=0x22 TRP_AB_F0_1:RW:16:8:=0x03 TRP_AB_F2_0:RW:8:8:=0x2d TRP_AB_F1_0:RW:0:8:=0x22
                    60 0x00000009    //  60: TRFC_F0:RW:0:10:=0x0013
                    62 0x00000120    //  62: TRFC_F1:RW:0:10:=0x0260
                    64 0x00000180    //  64: TRFC_F2:RW:0:10:=0x032b
                    67 0x00020000    //  67: TRFC_PB_F0:RW:16:10:=0x0005 PBR_NUMERIC_ORDER:RW:8:1:=0x00 PBR_EN:RW:0:1:=0x00
                    68 0x00480010    //  68: TRFC_PB_F1:RW:16:10:=0x0098 TREFI_PB_F0:RW:0:16:=0x0010
                    69 0x00600304    //  69: TRFC_PB_F2:RW:16:10:=0x00cb TREFI_PB_F1:RW:0:16:=0x0304
                    79 0x000A000A    //  79: TXSNR_F0:RW:16:16:=0x0014 TXSR_F0:RW:0:16:=0x0014
                    80 0x012C012C    //  80: TXSNR_F1:RW:16:16:=0x026c TXSR_F1:RW:0:16:=0x026c
                    81 0x01900190    //  81: TXSNR_F2:RW:16:16:=0x033b TXSR_F2:RW:0:16:=0x033b
                    272 0x01010000    //  272: ROW_DIFF_1:RW:24:3:=0x00 ROW_DIFF_0:RW:16:3:=0x00 BANK_DIFF_1:RW:8:2:=0x00 BANK_DIFF_0:RW:0:2:=0x00
                    274 0x00000FFF    //  274: ROW_START_VAL_0:RW:16:3:=0x00 CS_VAL_UPPER_0:RW:0:16:=0x1fff
                    276 0x01FF0000    //  276: CS_MSK_0:RW:16:16:=0x03ff CS_MAP_NON_POW2:RW:8:2:=0x00 ROW_START_VAL_1:RW:0:3:=0x00
                    282 0x00010000    //  282: REDUC:RW:24:1:=0x00 CS_MAP:RW:16:2:=0x03 INHIBIT_DRAM_CMD:RW:8:2:=0x00 DISABLE_RD_INTERLEAVE:RW:0:1:=0x00
                >;

                DDR_PI_registers = <
                    73 0x00080100    //  73: RESERVED:RW_D:24:4:=0x00 PI_TCCD:RW:16:5:=0x08 PI_ROW_DIFF:RW:8:3:=0x00 PI_BANK_DIFF:RW:0:2:=0x00
                    169 0x00094812    //  169: PI_TRFC_F0:RW:16:10:=0x0013 PI_CASLAT_LIN_F2:RW:8:7:=0x48 PI_WRLAT_F2:RW:0:7:=0x12
                    171 0x00000120    //  171: PI_TRFC_F1:RW:0:10:=0x0260
                    173 0x00000180    //  173: PI_TRFC_F2:RW:0:10:=0x032b
                    218 0x04010504    //  218: PI_TWR_F0:RW:24:8:=0x04 PI_TWTR_F0:RW:16:6:=0x01 PI_TRCD_F0:RW:8:8:=0x05 PI_TRP_F0:RW:0:8:=0x03
                    235 0x012C000A    //  235: PI_TXSR_F1:RW:16:16:=0x026c PI_TXSR_F0:RW:0:16:=0x0014
                    236 0x03030190    //  236: PI_TEXCKE_F1:RW:24:6:=0x03 PI_TEXCKE_F0:RW:16:6:=0x03 PI_TXSR_F2:RW:0:16:=0x033b
                    241 0x0000000A    //  241: PI_TXSNR_F0:RW:0:16:=0x0014
                    246 0x0000012C    //  246: PI_TXSNR_F1:RW:0:16:=0x026c
                    251 0x01000190    //  251: RESERVED:RW:16:12:=0x0100 PI_TXSNR_F2:RW:0:16:=0x033b
                >;

                DDR_PHY_registers = <
                >;

            };
        };
    };
};
