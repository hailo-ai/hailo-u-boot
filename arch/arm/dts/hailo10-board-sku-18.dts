// SPDX-License-Identifier: GPL-2.0
/*
 * dts file for Hailo10 (board-sku-18).
 *
 * Copyright (c) 2019-2025 Hailo Technologies Ltd. All rights reserved.
 */
#include "hailo10-m2-base.dtsi"
#include "hailo1x_ddr_MT53E512M32D1-046_regconfig_2GB_LP4.dtsi"
