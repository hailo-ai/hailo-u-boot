// SPDX-License-Identifier: GPL-2.0
/*
 * dts file for Hailo15 SoC
 *
 * Copyright (c) 2019-2023 Hailo Technologies Ltd. All rights reserved.
 */

&hailo_boot_info {
    ddr_config {
        ddr_patches {
            MT53E256M32D1-046_regconfig_1GB_LP4x {
                reg_config_version = "2.3";
                mr0 = <0xb8>;
                mr5 = <0xff>;
                mr6 = <0x7>;
                mr8 = <0x8>;
                mr12 = <0x5d>;
                num_of_ranks = <1>;
                DDR_ctrl_registers = <
                    21 0x01010000    //  21: ODT_VALUE:RW:24:1:=0x01 NO_MRW_INIT:RW:16:1:=0x00 DFI_INV_DATA_CS:RW:8:1:=0x00 MRR_ERROR_STATUS:RD:0:1:=0x00
                    22 0x01011001    //  22: DFIBUS_FREQ_INIT:RW:24:2:=0x02 PHY_INDEP_INIT_MODE:RW:16:1:=0x00 TSREF2PHYMSTR:RW:8:6:=0x10 PHY_INDEP_TRAIN_MODE:RW:0:1:=0x01
                    37 0x12481040    //  37: WRLAT_F2:RW:24:7:=0x12 CASLAT_LIN_F2:RW:16:7:=0x48 WRLAT_F1:RW:8:7:=0x0e CASLAT_LIN_F1:RW:0:7:=0x38
                    40 0x11000203    //  40: TRRD_F1:RW:24:8:=0x0d TFAW_F0:RW:8:9:=0x0002 TRP_F0:RW:0:8:=0x03
                    42 0x1600311D    //  42: TRRD_F2:RW:24:8:=0x11 TFAW_F1:RW:8:9:=0x0031 TRP_F1:RW:0:8:=0x1d
                    60 0x00000009    //  60: TRFC_F0:RW:0:10:=0x0013
                    62 0x00000120    //  62: TRFC_F1:RW:0:10:=0x0260
                    64 0x00000180    //  64: TRFC_F2:RW:0:10:=0x032b
                    67 0x00020000    //  67: TRFC_PB_F0:RW:16:10:=0x0005 PBR_NUMERIC_ORDER:RW:8:1:=0x00 PBR_EN:RW:0:1:=0x00
                    68 0x00480010    //  68: TRFC_PB_F1:RW:16:10:=0x0098 TREFI_PB_F0:RW:0:16:=0x0010
                    69 0x00600304    //  69: TRFC_PB_F2:RW:16:10:=0x00cb TREFI_PB_F1:RW:0:16:=0x0304
                    79 0x000A000A    //  79: TXSNR_F0:RW:16:16:=0x0014 TXSR_F0:RW:0:16:=0x0014
                    80 0x012C012C    //  80: TXSNR_F1:RW:16:16:=0x026c TXSR_F1:RW:0:16:=0x026c
                    81 0x01900190    //  81: TXSNR_F2:RW:16:16:=0x033b TXSR_F2:RW:0:16:=0x033b
                    138 0x000E0A09    //  138: LPI_WAKEUP_EN:RW:24:6:=0x2f LPI_TIMER_WAKEUP_F2:RW:16:4:=0x0e LPI_SRPD_LONG_MCCLK_GATE_WAKEUP_F2:RW:8:4:=0x0a LPI_SRPD_LONG_WAKEUP_F2:RW:0:4:=0x09
                    147 0x08080000    //  147: PCPCS_PD_EXIT_DEPTH:RW:24:6:=0x08 PCPCS_PD_ENTER_DEPTH:RW:16:6:=0x08 PCPCS_PD_EN:RW:8:1:=0x01 LPC_SR_ZQ_EN:RW:0:1:=0x00
                    174 0x36640004    //  174: MR2_DATA_F1_0:RW:24:8:=0x2d MR1_DATA_F1_0:RW:16:8:=0x54 MR2_DATA_F0_0:RW:8:8:=0x00 MR1_DATA_F0_0:RW:0:8:=0x04
                    177 0x36000000    //  177: MR11_DATA_F1_0:RW:24:8:=0x00 MR11_DATA_F0_0:RW:16:8:=0x00 MR8_DATA_0:RD:8:8:=0x00 MR4_DATA_F2_0:RW:0:8:=0x00
                    178 0x0E0E3236    //  178: MR12_DATA_F2_0:RW:24:8:=0x00 MR12_DATA_F1_0:RW:16:8:=0x00 MR12_DATA_F0_0:RW:8:8:=0x00 MR11_DATA_F2_0:RW:0:8:=0x00
                    179 0x0E0E32C8    //  179: MR14_DATA_F2_0:RW:24:8:=0x00 MR14_DATA_F1_0:RW:16:8:=0x00 MR14_DATA_F0_0:RW:8:8:=0x00 MR13_DATA_0:RW:0:8:=0x00
                    180 0x06000000    //  180: MR22_DATA_F0_0:RW:24:8:=0x00 MR20_DATA_0:RD:16:8:=0x00 MR17_DATA_0:RW:8:8:=0x00 MR16_DATA_0:RW:0:8:=0x00
                    181 0x00040606    //  181: MR2_DATA_F0_1:RW:24:8:=0x00 MR1_DATA_F0_1:RW:16:8:=0x04 MR22_DATA_F2_0:RW:8:8:=0x00 MR22_DATA_F1_0:RW:0:8:=0x00
                    182 0x3F743664    //  182: MR2_DATA_F2_1:RW:24:8:=0x3f MR1_DATA_F2_1:RW:16:8:=0x74 MR2_DATA_F1_1:RW:8:8:=0x2d MR1_DATA_F1_1:RW:0:8:=0x54
                    185 0x32363600    //  185: MR12_DATA_F0_1:RW:24:8:=0x00 MR11_DATA_F2_1:RW:16:8:=0x00 MR11_DATA_F1_1:RW:8:8:=0x00 MR11_DATA_F0_1:RW:0:8:=0x00
                    186 0x32C80E0E    //  186: MR14_DATA_F0_1:RW:24:8:=0x00 MR13_DATA_1:RW:16:8:=0x00 MR12_DATA_F2_1:RW:8:8:=0x00 MR12_DATA_F1_1:RW:0:8:=0x00
                    187 0x00000E0E    //  187: MR17_DATA_1:RW:24:8:=0x00 MR16_DATA_1:RW:16:8:=0x00 MR14_DATA_F2_1:RW:8:8:=0x00 MR14_DATA_F1_1:RW:0:8:=0x00
                    188 0x3E3E3E00    //  188: MR22_DATA_F2_1:RW:24:8:=0x00 MR22_DATA_F1_1:RW:16:8:=0x00 MR22_DATA_F0_1:RW:8:8:=0x00 MR20_DATA_1:RD:0:8:=0x00
                    190 0x01000000    //  190: FSP_PHY_UPDATE_MRW:RW:24:1:=0x00 RESERVED:RD:16:1:=0x00 RESERVED:RD:8:1:=0x00 RL3_SUPPORT_EN:RD:0:2:=0x00
                    191 0x01010001    //  191: FSP_WR_CURRENT:RW+:24:1:=0x00 FSP_OP_CURRENT:RW+:16:1:=0x00 FSP_STATUS:RW:8:1:=0x00 DFS_ALWAYS_WRITE_FSP:RW:0:1:=0x01
                    272 0x02020000    //  272: ROW_DIFF_1:RW:24:3:=0x00 ROW_DIFF_0:RW:16:3:=0x00 BANK_DIFF_1:RW:8:2:=0x00 BANK_DIFF_0:RW:0:2:=0x00
                    274 0x000007FF    //  274: ROW_START_VAL_0:RW:16:3:=0x00 CS_VAL_UPPER_0:RW:0:16:=0x1fff
                    276 0x00FF0000    //  276: CS_MSK_0:RW:16:16:=0x03ff CS_MAP_NON_POW2:RW:8:2:=0x00 ROW_START_VAL_1:RW:0:3:=0x00
                    278 0x25250B00    //  278: COMMAND_AGE_COUNT:RW:24:8:=0xff AGE_COUNT:RW:16:8:=0xff APREBIT:RW_D:8:5:=0x0b RESERVED:RW:0:1:=0x00
                    281 0x01180001    //  281: SWAP_EN:RW:24:1:=0x01 NUM_Q_ENTRIES_ACT_DISABLE:RW:16:5:=0x18 DISABLE_RW_GROUP_W_BNK_CONFLICT:RW:8:2:=0x01 W2R_SPLIT_EN:RW:0:1:=0x01
                    282 0x00010000    //  282: REDUC:RW:24:1:=0x00 CS_MAP:RW:16:2:=0x03 INHIBIT_DRAM_CMD:RW:8:2:=0x00 DISABLE_RD_INTERLEAVE:RW:0:1:=0x00
                    323 0x050A0A03    //  323: RD_TO_ODTH_F0:RW:24:6:=0x05 WR_TO_ODTH_F2:RW:16:6:=0x0a WR_TO_ODTH_F1:RW:8:6:=0x08 WR_TO_ODTH_F0:RW:0:6:=0x03
                    324 0x0C081F1C    //  324: RW2MRW_DLY_F1:RW_D:24:5:=0x0c RW2MRW_DLY_F0:RW_D:16:5:=0x08 RD_TO_ODTH_F2:RW:8:6:=0x1f RD_TO_ODTH_F1:RW:0:6:=0x18
                    326 0x0A0C020E    //  326: W2R_DIFFCS_DLY_F1:RW_D:24:5:=0x0a R2W_DIFFCS_DLY_F1:RW_D:16:5:=0x0a R2R_DIFFCS_DLY_F1:RW_D:8:5:=0x02 W2W_DIFFCS_DLY_F0:RW_D:0:5:=0x0e
                    328 0x0C080007    //  328: R2W_SAMECS_DLY_F1:RW_D:24:5:=0x0a R2W_SAMECS_DLY_F0:RW_D:16:5:=0x08 R2R_SAMECS_DLY:RW:8:5:=0x00 W2W_DIFFCS_DLY_F2:RW_D:0:5:=0x07
                    331 0x04000104    //  331: AXI0_R_PRIORITY:RW:24:3:=0x04 AXI0_FIXED_PORT_PRIORITY_ENABLE:RW:16:1:=0x00 AXI0_ALL_STROBES_USED_ENABLE:RW:8:1:=0x00 TDQSCK_MIN_F2:RW:0:3:=0x04
                    332 0x04000104    //  332: AXI1_R_PRIORITY:RW:24:3:=0x04 AXI1_FIXED_PORT_PRIORITY_ENABLE:RW:16:1:=0x00 AXI1_ALL_STROBES_USED_ENABLE:RW:8:1:=0x00 AXI0_W_PRIORITY:RW:0:3:=0x04
                    365 0x00000C14    //  365: WRLAT_ADJ_F1:RW:8:7:=0x0a RDLAT_ADJ_F1:RW:0:7:=0x10
                    376 0x0B1E091A    //  376: TDFI_WRCSLAT_F2:RW:24:7:=0x0b TDFI_RDCSLAT_F2:RW:16:7:=0x1e TDFI_WRCSLAT_F1:RW:8:7:=0x07 TDFI_RDCSLAT_F1:RW:0:7:=0x16
                    385 0x22060001    //  385: NWR_F1:RW:24:8:=0x1e NWR_F0:RW:16:8:=0x06 AXI_PARITY_ERROR_STATUS:RD:8:2:=0x00 GLOBAL_ERROR_MASK:RW:0:8:=0x00
                >;

                DDR_PI_registers = <
                    29 0x05000000    //  29: PI_WRLVL_CS_MAP:RW:24:4:=0x0f PI_WRLVL_ROTATE:RW:16:1:=0x00 PI_WRLVL_RESP_MASK:RW:8:4:=0x00 PI_WRLVL_DISABLE_DFS:RW:0:1:=0x00
                    45 0x00050500    //  45: PI_RDLVL_GATE_CS_MAP:RW:16:4:=0x0f PI_RDLVL_CS_MAP:RW:8:4:=0x0f PI_RDLVL_GATE_ROTATE:RW:0:1:=0x00
                    55 0x05000000    //  55: PI_CALVL_CS_MAP:RW:24:4:=0x0f PI_CALVL_ROTATE:RW:16:1:=0x00 PI_CALVL_DISABLE_DFS:RW:8:1:=0x00 PI_CALVL_ON_SREF_EXIT:RW:0:1:=0x00
                    61 0x10020101    //  61: PI_TDFI_INIT_START_MIN:RW:24:8:=0x10 PI_CALVL_VREF_NORMAL_STEPSIZE:RW:16:4:=0x02 PI_CALVL_VREF_INITIAL_STEPSIZE:RW:8:4:=0x04 PI_CA_TRAIN_VREF_EN:RW:0:1:=0x01
                    67 0x00020105    //  67: PI_WDQLVL_PERIODIC:RW:24:1:=0x00 PI_WDQLVL_VREF_NORMAL_STEPSIZE:RW:16:5:=0x02 PI_WDQLVL_VREF_INITIAL_STEPSIZE:RW:8:5:=0x04 PI_WDQLVL_CS_MAP:RW:0:4:=0x0f
                    73 0x00080200    //  73: RESERVED:RW_D:24:4:=0x00 PI_TCCD:RW:16:5:=0x08 PI_ROW_DIFF:RW:8:3:=0x00 PI_BANK_DIFF:RW:0:2:=0x00
                    139 0x00000100    //  139: PI_DLL_RST_DELAY:RW:16:16:=0x0000 PI_DRAM_INIT_EN:RW:8:1:=0x00 PI_DLL_RST:RW:0:1:=0x00
                    165 0x0000005B    //  165: PI_TDELAY_RDWR_2_BUS_IDLE_F1:RW:0:8:=0x57
                    168 0x40100C04    //  168: PI_CASLAT_LIN_F1:RW:24:7:=0x38 PI_WRLAT_F1:RW:16:7:=0x0e PI_CASLAT_LIN_F0:RW:8:7:=0x0c PI_WRLAT_F0:RW:0:7:=0x04
                    169 0x00094812    //  169: PI_TRFC_F0:RW:16:10:=0x0013 PI_CASLAT_LIN_F2:RW:8:7:=0x48 PI_WRLAT_F2:RW:0:7:=0x12
                    171 0x00000120    //  171: PI_TRFC_F1:RW:0:10:=0x0260
                    173 0x00000180    //  173: PI_TRFC_F2:RW:0:10:=0x032b
                    185 0x14040300    //  185: PI_RDLAT_ADJ_F1:RW:24:7:=0x10 PI_RDLAT_ADJ_F0:RW:16:7:=0x04 PI_RDLVL_MULTI_EN_F2:RW:8:2:=0x00 PI_RDLVL_DFE_EN_F2:RW:0:2:=0x00
                    186 0x0E0C0215    //  186: PI_WRLAT_ADJ_F2:RW:24:7:=0x0e PI_WRLAT_ADJ_F1:RW:16:7:=0x0a PI_WRLAT_ADJ_F0:RW:8:7:=0x02 PI_RDLAT_ADJ_F2:RW:0:7:=0x15
                    199 0x100C322E    //  199: PI_CALVL_VREF_INITIAL_STOP_POINT_F1:RW:24:7:=0x1e PI_CALVL_VREF_INITIAL_START_POINT_F1:RW:16:7:=0x1a PI_CALVL_VREF_INITIAL_STOP_POINT_F0:RW:8:7:=0x1e PI_CALVL_VREF_INITIAL_START_POINT_F0:RW:0:7:=0x1a
                    200 0x0101100C    //  200: PI_CALVL_VREF_DELTA_F1:RW:24:4:=0x01 PI_CALVL_VREF_DELTA_F0:RW:16:4:=0x01 PI_CALVL_VREF_INITIAL_STOP_POINT_F2:RW:8:7:=0x1e PI_CALVL_VREF_INITIAL_START_POINT_F2:RW:0:7:=0x1a
                    211 0x322E0056    //  211: PI_WDQLVL_VREF_INITIAL_STOP_POINT_F0:RW:24:7:=0x1e PI_WDQLVL_VREF_INITIAL_START_POINT_F0:RW:16:7:=0x1a PI_TDFI_WDQLVL_RW_F0:RW:0:10:=0x0056
                    213 0x005C002E    //  213: PI_TDFI_WDQLVL_RW_F1:RW:16:10:=0x005a PI_TDFI_WDQLVL_WR_F1:RW:0:10:=0x002c
                    214 0x0101100C    //  214: PI_WDQLVL_EN_F1:RW:24:2:=0x01 PI_WDQLVL_VREF_DELTA_F1:RW:16:4:=0x01 PI_WDQLVL_VREF_INITIAL_STOP_POINT_F1:RW:8:7:=0x1e PI_WDQLVL_VREF_INITIAL_START_POINT_F1:RW:0:7:=0x1a
                    216 0x100C005B    //  216: PI_WDQLVL_VREF_INITIAL_STOP_POINT_F2:RW:24:7:=0x1e PI_WDQLVL_VREF_INITIAL_START_POINT_F2:RW:16:7:=0x1a PI_TDFI_WDQLVL_RW_F2:RW:0:10:=0x005b
                    235 0x012C000A    //  235: PI_TXSR_F1:RW:16:16:=0x026c PI_TXSR_F0:RW:0:16:=0x0014
                    236 0x03030190    //  236: PI_TEXCKE_F1:RW:24:6:=0x03 PI_TEXCKE_F0:RW:16:6:=0x03 PI_TXSR_F2:RW:0:16:=0x033b
                    241 0x0000000A    //  241: PI_TXSNR_F0:RW:0:16:=0x0014
                    246 0x0000012C    //  246: PI_TXSNR_F1:RW:0:16:=0x026c
                    251 0x01000190    //  251: RESERVED:RW:16:12:=0x0100 PI_TXSNR_F2:RW:0:16:=0x033b
                    259 0x08040404    //  259: PI_MR13_DATA_0:RW+:24:8:=0x00 PI_WDQ_OSC_DELTA_INDEX_F2:RW:16:4:=0x04 PI_WDQ_OSC_DELTA_INDEX_F1:RW:8:4:=0x04 PI_WDQ_OSC_DELTA_INDEX_F0:RW:0:4:=0x04
                    261 0x55083C5A    //  261: PI_MR15_DATA_1:RW:24:8:=0x55 PI_MR13_DATA_1:RW+:16:8:=0x00 PI_MR40_DATA_0:RW:8:8:=0x3c PI_MR32_DATA_0:RW:0:8:=0x5a
                    263 0x0055083C    //  263: PI_MR16_DATA_2:RW:24:8:=0x00 PI_MR15_DATA_2:RW:16:8:=0x55 PI_MR13_DATA_2:RW+:8:8:=0x00 PI_MR40_DATA_1:RW:0:8:=0x3c
                    265 0x00005508    //  265: PI_MR17_DATA_3:RW:24:8:=0x00 PI_MR16_DATA_3:RW:16:8:=0x00 PI_MR15_DATA_3:RW:8:8:=0x55 PI_MR13_DATA_3:RW+:0:8:=0x00
                    276 0x00063232    //  276: PI_MR23_DATA_F0_0:RW:24:8:=0x00 PI_MR22_DATA_F0_0:RW+:16:8:=0x00 PI_MR14_DATA_F0_0:RW+:8:8:=0x4d PI_MR12_DATA_F0_0:RW+:0:8:=0x4d
                    277 0x36313664    //  277: PI_MR11_DATA_F1_0:RW+:24:8:=0x00 PI_MR3_DATA_F1_0:RW+:16:8:=0x31 PI_MR2_DATA_F1_0:RW+:8:8:=0x2d PI_MR1_DATA_F1_0:RW+:0:8:=0x54
                    278 0x00060E0E    //  278: PI_MR23_DATA_F1_0:RW:24:8:=0x00 PI_MR22_DATA_F1_0:RW+:16:8:=0x00 PI_MR14_DATA_F1_0:RW+:8:8:=0x4d PI_MR12_DATA_F1_0:RW+:0:8:=0x4d
                    279 0x36313F74    //  279: PI_MR11_DATA_F2_0:RW+:24:8:=0x00 PI_MR3_DATA_F2_0:RW+:16:8:=0x31 PI_MR2_DATA_F2_0:RW+:8:8:=0x3f PI_MR1_DATA_F2_0:RW+:0:8:=0x74
                    280 0x00060E0E    //  280: PI_MR23_DATA_F2_0:RW:24:8:=0x00 PI_MR22_DATA_F2_0:RW+:16:8:=0x00 PI_MR14_DATA_F2_0:RW+:8:8:=0x4d PI_MR12_DATA_F2_0:RW+:0:8:=0x4d
                    282 0x003E3232    //  282: PI_MR23_DATA_F0_1:RW:24:8:=0x00 PI_MR22_DATA_F0_1:RW+:16:8:=0x00 PI_MR14_DATA_F0_1:RW+:8:8:=0x4d PI_MR12_DATA_F0_1:RW+:0:8:=0x4d
                    283 0x36313664    //  283: PI_MR11_DATA_F1_1:RW+:24:8:=0x00 PI_MR3_DATA_F1_1:RW+:16:8:=0x31 PI_MR2_DATA_F1_1:RW+:8:8:=0x2d PI_MR1_DATA_F1_1:RW+:0:8:=0x54
                    284 0x003E0E0E    //  284: PI_MR23_DATA_F1_1:RW:24:8:=0x00 PI_MR22_DATA_F1_1:RW+:16:8:=0x00 PI_MR14_DATA_F1_1:RW+:8:8:=0x4d PI_MR12_DATA_F1_1:RW+:0:8:=0x4d
                    285 0x36313F74    //  285: PI_MR11_DATA_F2_1:RW+:24:8:=0x00 PI_MR3_DATA_F2_1:RW+:16:8:=0x31 PI_MR2_DATA_F2_1:RW+:8:8:=0x3f PI_MR1_DATA_F2_1:RW+:0:8:=0x74
                    286 0x003E0E0E    //  286: PI_MR23_DATA_F2_1:RW:24:8:=0x00 PI_MR22_DATA_F2_1:RW+:16:8:=0x00 PI_MR14_DATA_F2_1:RW+:8:8:=0x4d PI_MR12_DATA_F2_1:RW+:0:8:=0x4d
                    288 0x00063232    //  288: PI_MR23_DATA_F0_2:RW:24:8:=0x00 PI_MR22_DATA_F0_2:RW+:16:8:=0x00 PI_MR14_DATA_F0_2:RW+:8:8:=0x4d PI_MR12_DATA_F0_2:RW+:0:8:=0x4d
                    289 0x36313664    //  289: PI_MR11_DATA_F1_2:RW+:24:8:=0x00 PI_MR3_DATA_F1_2:RW+:16:8:=0x31 PI_MR2_DATA_F1_2:RW+:8:8:=0x2d PI_MR1_DATA_F1_2:RW+:0:8:=0x54
                    290 0x00060E0E    //  290: PI_MR23_DATA_F1_2:RW:24:8:=0x00 PI_MR22_DATA_F1_2:RW+:16:8:=0x00 PI_MR14_DATA_F1_2:RW+:8:8:=0x4d PI_MR12_DATA_F1_2:RW+:0:8:=0x4d
                    291 0x36313F74    //  291: PI_MR11_DATA_F2_2:RW+:24:8:=0x00 PI_MR3_DATA_F2_2:RW+:16:8:=0x31 PI_MR2_DATA_F2_2:RW+:8:8:=0x3f PI_MR1_DATA_F2_2:RW+:0:8:=0x74
                    292 0x00060E0E    //  292: PI_MR23_DATA_F2_2:RW:24:8:=0x00 PI_MR22_DATA_F2_2:RW+:16:8:=0x00 PI_MR14_DATA_F2_2:RW+:8:8:=0x4d PI_MR12_DATA_F2_2:RW+:0:8:=0x4d
                    294 0x003E3232    //  294: PI_MR23_DATA_F0_3:RW:24:8:=0x00 PI_MR22_DATA_F0_3:RW+:16:8:=0x00 PI_MR14_DATA_F0_3:RW+:8:8:=0x4d PI_MR12_DATA_F0_3:RW+:0:8:=0x4d
                    295 0x36313664    //  295: PI_MR11_DATA_F1_3:RW+:24:8:=0x00 PI_MR3_DATA_F1_3:RW+:16:8:=0x31 PI_MR2_DATA_F1_3:RW+:8:8:=0x2d PI_MR1_DATA_F1_3:RW+:0:8:=0x54
                    296 0x003E0E0E    //  296: PI_MR23_DATA_F1_3:RW:24:8:=0x00 PI_MR22_DATA_F1_3:RW+:16:8:=0x00 PI_MR14_DATA_F1_3:RW+:8:8:=0x4d PI_MR12_DATA_F1_3:RW+:0:8:=0x4d
                    297 0x36313F74    //  297: PI_MR11_DATA_F2_3:RW+:24:8:=0x00 PI_MR3_DATA_F2_3:RW+:16:8:=0x31 PI_MR2_DATA_F2_3:RW+:8:8:=0x3f PI_MR1_DATA_F2_3:RW+:0:8:=0x74
                    298 0x003E0E0E    //  298: PI_MR23_DATA_F2_3:RW:24:8:=0x00 PI_MR22_DATA_F2_3:RW+:16:8:=0x00 PI_MR14_DATA_F2_3:RW+:8:8:=0x4d PI_MR12_DATA_F2_3:RW+:0:8:=0x4d
                >;

                DDR_PHY_registers = <
                    5 0x01010000    //  5: PHY_PER_CS_TRAINING_MULTICAST_EN_0:RW_D:24:1:=0x01 PHY_PER_RANK_CS_MAP_0:RW+:16:2:=0x03 PHY_SW_WRDQS_SHIFT_0:RW:8:4:=0x00 PHY_SW_WRDM_SHIFT_0:RW:0:6:=0x00
                    12 0x00000100    //  12: PHY_VREF_TRAIN_OBS_0:RD:16:7:=0x00 PHY_VREF_INITIAL_STEPSIZE_0:RW:8:6:=0x04 PHY_RDLVL_MULTI_PATT_RST_DISABLE_0:RW:0:1:=0x00
                    85 0x3A03CC0C    //  85: PHY_VREF_INITIAL_START_POINT_0:RW+:24:7:=0x20 PHY_TWO_CYC_PREAMBLE_0:RW+:16:2:=0x03 PHY_DQS_TSEL_SELECT_0:RW+:0:16:=0x4408
                    86 0x20000142    //  86: PHY_NTP_WDQ_STEP_SIZE_0:RW+:24:8:=0x20 PHY_NTP_TRAIN_EN_0:RW+:16:1:=0x00 PHY_VREF_TRAINING_CTRL_0:RW+:8:2:=0x01 PHY_VREF_INITIAL_STOP_POINT_0:RW+:0:7:=0x25
                    100 0x09BE00A0    //  100: PHY_PAD_VREF_CTRL_DQ_0:RW+:16:12:=0x069f PHY_VREF_SETTING_TIME_0:RW+:0:16:=0x0004
                    261 0x01010000    //  261: PHY_PER_CS_TRAINING_MULTICAST_EN_1:RW_D:24:1:=0x01 PHY_PER_RANK_CS_MAP_1:RW+:16:2:=0x03 PHY_SW_WRDQS_SHIFT_1:RW:8:4:=0x00 PHY_SW_WRDM_SHIFT_1:RW:0:6:=0x00
                    268 0x00000100    //  268: PHY_VREF_TRAIN_OBS_1:RD:16:7:=0x00 PHY_VREF_INITIAL_STEPSIZE_1:RW:8:6:=0x04 PHY_RDLVL_MULTI_PATT_RST_DISABLE_1:RW:0:1:=0x00
                    341 0x3A03CC0C    //  341: PHY_VREF_INITIAL_START_POINT_1:RW+:24:7:=0x20 PHY_TWO_CYC_PREAMBLE_1:RW+:16:2:=0x03 PHY_DQS_TSEL_SELECT_1:RW+:0:16:=0x4408
                    342 0x20000142    //  342: PHY_NTP_WDQ_STEP_SIZE_1:RW+:24:8:=0x20 PHY_NTP_TRAIN_EN_1:RW+:16:1:=0x00 PHY_VREF_TRAINING_CTRL_1:RW+:8:2:=0x01 PHY_VREF_INITIAL_STOP_POINT_1:RW+:0:7:=0x25
                    356 0x09BE00A0    //  356: PHY_PAD_VREF_CTRL_DQ_1:RW+:16:12:=0x069f PHY_VREF_SETTING_TIME_1:RW+:0:16:=0x0004
                    517 0x01010000    //  517: PHY_PER_CS_TRAINING_MULTICAST_EN_2:RW_D:24:1:=0x01 PHY_PER_RANK_CS_MAP_2:RW+:16:2:=0x03 PHY_SW_WRDQS_SHIFT_2:RW:8:4:=0x00 PHY_SW_WRDM_SHIFT_2:RW:0:6:=0x00
                    524 0x00000100    //  524: PHY_VREF_TRAIN_OBS_2:RD:16:7:=0x00 PHY_VREF_INITIAL_STEPSIZE_2:RW:8:6:=0x04 PHY_RDLVL_MULTI_PATT_RST_DISABLE_2:RW:0:1:=0x00
                    597 0x3A03CC0C    //  597: PHY_VREF_INITIAL_START_POINT_2:RW+:24:7:=0x20 PHY_TWO_CYC_PREAMBLE_2:RW+:16:2:=0x03 PHY_DQS_TSEL_SELECT_2:RW+:0:16:=0x4408
                    598 0x20000142    //  598: PHY_NTP_WDQ_STEP_SIZE_2:RW+:24:8:=0x20 PHY_NTP_TRAIN_EN_2:RW+:16:1:=0x00 PHY_VREF_TRAINING_CTRL_2:RW+:8:2:=0x01 PHY_VREF_INITIAL_STOP_POINT_2:RW+:0:7:=0x25
                    612 0x09BE00A0    //  612: PHY_PAD_VREF_CTRL_DQ_2:RW+:16:12:=0x069f PHY_VREF_SETTING_TIME_2:RW+:0:16:=0x0004
                    773 0x01010000    //  773: PHY_PER_CS_TRAINING_MULTICAST_EN_3:RW_D:24:1:=0x01 PHY_PER_RANK_CS_MAP_3:RW+:16:2:=0x03 PHY_SW_WRDQS_SHIFT_3:RW:8:4:=0x00 PHY_SW_WRDM_SHIFT_3:RW:0:6:=0x00
                    780 0x00000100    //  780: PHY_VREF_TRAIN_OBS_3:RD:16:7:=0x00 PHY_VREF_INITIAL_STEPSIZE_3:RW:8:6:=0x04 PHY_RDLVL_MULTI_PATT_RST_DISABLE_3:RW:0:1:=0x00
                    853 0x3A03CC0C    //  853: PHY_VREF_INITIAL_START_POINT_3:RW+:24:7:=0x20 PHY_TWO_CYC_PREAMBLE_3:RW+:16:2:=0x03 PHY_DQS_TSEL_SELECT_3:RW+:0:16:=0x4408
                    854 0x20000142    //  854: PHY_NTP_WDQ_STEP_SIZE_3:RW+:24:8:=0x20 PHY_NTP_TRAIN_EN_3:RW+:16:1:=0x00 PHY_VREF_TRAINING_CTRL_3:RW+:8:2:=0x01 PHY_VREF_INITIAL_STOP_POINT_3:RW+:0:7:=0x25
                    868 0x09BE00A0    //  868: PHY_PAD_VREF_CTRL_DQ_3:RW+:16:12:=0x069f PHY_VREF_SETTING_TIME_3:RW+:0:16:=0x0004
                    1064 0x000604CC    //  1064: PHY_PAD_ADR_IO_CFG_0:RW+:16:11:=0x0000 PHY_ADR_DC_CAL_CLK_SEL_0:RW+:8:3:=0x02 PHY_ADR_TSEL_SELECT_0:RW+:0:8:=0x44
                    1293 0x50020040    //  1293: PHY_CALVL_CS_MAP:RW:24:8:=0x50 PHY_CSLVL_COARSE_CAPTURE_CNT:RW:16:4:=0x02 PHY_CSLVL_COARSE_CHK:RW:0:11:=0x0028
                    1330 0x00001294    //  1330: PHY_CAL_START_0:WR:24:1:=0x00 PHY_CAL_CLEAR_0:WR:16:1:=0x00 PHY_CAL_MODE_0:RW:0:13:=0x0064
                    1393 0x0003EF80    //  1393: PHY_PAD_CAL_IO_CFG_0:RW+:0:18:=0x000000
                    1406 0x3184BFCC    //  1406: PHY_PAD_FDBK_DRIVE:RW+:0:30:=0x00030044
                    1408 0x0C000E7F    //  1408: PHY_PAD_DATA_DRIVE:RW+:0:31:=0x00000180
                    1409 0x30000E7F    //  1409: PHY_PAD_DQS_DRIVE:RW+:0:32:=0x00000180
                    1410 0x300E7F11    //  1410: PHY_PAD_ADDR_DRIVE:RW+:0:30:=0x00018011
                    1412 0x000E7FCC    //  1412: PHY_PAD_CLK_DRIVE:RW+:0:32:=0x00018044
                    1414 0x300E7F11    //  1414: PHY_PAD_CKE_DRIVE:RW+:0:30:=0x00018011
                    1416 0x300E7F11    //  1416: PHY_PAD_RST_DRIVE:RW+:0:30:=0x00018011
                    1418 0x300E7F11    //  1418: PHY_PAD_CS_DRIVE:RW+:0:30:=0x00018011
                >;

            };
        };
    };
};
