// SPDX-License-Identifier: GPL-2.0
/*
 * dts file for Hailo10 (board-sku-16).
 *
 * Copyright (c) 2019-2025 Hailo Technologies Ltd. All rights reserved.
 */
#include "hailo10-m2-base.dtsi"
#include "hailo1x_ddr_MT53E256M32D1-046_regconfig_1GB_LP4.dtsi"
