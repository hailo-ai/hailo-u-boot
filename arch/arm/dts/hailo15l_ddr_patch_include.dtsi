// SPDX-License-Identifier: GPL-2.0
/*
 * dts file for Hailo15 ddr_MT53E1G32D2FW-046
 *
 * Copyright (c) 2019-2023 Hailo Technologies Ltd. All rights reserved.
 */

#include "hailo1x_ddr_MT53E1G32D2FW-046-C_regconfig_4GB_LP4_patch.dtsi"
#include "hailo15l_ddr_MT53E512M32D1-046_regconfig_2GB_LP4X_patch.dtsi"
#include "hailo15l_ddr_MT53E512M32D1-046_regconfig_2GB_patch.dtsi"
#include "hailo1x_ddr_MT53E256M32D1-046_regconfig_1GB_LP4_patch.dtsi"
#include "hailo1x_ddr_MT53E256M32D1-046_regconfig_1GB_LP4X_patch.dtsi"
#include "hailo1x_ddr_MT53E256M32D2-046_regconfig_1GB_LP4X_patch.dtsi"