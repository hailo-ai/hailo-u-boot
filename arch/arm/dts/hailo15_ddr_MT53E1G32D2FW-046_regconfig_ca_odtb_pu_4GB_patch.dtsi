// SPDX-License-Identifier: GPL-2.0
/*
 * dts file for Hailo15 SoC
 *
 * Copyright (c) 2019-2023 Hailo Technologies Ltd. All rights reserved.
 */

&hailo_boot_info {
    ddr_config {
        ddr_patches {
            MT53E1G32D2FW-046_regconfig_ca_odtb_pu_4GB {
                mr0 = <0xb9>;
                mr5 = <0xff>;
                mr6 = <0x7>;
                mr8 = <0x10>;
                mr12 = <0x4d>;
                num_of_ranks = <2>;
                DDR_ctrl_registers = <
                    177 0x00040000    //  177: MR11_DATA_F1_0:RW:24:8:=0x00 MR11_DATA_F0_0:RW:16:8:=0x00 MR8_DATA_0:RD:8:8:=0x00 MR4_DATA_F2_0:RW:0:8:=0x00
                    178 0x17171700    //  178: MR12_DATA_F2_0:RW:24:8:=0x00 MR12_DATA_F1_0:RW:16:8:=0x00 MR12_DATA_F0_0:RW:8:8:=0x00 MR11_DATA_F2_0:RW:0:8:=0x00
                    179 0x4D4D0F00    //  179: MR14_DATA_F2_0:RW:24:8:=0x00 MR14_DATA_F1_0:RW:16:8:=0x00 MR14_DATA_F0_0:RW:8:8:=0x00 MR13_DATA_0:RW:0:8:=0x00
                    180 0x05000000    //  180: MR22_DATA_F0_0:RW:24:8:=0x00 MR20_DATA_0:RD:16:8:=0x00 MR17_DATA_0:RW:8:8:=0x00 MR16_DATA_0:RW:0:8:=0x00
                    181 0x00040505    //  181: MR2_DATA_F0_1:RW:24:8:=0x00 MR1_DATA_F0_1:RW:16:8:=0x04 MR22_DATA_F2_0:RW:8:8:=0x00 MR22_DATA_F1_0:RW:0:8:=0x00
                    185 0x17000004    //  185: MR12_DATA_F0_1:RW:24:8:=0x00 MR11_DATA_F2_1:RW:16:8:=0x00 MR11_DATA_F1_1:RW:8:8:=0x00 MR11_DATA_F0_1:RW:0:8:=0x00
                    186 0x0F001717    //  186: MR14_DATA_F0_1:RW:24:8:=0x00 MR13_DATA_1:RW:16:8:=0x00 MR12_DATA_F2_1:RW:8:8:=0x00 MR12_DATA_F1_1:RW:0:8:=0x00
                    187 0x00004D4D    //  187: MR17_DATA_1:RW:24:8:=0x00 MR16_DATA_1:RW:16:8:=0x00 MR14_DATA_F2_1:RW:8:8:=0x00 MR14_DATA_F1_1:RW:0:8:=0x00
                    188 0x05050500    //  188: MR22_DATA_F2_1:RW:24:8:=0x00 MR22_DATA_F1_1:RW:16:8:=0x00 MR22_DATA_F0_1:RW:8:8:=0x00 MR20_DATA_1:RD:0:8:=0x00
                    272 0x01010000    //  272: ROW_DIFF_1:RW:24:3:=0x00 ROW_DIFF_0:RW:16:3:=0x00 BANK_DIFF_1:RW:8:2:=0x00 BANK_DIFF_0:RW:0:2:=0x00
                    274 0x00000FFF    //  274: ROW_START_VAL_0:RW:16:3:=0x00 CS_VAL_UPPER_0:RW:0:16:=0x1fff
                    275 0x1FFF1000    //  275: CS_VAL_UPPER_1:RW:16:16:=0x3fff CS_VAL_LOWER_1:RW:0:16:=0x2000
                    276 0x01FF0000    //  276: CS_MSK_0:RW:16:16:=0x03ff CS_MAP_NON_POW2:RW:8:2:=0x00 ROW_START_VAL_1:RW:0:3:=0x00
                    277 0x000001FF    //  277: RESERVED:RW:24:5:=0x00 CS_LOWER_ADDR_EN:RW:16:1:=0x00 CS_MSK_1:RW:0:16:=0x03ff
                    291 0x01010000    //  291: DEVICE0_BYTE0_CS1:RW:24:4:=0x01 MEMDATA_RATIO_1:RW:16:3:=0x01 DEVICE3_BYTE0_CS0:RW:8:4:=0x00 DEVICE2_BYTE0_CS0:RW:0:4:=0x00
                    292 0x00000004    //  292: Q_FULLNESS:RW:24:5:=0x00 DEVICE3_BYTE0_CS1:RW:16:4:=0x00 DEVICE2_BYTE0_CS1:RW:8:4:=0x00 DEVICE1_BYTE0_CS1:RW:0:4:=0x04
                >;

                DDR_PI_registers = <
                    14 0x0800000F    //  14: PI_TMRR:RW:24:4:=0x08 PI_SRX_LVL_TARGET_CS_EN:RW:16:1:=0x00 PI_RANK_NUM_PER_CKE:RW:8:5:=0x00 PI_CS_MAP:RW:0:4:=0x0f
                    61 0x10020401    //  61: PI_TDFI_INIT_START_MIN:RW:24:8:=0x10 PI_CALVL_VREF_NORMAL_STEPSIZE:RW:16:4:=0x02 PI_CALVL_VREF_INITIAL_STEPSIZE:RW:8:4:=0x04 PI_CA_TRAIN_VREF_EN:RW:0:1:=0x01
                    67 0x0002040F    //  67: PI_WDQLVL_PERIODIC:RW:24:1:=0x00 PI_WDQLVL_VREF_NORMAL_STEPSIZE:RW:16:5:=0x02 PI_WDQLVL_VREF_INITIAL_STEPSIZE:RW:8:5:=0x04 PI_WDQLVL_CS_MAP:RW:0:4:=0x0f
                    73 0x00080100    //  73: RESERVED:RW_D:24:4:=0x00 PI_TCCD:RW:16:5:=0x08 PI_ROW_DIFF:RW:8:3:=0x00 PI_BANK_DIFF:RW:0:2:=0x00
                >;

                DDR_PHY_registers = <
                    12 0x00000400    //  12: PHY_VREF_TRAIN_OBS_0:RD:16:7:=0x00 PHY_VREF_INITIAL_STEPSIZE_0:RW:8:6:=0x04 PHY_RDLVL_MULTI_PATT_RST_DISABLE_0:RW:0:1:=0x00
                    268 0x00000400    //  268: PHY_VREF_TRAIN_OBS_1:RD:16:7:=0x00 PHY_VREF_INITIAL_STEPSIZE_1:RW:8:6:=0x04 PHY_RDLVL_MULTI_PATT_RST_DISABLE_1:RW:0:1:=0x00
                    524 0x00000400    //  524: PHY_VREF_TRAIN_OBS_2:RD:16:7:=0x00 PHY_VREF_INITIAL_STEPSIZE_2:RW:8:6:=0x04 PHY_RDLVL_MULTI_PATT_RST_DISABLE_2:RW:0:1:=0x00
                    780 0x00000400    //  780: PHY_VREF_TRAIN_OBS_3:RD:16:7:=0x00 PHY_VREF_INITIAL_STEPSIZE_3:RW:8:6:=0x04 PHY_RDLVL_MULTI_PATT_RST_DISABLE_3:RW:0:1:=0x00
                >;

            };
        };
    };
};
