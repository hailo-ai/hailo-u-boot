// SPDX-License-Identifier: GPL-2.0
/*
 * dts file for Hailo15 SoC
 *
 * Copyright (c) 2019-2023 Hailo Technologies Ltd. All rights reserved.
 */

&hailo_boot_info {
    ddr_config {
        ddr_patches {
            W66DP2RQQAHJ_regconfig_1GB_LP4X {
                reg_config_version = "2.5";
                mr0 = <0x38>;
                mr5 = <0x8>;
                mr6 = <0x0>;
                mr8 = <0x8>;
                mr12 = <0x5d>;
                num_of_ranks = <1>;
                DDR_ctrl_registers = <
                    39 0x09040008    //  39: TWTR_F0:RW:24:6:=0x09 TRAS_MIN_F0:RW:16:8:=0x04 TRC_F0:RW:0:9:=0x0007
                    40 0x0D000204    //  40: TRRD_F1:RW:24:8:=0x0d TFAW_F0:RW:8:9:=0x0002 TRP_F0:RW:0:8:=0x03
                    54 0x08010100    //  54: TDAL_F0:RW:24:8:=0x07 TRAS_LOCKOUT:RW:16:1:=0x01 CONCURRENTAP:RW:8:1:=0x01 AP:RW:0:1:=0x00
                    55 0x0404503C    //  55: TRP_AB_F0_0:RW:24:8:=0x03 BSTLEN:RW_D:16:5:=0x04 TDAL_F2:RW:8:8:=0x50 TDAL_F1:RW:0:8:=0x3c
                    56 0x22042D22    //  56: TRP_AB_F1_1:RW:24:8:=0x22 TRP_AB_F0_1:RW:16:8:=0x03 TRP_AB_F2_0:RW:8:8:=0x2d TRP_AB_F1_0:RW:0:8:=0x22
                    60 0x00000007    //  60: TRFC_F0:RW:0:10:=0x0013
                    62 0x000000D0    //  62: TRFC_F1:RW:0:10:=0x0260
                    64 0x00000116    //  64: TRFC_F2:RW:0:10:=0x032b
                    67 0x00010000    //  67: TRFC_PB_F0:RW:16:10:=0x0005 PBR_NUMERIC_ORDER:RW:8:1:=0x00 PBR_EN:RW:0:1:=0x00
                    68 0x00300010    //  68: TRFC_PB_F1:RW:16:10:=0x0098 TREFI_PB_F0:RW:0:16:=0x0010
                    69 0x00400304    //  69: TRFC_PB_F2:RW:16:10:=0x00cb TREFI_PB_F1:RW:0:16:=0x0304
                    79 0x00070007    //  79: TXSNR_F0:RW:16:16:=0x0014 TXSR_F0:RW:0:16:=0x0014
                    80 0x00DC00DC    //  80: TXSNR_F1:RW:16:16:=0x026c TXSR_F1:RW:0:16:=0x026c
                    81 0x01260126    //  81: TXSNR_F2:RW:16:16:=0x033b TXSR_F2:RW:0:16:=0x033b
                    178 0x0E0E3236    //  178: MR12_DATA_F2_0:RW:24:8:=0x00 MR12_DATA_F1_0:RW:16:8:=0x00 MR12_DATA_F0_0:RW:8:8:=0x00 MR11_DATA_F2_0:RW:0:8:=0x00
                    179 0x0E0E32C8    //  179: MR14_DATA_F2_0:RW:24:8:=0x00 MR14_DATA_F1_0:RW:16:8:=0x00 MR14_DATA_F0_0:RW:8:8:=0x00 MR13_DATA_0:RW:0:8:=0x00
                    185 0x32363600    //  185: MR12_DATA_F0_1:RW:24:8:=0x00 MR11_DATA_F2_1:RW:16:8:=0x00 MR11_DATA_F1_1:RW:8:8:=0x00 MR11_DATA_F0_1:RW:0:8:=0x00
                    186 0x32C80E0E    //  186: MR14_DATA_F0_1:RW:24:8:=0x00 MR13_DATA_1:RW:16:8:=0x00 MR12_DATA_F2_1:RW:8:8:=0x00 MR12_DATA_F1_1:RW:0:8:=0x00
                    187 0x00000E0E    //  187: MR17_DATA_1:RW:24:8:=0x00 MR16_DATA_1:RW:16:8:=0x00 MR14_DATA_F2_1:RW:8:8:=0x00 MR14_DATA_F1_1:RW:0:8:=0x00
                    188 0x2E2E2E00    //  188: MR22_DATA_F2_1:RW:24:8:=0x00 MR22_DATA_F1_1:RW:16:8:=0x00 MR22_DATA_F0_1:RW:8:8:=0x00 MR20_DATA_1:RD:0:8:=0x00
                    272 0x02020000    //  272: ROW_DIFF_1:RW:24:3:=0x00 ROW_DIFF_0:RW:16:3:=0x00 BANK_DIFF_1:RW:8:2:=0x00 BANK_DIFF_0:RW:0:2:=0x00
                    274 0x000007FF    //  274: ROW_START_VAL_0:RW:16:3:=0x00 CS_VAL_UPPER_0:RW:0:16:=0x1fff
                    276 0x00FF0000    //  276: CS_MSK_0:RW:16:16:=0x03ff CS_MAP_NON_POW2:RW:8:2:=0x00 ROW_START_VAL_1:RW:0:3:=0x00
                    282 0x00010000    //  282: REDUC:RW:24:1:=0x00 CS_MAP:RW:16:2:=0x03 INHIBIT_DRAM_CMD:RW:8:2:=0x00 DISABLE_RD_INTERLEAVE:RW:0:1:=0x00
                >;

                DDR_PI_registers = <
                    73 0x00080200    //  73: RESERVED:RW_D:24:4:=0x00 PI_TCCD:RW:16:5:=0x08 PI_ROW_DIFF:RW:8:3:=0x00 PI_BANK_DIFF:RW:0:2:=0x00
                    169 0x00074812    //  169: PI_TRFC_F0:RW:16:10:=0x0013 PI_CASLAT_LIN_F2:RW:8:7:=0x48 PI_WRLAT_F2:RW:0:7:=0x12
                    171 0x000000D0    //  171: PI_TRFC_F1:RW:0:10:=0x0260
                    173 0x00000116    //  173: PI_TRFC_F2:RW:0:10:=0x032b
                    199 0x100C322E    //  199: PI_CALVL_VREF_INITIAL_STOP_POINT_F1:RW:24:7:=0x1e PI_CALVL_VREF_INITIAL_START_POINT_F1:RW:16:7:=0x1a PI_CALVL_VREF_INITIAL_STOP_POINT_F0:RW:8:7:=0x1e PI_CALVL_VREF_INITIAL_START_POINT_F0:RW:0:7:=0x1a
                    200 0x0101100C    //  200: PI_CALVL_VREF_DELTA_F1:RW:24:4:=0x01 PI_CALVL_VREF_DELTA_F0:RW:16:4:=0x01 PI_CALVL_VREF_INITIAL_STOP_POINT_F2:RW:8:7:=0x1e PI_CALVL_VREF_INITIAL_START_POINT_F2:RW:0:7:=0x1a
                    211 0x322E0056    //  211: PI_WDQLVL_VREF_INITIAL_STOP_POINT_F0:RW:24:7:=0x1e PI_WDQLVL_VREF_INITIAL_START_POINT_F0:RW:16:7:=0x1a PI_TDFI_WDQLVL_RW_F0:RW:0:10:=0x0056
                    214 0x0101100C    //  214: PI_WDQLVL_EN_F1:RW:24:2:=0x01 PI_WDQLVL_VREF_DELTA_F1:RW:16:4:=0x01 PI_WDQLVL_VREF_INITIAL_STOP_POINT_F1:RW:8:7:=0x1e PI_WDQLVL_VREF_INITIAL_START_POINT_F1:RW:0:7:=0x1a
                    216 0x100C005B    //  216: PI_WDQLVL_VREF_INITIAL_STOP_POINT_F2:RW:24:7:=0x1e PI_WDQLVL_VREF_INITIAL_START_POINT_F2:RW:16:7:=0x1a PI_TDFI_WDQLVL_RW_F2:RW:0:10:=0x005b
                    218 0x04010504    //  218: PI_TWR_F0:RW:24:8:=0x04 PI_TWTR_F0:RW:16:6:=0x01 PI_TRCD_F0:RW:8:8:=0x05 PI_TRP_F0:RW:0:8:=0x03
                    235 0x00DC0007    //  235: PI_TXSR_F1:RW:16:16:=0x026c PI_TXSR_F0:RW:0:16:=0x0014
                    236 0x03030126    //  236: PI_TEXCKE_F1:RW:24:6:=0x03 PI_TEXCKE_F0:RW:16:6:=0x03 PI_TXSR_F2:RW:0:16:=0x033b
                    241 0x00000007    //  241: PI_TXSNR_F0:RW:0:16:=0x0014
                    246 0x000000DC    //  246: PI_TXSNR_F1:RW:0:16:=0x026c
                    251 0x01000126    //  251: RESERVED:RW:16:12:=0x0100 PI_TXSNR_F2:RW:0:16:=0x033b
                    276 0x00063232    //  276: PI_MR23_DATA_F0_0:RW:24:8:=0x00 PI_MR22_DATA_F0_0:RW+:16:8:=0x00 PI_MR14_DATA_F0_0:RW+:8:8:=0x4d PI_MR12_DATA_F0_0:RW+:0:8:=0x4d
                    278 0x00060E0E    //  278: PI_MR23_DATA_F1_0:RW:24:8:=0x00 PI_MR22_DATA_F1_0:RW+:16:8:=0x00 PI_MR14_DATA_F1_0:RW+:8:8:=0x4d PI_MR12_DATA_F1_0:RW+:0:8:=0x4d
                    280 0x00060E0E    //  280: PI_MR23_DATA_F2_0:RW:24:8:=0x00 PI_MR22_DATA_F2_0:RW+:16:8:=0x00 PI_MR14_DATA_F2_0:RW+:8:8:=0x4d PI_MR12_DATA_F2_0:RW+:0:8:=0x4d
                    282 0x002E3232    //  282: PI_MR23_DATA_F0_1:RW:24:8:=0x00 PI_MR22_DATA_F0_1:RW+:16:8:=0x00 PI_MR14_DATA_F0_1:RW+:8:8:=0x4d PI_MR12_DATA_F0_1:RW+:0:8:=0x4d
                    284 0x002E0E0E    //  284: PI_MR23_DATA_F1_1:RW:24:8:=0x00 PI_MR22_DATA_F1_1:RW+:16:8:=0x00 PI_MR14_DATA_F1_1:RW+:8:8:=0x4d PI_MR12_DATA_F1_1:RW+:0:8:=0x4d
                    286 0x002E0E0E    //  286: PI_MR23_DATA_F2_1:RW:24:8:=0x00 PI_MR22_DATA_F2_1:RW+:16:8:=0x00 PI_MR14_DATA_F2_1:RW+:8:8:=0x4d PI_MR12_DATA_F2_1:RW+:0:8:=0x4d
                    288 0x00063232    //  288: PI_MR23_DATA_F0_2:RW:24:8:=0x00 PI_MR22_DATA_F0_2:RW+:16:8:=0x00 PI_MR14_DATA_F0_2:RW+:8:8:=0x4d PI_MR12_DATA_F0_2:RW+:0:8:=0x4d
                    290 0x00060E0E    //  290: PI_MR23_DATA_F1_2:RW:24:8:=0x00 PI_MR22_DATA_F1_2:RW+:16:8:=0x00 PI_MR14_DATA_F1_2:RW+:8:8:=0x4d PI_MR12_DATA_F1_2:RW+:0:8:=0x4d
                    292 0x00060E0E    //  292: PI_MR23_DATA_F2_2:RW:24:8:=0x00 PI_MR22_DATA_F2_2:RW+:16:8:=0x00 PI_MR14_DATA_F2_2:RW+:8:8:=0x4d PI_MR12_DATA_F2_2:RW+:0:8:=0x4d
                    294 0x002E3232    //  294: PI_MR23_DATA_F0_3:RW:24:8:=0x00 PI_MR22_DATA_F0_3:RW+:16:8:=0x00 PI_MR14_DATA_F0_3:RW+:8:8:=0x4d PI_MR12_DATA_F0_3:RW+:0:8:=0x4d
                    296 0x002E0E0E    //  296: PI_MR23_DATA_F1_3:RW:24:8:=0x00 PI_MR22_DATA_F1_3:RW+:16:8:=0x00 PI_MR14_DATA_F1_3:RW+:8:8:=0x4d PI_MR12_DATA_F1_3:RW+:0:8:=0x4d
                    298 0x002E0E0E    //  298: PI_MR23_DATA_F2_3:RW:24:8:=0x00 PI_MR22_DATA_F2_3:RW+:16:8:=0x00 PI_MR14_DATA_F2_3:RW+:8:8:=0x4d PI_MR12_DATA_F2_3:RW+:0:8:=0x4d
                >;

                DDR_PHY_registers = <
                    84 0x01CC0C01    //  84: PHY_DQS_TSEL_ENABLE_0:RW+:24:3:=0x01 PHY_DQ_TSEL_SELECT_0:RW+:8:16:=0x4408 PHY_DQ_TSEL_ENABLE_0:RW+:0:3:=0x01
                    85 0x3A03CC0C    //  85: PHY_VREF_INITIAL_START_POINT_0:RW+:24:7:=0x20 PHY_TWO_CYC_PREAMBLE_0:RW+:16:2:=0x03 PHY_DQS_TSEL_SELECT_0:RW+:0:16:=0x4408
                    86 0x20000142    //  86: PHY_NTP_WDQ_STEP_SIZE_0:RW+:24:8:=0x20 PHY_NTP_TRAIN_EN_0:RW+:16:1:=0x00 PHY_VREF_TRAINING_CTRL_0:RW+:8:2:=0x01 PHY_VREF_INITIAL_STOP_POINT_0:RW+:0:7:=0x25
                    100 0x09BE00A0    //  100: PHY_PAD_VREF_CTRL_DQ_0:RW+:16:12:=0x069f PHY_VREF_SETTING_TIME_0:RW+:0:16:=0x0004
                    138 0x01012020    //  138: PHY_DSLICE_PAD_BOOSTPN_SETTING_0:RW+:16:16:=0x0000 PHY_DATA_DC_DM_CLK_ADJUST_0:RW+:8:8:=0x20 PHY_DATA_DC_DQ7_CLK_ADJUST_0:RW+:0:8:=0x20
                    340 0x01CC0C01    //  340: PHY_DQS_TSEL_ENABLE_1:RW+:24:3:=0x01 PHY_DQ_TSEL_SELECT_1:RW+:8:16:=0x4408 PHY_DQ_TSEL_ENABLE_1:RW+:0:3:=0x01
                    341 0x3A03CC0C    //  341: PHY_VREF_INITIAL_START_POINT_1:RW+:24:7:=0x20 PHY_TWO_CYC_PREAMBLE_1:RW+:16:2:=0x03 PHY_DQS_TSEL_SELECT_1:RW+:0:16:=0x4408
                    342 0x20000142    //  342: PHY_NTP_WDQ_STEP_SIZE_1:RW+:24:8:=0x20 PHY_NTP_TRAIN_EN_1:RW+:16:1:=0x00 PHY_VREF_TRAINING_CTRL_1:RW+:8:2:=0x01 PHY_VREF_INITIAL_STOP_POINT_1:RW+:0:7:=0x25
                    356 0x09BE00A0    //  356: PHY_PAD_VREF_CTRL_DQ_1:RW+:16:12:=0x069f PHY_VREF_SETTING_TIME_1:RW+:0:16:=0x0004
                    394 0x01012020    //  394: PHY_DSLICE_PAD_BOOSTPN_SETTING_1:RW+:16:16:=0x0000 PHY_DATA_DC_DM_CLK_ADJUST_1:RW+:8:8:=0x20 PHY_DATA_DC_DQ7_CLK_ADJUST_1:RW+:0:8:=0x20
                    596 0x01CC0C01    //  596: PHY_DQS_TSEL_ENABLE_2:RW+:24:3:=0x01 PHY_DQ_TSEL_SELECT_2:RW+:8:16:=0x4408 PHY_DQ_TSEL_ENABLE_2:RW+:0:3:=0x01
                    597 0x3A03CC0C    //  597: PHY_VREF_INITIAL_START_POINT_2:RW+:24:7:=0x20 PHY_TWO_CYC_PREAMBLE_2:RW+:16:2:=0x03 PHY_DQS_TSEL_SELECT_2:RW+:0:16:=0x4408
                    598 0x20000142    //  598: PHY_NTP_WDQ_STEP_SIZE_2:RW+:24:8:=0x20 PHY_NTP_TRAIN_EN_2:RW+:16:1:=0x00 PHY_VREF_TRAINING_CTRL_2:RW+:8:2:=0x01 PHY_VREF_INITIAL_STOP_POINT_2:RW+:0:7:=0x25
                    612 0x09BE00A0    //  612: PHY_PAD_VREF_CTRL_DQ_2:RW+:16:12:=0x069f PHY_VREF_SETTING_TIME_2:RW+:0:16:=0x0004
                    650 0x01012020    //  650: PHY_DSLICE_PAD_BOOSTPN_SETTING_2:RW+:16:16:=0x0000 PHY_DATA_DC_DM_CLK_ADJUST_2:RW+:8:8:=0x20 PHY_DATA_DC_DQ7_CLK_ADJUST_2:RW+:0:8:=0x20
                    852 0x01CC0C01    //  852: PHY_DQS_TSEL_ENABLE_3:RW+:24:3:=0x01 PHY_DQ_TSEL_SELECT_3:RW+:8:16:=0x4408 PHY_DQ_TSEL_ENABLE_3:RW+:0:3:=0x01
                    853 0x3A03CC0C    //  853: PHY_VREF_INITIAL_START_POINT_3:RW+:24:7:=0x20 PHY_TWO_CYC_PREAMBLE_3:RW+:16:2:=0x03 PHY_DQS_TSEL_SELECT_3:RW+:0:16:=0x4408
                    854 0x20000142    //  854: PHY_NTP_WDQ_STEP_SIZE_3:RW+:24:8:=0x20 PHY_NTP_TRAIN_EN_3:RW+:16:1:=0x00 PHY_VREF_TRAINING_CTRL_3:RW+:8:2:=0x01 PHY_VREF_INITIAL_STOP_POINT_3:RW+:0:7:=0x25
                    868 0x09BE00A0    //  868: PHY_PAD_VREF_CTRL_DQ_3:RW+:16:12:=0x069f PHY_VREF_SETTING_TIME_3:RW+:0:16:=0x0004
                    906 0x01012020    //  906: PHY_DSLICE_PAD_BOOSTPN_SETTING_3:RW+:16:16:=0x0000 PHY_DATA_DC_DM_CLK_ADJUST_3:RW+:8:8:=0x20 PHY_DATA_DC_DQ7_CLK_ADJUST_3:RW+:0:8:=0x20
                    1064 0x000604CC    //  1064: PHY_PAD_ADR_IO_CFG_0:RW+:16:11:=0x0000 PHY_ADR_DC_CAL_CLK_SEL_0:RW+:8:3:=0x02 PHY_ADR_TSEL_SELECT_0:RW+:0:8:=0x44
                    1330 0x00001294    //  1330: PHY_CAL_START_0:WR:24:1:=0x00 PHY_CAL_CLEAR_0:WR:16:1:=0x00 PHY_CAL_MODE_0:RW:0:13:=0x0064
                    1406 0x0184BF88    //  1406: PHY_PAD_FDBK_DRIVE:RW+:0:30:=0x00030044
                    1407 0x00030100    //  1407: PHY_PAD_FDBK_DRIVE2:RW+:0:18:=0x030008
                    1408 0x00000E7F    //  1408: PHY_PAD_DATA_DRIVE:RW+:0:31:=0x00000180
                    1409 0x00000E7F    //  1409: PHY_PAD_DQS_DRIVE:RW+:0:32:=0x00000180
                    1410 0x001E7F11    //  1410: PHY_PAD_ADDR_DRIVE:RW+:0:30:=0x00018011
                    1411 0x01990000    //  1411: PHY_PAD_ADDR_DRIVE2:RW+:0:27:=0x0089ff00
                    1412 0x008E7FCC    //  1412: PHY_PAD_CLK_DRIVE:RW+:0:32:=0x00018044
                    1414 0x001E7F11    //  1414: PHY_PAD_CKE_DRIVE:RW+:0:30:=0x00018011
                    1415 0x01990000    //  1415: PHY_PAD_CKE_DRIVE2:RW+:0:27:=0x0089ff00
                    1416 0x001E7F11    //  1416: PHY_PAD_RST_DRIVE:RW+:0:30:=0x00018011
                    1417 0x01990000    //  1417: PHY_PAD_RST_DRIVE2:RW+:0:27:=0x0089ff00
                    1418 0x001E7F11    //  1418: PHY_PAD_CS_DRIVE:RW+:0:30:=0x00018011
                >;

            };
        };
    };
};
