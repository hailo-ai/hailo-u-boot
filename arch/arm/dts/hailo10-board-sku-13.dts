// SPDX-License-Identifier: GPL-2.0
/*
 * dts file for Hailo10 (board-sku-13).
 *
 * Copyright (c) 2019-2025 Hailo Technologies Ltd. All rights reserved.
 */
#include "hailo10-m2-base.dtsi"
/* TODO: Add appropriate DDR configuration include */
