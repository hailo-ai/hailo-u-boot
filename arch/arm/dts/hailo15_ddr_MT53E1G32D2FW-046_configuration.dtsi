// SPDX-License-Identifier: GPL-2.0
/*
 * dts file for Hailo15 ddr_MT53E1G32D2FW-046
 *
 * Copyright (c) 2019-2023 Hailo Technologies Ltd. All rights reserved.
 */

#include "dt-bindings/soc/hailo15_ddr_config.h"

&hailo_boot_info {
	ddr_config {
		working_mode = <DDR_WORKING_MODE_NORMAL>;
#ifdef CONFIG_HAILO15_DDR_ENABLE_ECC
		ecc_mode = <DDR_CTRL_ECC_MODE_CORRECTION>;
#else
		ecc_mode = <DDR_CTRL_ECC_MODE_DISABLED>;
#endif
		bist_enable = <1>;
		operational_freq = <2>;
		stop_before_controller_start = <0>;
		f1_frequency = <1600000000>;
		f2_frequency = <2000000000>;
		temperature_poll_period_ms = <1000>;
		temperature_retraining_threshold_millicelsius = <5000>;
		periodic_io_calibration_disable = <0>;
		periodic_vref_training_enable = <0>;
		periodic_calvl_training_enable = <0>;
		periodic_wrlvl_training_enable = <0>;
		periodic_rdlvl_training_enable = <0>;
		periodic_rdlvl_gate_training_enable = <0>;
		periodic_wdqlvl_training_enable = <0>;
	};
};
