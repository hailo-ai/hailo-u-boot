## board/hailo/hailo15-evb-2-camera-vpu/Kconfig
```kconfig
if TARGET_HAILO15_EVB_2_CAMERA_VPU

config SYS_BOARD
	default "hailo15-evb-2-camera-vpu"

config SYS_VENDOR
	default "hailo"

config SYS_CONFIG_NAME
	default "hailo15-evb-2-camera-vpu"
	help
	  This option contains information about board configuration name.
	  Based on this option include/configs/<CONFIG_SYS_CONFIG_NAME>.h header
	  will be used for board configuration.

endif
```

## board/hailo/hailo15-evb-security-camera/Kconfig
```kconfig
if TARGET_HAILO15_EVB_SECURITY_CAMERA

config SYS_BOARD
	default "hailo15-evb-security-camera"

config SYS_VENDOR
	default "hailo"

config SYS_CONFIG_NAME
	default "hailo15-evb-security-camera"
	help
	  This option contains information about board configuration name.
	  Based on this option include/configs/<CONFIG_SYS_CONFIG_NAME>.h header
	  will be used for board configuration.

endif
```

## board/hailo/hailo15-ginger-soc/Kconfig
```kconfig
if TARGET_HAILO15_GINGER_SOC

config SYS_BOARD
	default "hailo15-ginger-soc"

config SYS_VENDOR
	default "hailo"

config SYS_CONFIG_NAME
	default "hailo15-ginger-soc"

endif
```

## board/hailo/hailo15-lavender/Kconfig
```kconfig
if TARGET_HAILO15_LAVENDER

config SYS_BOARD
	default "hailo15-lavender"

config SYS_VENDOR
	default "hailo"

config SYS_CONFIG_NAME
	default "hailo15-lavender"

endif
```

## board/hailo/hailo15-sbc/Kconfig
```kconfig
if TARGET_HAILO15_SBC

config SYS_BOARD
	default "hailo15-sbc"

config SYS_VENDOR
	default "hailo"

config SYS_CONFIG_NAME
	default "hailo15-sbc"
	help
	  This option contains information about board configuration name.
	  Based on this option include/configs/<CONFIG_SYS_CONFIG_NAME>.h header
	  will be used for board configuration.

endif
```

## board/hailo/hailo15-veloce/Kconfig
```kconfig
if TARGET_HAILO15_VELOCE

config SYS_BOARD
	default "hailo15-veloce"

config SYS_VENDOR
	default "hailo"

config SYS_CONFIG_NAME
	default "hailo15-veloce"

endif
```

## board/hailo/hailo15-vp/Kconfig
```kconfig
if TARGET_HAILO15_VP

config SYS_BOARD
	default "hailo15-vp"

config SYS_VENDOR
	default "hailo"

config SYS_CONFIG_NAME
	default "hailo15-vp"

endif
```

## configs/hailo15_evb_2_camera_vpu_defconfig
```kconfig
CONFIG_ARM=y
CONFIG_ARCH_HAILO=y
CONFIG_TARGET_HAILO15_EVB_2_CAMERA_VPU=y
CONFIG_DEFAULT_DEVICE_TREE="hailo15-evb-2-camera-vpu"
CONFIG_SPI_FLASH_STMICRO=y
```

## configs/hailo15_evb_security_camera_defconfig
```kconfig
CONFIG_ARM=y
CONFIG_ARCH_HAILO=y
CONFIG_TARGET_HAILO15_EVB_SECURITY_CAMERA=y
CONFIG_DEFAULT_DEVICE_TREE="hailo15-evb-security-camera"
CONFIG_SPI_FLASH_STMICRO=y
CONFIG_DM_I2C=y
CONFIG_SYS_I2C_DW=y
CONFIG_CMD_I2C=y
```

## configs/hailo15_ginger_soc_defconfig
```kconfig
CONFIG_ARM=y
CONFIG_ARCH_HAILO=y
CONFIG_TARGET_HAILO15_GINGER_SOC=y
CONFIG_DEFAULT_DEVICE_TREE="hailo15-ginger-soc"
CONFIG_SPI_FLASH_STMICRO=y
```

## configs/hailo15_ginger_soc_sdio0_defconfig
```kconfig
CONFIG_ARM=y
CONFIG_ARCH_HAILO=y
CONFIG_TARGET_HAILO15_GINGER_SOC_SDIO0=y
CONFIG_DEFAULT_DEVICE_TREE="hailo15-ginger-soc-sdio0"
CONFIG_SPI_FLASH_STMICRO=y
```

## configs/hailo15_lavender_defconfig
```kconfig
CONFIG_ARM=y
CONFIG_ARCH_HAILO=y
CONFIG_TARGET_HAILO15_LAVENDER=y
CONFIG_DEFAULT_DEVICE_TREE="hailo15-lavender"
CONFIG_SPI_FLASH_STMICRO=y
```

## configs/hailo15_sbc_defconfig
```kconfig
CONFIG_ARM=y
CONFIG_ARCH_HAILO=y
CONFIG_TARGET_HAILO15_SBC=y
CONFIG_DEFAULT_DEVICE_TREE="hailo15-sbc"
CONFIG_SPI_FLASH_ISSI=y
CONFIG_SPI_FLASH_WINBOND=y
```

## configs/hailo15_veloce_defconfig
```kconfig
CONFIG_ARM=y
CONFIG_ARCH_HAILO=y
CONFIG_TARGET_HAILO15_VELOCE=y
CONFIG_DEFAULT_DEVICE_TREE="hailo15-veloce"
CONFIG_USE_BOOTCOMMAND=y
CONFIG_BOOTCOMMAND="setenv bootargs console=ttyS0,115200n8 earlyprintk earlycon loglevel=8 rootwait debug root=/dev/mtdblock2; bootm 80101000"
CONFIG_AUTOBOOT=n
```

## configs/hailo15_vp_defconfig
```kconfig
CONFIG_ARM=y
CONFIG_ARCH_HAILO=y
CONFIG_TARGET_HAILO15_VP=y
CONFIG_DEFAULT_DEVICE_TREE="hailo15-vp"
CONFIG_MMC_SDHCI=n
CONFIG_DM_MMC=n
CONFIG_ARM_PL180_MMCI=y
```

## drivers/pinctrl/hailo/Kconfig
```kconfig
# SPDX-License-Identifier: GPL-2.0-only
config PINCTRL_HAILO15
	bool "HAILO15 pinctrl driver"
	depends on MACH_HAILO15 && PINCTRL
	help
	  Say yes here to provide support for HAILO15 driver.
```
